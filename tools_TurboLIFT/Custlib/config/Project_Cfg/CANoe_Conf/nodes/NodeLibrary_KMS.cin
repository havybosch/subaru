variables
{
	
	Message MACKSEND1		MSG_MACKSEND1;
	Message MACKSEND2		MSG_MACKSEND2;	
	Message MACKSEND3		MSG_MACKSEND3;
	Message MACKSEND4		MSG_MACKSEND4;
	Message MACKSEND5		MSG_MACKSEND5;
	Message MACKSEND6		MSG_MACKSEND6;	
	Message MACKSEND7		MSG_MACKSEND7;
	Message MACKSEND8		MSG_MACKSEND8;
	Message MACKVERI1		MSG_MACKVERI1;
	Message MACKVERI2		MSG_MACKVERI2;	
	Message MACKVERI3		MSG_MACKVERI3;
	Message MACKVERI4		MSG_MACKVERI4;
	Message MACKID_MACKUSAGE		MSG_MACKID_MACKUSAGE;
	
	mstimer 	T_MSG_MACKSEND1;
	mstimer 	T_MSG_MACKSEND2;
	mstimer 	T_MSG_MACKSEND3;
	mstimer 	T_MSG_MACKSEND4;
	mstimer 	T_MSG_MACKSEND5;
	mstimer 	T_MSG_MACKSEND6;
	mstimer 	T_MSG_MACKSEND7;
	mstimer 	T_MSG_MACKSEND8;
	mstimer 	T_MSG_MACKVERI1;
	mstimer 	T_MSG_MACKVERI2;
	mstimer 	T_MSG_MACKVERI3;
	mstimer 	T_MSG_MACKVERI4;
	mstimer 	T_MSG_MACKID_MACKUSAGE;	

}