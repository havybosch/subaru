/*@!Encoding:1252*/
includes 
{
#include "NodeLibrary_R00r.cin"
#include "SecurityMasterGlobal.cin"
#pragma library ("../SecMgrCANoeClient.dll")
}
variables
{
  int cnt = 0;
  int Valid_pattern;
  int Invalid_pattern;
  int Unobtain_pattern;
  int data_selection = 255;
  int use_case;
  word SyncFVlength = 40;
  qword g_TripCnt;
  qword g_ResetCnt;
  int data_simulate;
  qword msgCnt_CruiseMultiSwitch1 = 0;
  qword resetFlag_CruiseMultiSwitch1 = 0;
  qword tripCnt_CruiseMultiSwitch1 = 0;
  qword resetCnt_CruiseMultiSwitch1 = 0;
  qword mac_CruiseMultiSwitch1;
  byte payload_CruiseMultiSwitch1[4];
  
  qword msgCnt_HvacControlInformation2 = 0;
  qword resetFlag_HvacControlInformation2 = 0;
  qword tripCnt_HvacControlInformation2 = 0;
  qword resetCnt_HvacControlInformation2 = 0;
  qword mac_HvacControlInformation2;
  byte payload_HvacControlInformation2[4];
  
  qword msgCnt_WheelData2 = 0;
  qword resetFlag_WheelData2 = 0;
  qword tripCnt_WheelData2 = 0;
  qword resetCnt_WheelData2 = 0;
  qword mac_WheelData2;
  byte payload_WheelData2[4];
  
  qword msgCnt_BCMInformation1 = 0;
  qword resetFlag_BCMInformation1 = 0;
  qword tripCnt_BCMInformation1 = 0;
  qword resetCnt_BCMInformation1 = 0;
  qword mac_BCMInformation1;
  byte payload_BCMInformation1[4];
  
  qword msgCnt_EPASSASInfo2 = 0;
  qword resetFlag_EPASSASInfo2 = 0;
  qword tripCnt_EPASSASInfo2 = 0;
  qword resetCnt_EPASSASInfo2 = 0;
  qword mac_EPASSASInfo2;
  byte payload_EPASSASInfo2[4];
  
  qword msgCnt_AEBLongReqBrk = 0;
  qword resetFlag_AEBLongReqBrk = 0;
  qword tripCnt_AEBLongReqBrk = 0;
  qword resetCnt_AEBLongReqBrk = 0;
  qword mac_AEBLongReqBrk;
  byte payload_AEBLongReqBrk[4];
  
  qword msgCnt_AEBLongReqPt = 0;
  qword resetFlag_AEBLongReqPt = 0;
  qword tripCnt_AEBLongReqPt = 0;
  qword resetCnt_AEBLongReqPt = 0;
  qword mac_AEBLongReqPt;
  byte payload_AEBLongReqPt[4];
  
  qword msgCnt_RCMStatusMessage2 = 0;
  qword resetFlag_RCMStatusMessage2 = 0;
  qword tripCnt_RCMStatusMessage2 = 0;
  qword resetCnt_RCMStatusMessage2 = 0;
  qword mac_RCMStatusMessage2;
  byte payload_RCMStatusMessage2[4];
  
  qword msgCnt_YawRate = 0;
  qword resetFlag_YawRate = 0;
  qword tripCnt_YawRate = 0;
  qword resetCnt_YawRate = 0;
  qword mac_YawRate;
  byte payload_YawRate[4];
  
  qword msgCnt_LateAcc = 0;
  qword resetFlag_LateAcc = 0;
  qword tripCnt_LateAcc = 0;
  qword resetCnt_LateAcc = 0;
  qword mac_LateAcc;
  byte payload_LateAcc[4];
  
  qword msgCnt_LongAcc = 0;
  qword resetFlag_LongAcc = 0;
  qword tripCnt_LongAcc = 0;
  qword resetCnt_LongAcc = 0;
  qword mac_LongAcc;
  byte payload_LongAcc[4];
  
  qword msgCnt_RCMStatusMessage1 = 0;
  qword resetFlag_RCMStatusMessage1 = 0;
  qword tripCnt_RCMStatusMessage1 = 0;
  qword resetCnt_RCMStatusMessage1 = 0;
  qword mac_RCMStatusMessage1;
  byte payload_RCMStatusMessage1[4];
  
  qword msgCnt_crashoutput = 0;
  qword resetFlag_crashoutput = 0;
  qword tripCnt_crashoutput = 0;
  qword resetCnt_crashoutput = 0;
  qword mac_crashoutput;
  byte payload_crashoutput[4];
  
  qword msgCnt_crashoutputbrk = 0;
  qword resetFlag_crashoutputbrk = 0;
  qword tripCnt_crashoutputbrk = 0;
  qword resetCnt_crashoutputbrk = 0;
  qword mac_crashoutputbrk;
  byte payload_crashoutputbrk[4];
  
  qword msgCnt_DesiredTorqBrk = 0;
  qword resetFlag_DesiredTorqBrk = 0;
  qword tripCnt_DesiredTorqBrk = 0;
  qword resetCnt_DesiredTorqBrk = 0;
  qword mac_DesiredTorqBrk;
  byte payload_DesiredTorqBrk[4];

  qword msgCnt_BrakeSysFeatures = 0;
  qword resetFlag_BrakeSysFeatures = 0;
  qword tripCnt_BrakeSysFeatures = 0;
  qword resetCnt_BrakeSysFeatures = 0;
  qword mac_BrakeSysFeatures;
  byte payload_BrakeSysFeatures[4];

  
  word clearAcceptanceWindow = 15;
  word tripCntInitValue = 0;
  qword tripCntMaxValue = 0xFFFF;
  
  dword glbHandle = 0;
  char buffer[100];
  long glbValue = 0;
  
  /* For security access*/
  byte VAR_SA_KeyData[32];
  
  /* For Security Access Level 0x1A */
  byte AES_Key[16] = { 0x22, 0x22, 0x22, 0x22, 0x22, 0x22, 0x22, 0x22, 0x22, 0x22, 0x22, 0x22, 0x22, 0x22, 0x22, 0x22 };
  byte AES_InitVector[16] = { 0x8C, 0xCF, 0x74, 0x97, 0x4D, 0x68, 0x72, 0x4F, 0x75, 0x66, 0x0E, 0x16, 0x2D, 0xFA, 0x92, 0xF7 };
  
}
on stopMeasurement
{
  glbHandle = OpenFileWrite("TripCounter.txt",0);
  snprintf(buffer, elcount(buffer), "%f", getvalue(EnvCGW_Sync_TripCnt_));
  filePutString(buffer, elcount(buffer), glbHandle);
  fileClose(glbHandle); 
}
on start
{
	putvalue ( EnvENG1D70To_, 1 );
	putvalue ( EnvABG1S01To_, 1 );
	putvalue ( EnvENG1S60To_, 1 );
	putvalue ( EnvEPB_info_1_MACTo_, 1 );
	putvalue ( EnvFSC_AEBHmi_InfoTo_, 1 );
	putvalue ( EnvFSC_AEBReq_Info_MACTo_, 1 );
	putvalue ( Env_P_Dummy, 0 );
//	putvalue ( EnvADAS_AP_Collision_Data2To_, 1 );
	putvalue ( EnvSAS_G_Info2To_, 1 );
	putvalue ( EnvRCM_Diag_RxTo_, 1 );
	putvalue ( EnvIP_Switch_InformationTo_, 1 );
	putvalue ( EnvAEB_Longitudinal_Req_Brk_MACTo_, 1 );
	putvalue ( EnvYAW_Rate_Brake_Control_2_2_MACTo_, 1 );
	putvalue ( EnvEPAS_SAS_Info_2_MACTo_, 1 );
	putvalue ( EnvMACKSEND6To_, 1 );
	putvalue ( EnvLocateTime_InfoTo_, 1 );
	putvalue ( EnvRCM_Bus_StatusTo_, 1 );
	putvalue ( EnvEngControlDataTo_, 1 );
	putvalue ( EnvDesiredTorqBrk_MACTo_, 1 );
	putvalue ( EnvCBCM_DriveSelection_InfoTo_, 1 );
	putvalue ( EnvRCM_Late_Acc_MACTo_, 1 );
	putvalue ( EnvMACKVERI2To_, 1 );
	putvalue ( EnvVDT_Trigger_Control2To_, 1 );
	putvalue ( EnvRCM_Diag_TxTo_, 1 );
	putvalue ( EnvDoor_D_MessageTo_, 1 );
	putvalue ( EnvSAS_G_Info1To_, 1 );
	putvalue ( EnvECM_StatusTo_, 1 );
	putvalue ( EnvADAS_HMI_Information2To_, 1 );
	putvalue ( EnvHvac_Control_Information2_MACTo_, 1 );
	putvalue ( EnvLongitudinal_Lateral_deltaVTo_, 1 );
	putvalue ( EnvYAW_Rate_Brake_Control_2_1_MACTo_, 1 );
	putvalue ( EnvMACKSEND3To_, 1 );
	putvalue ( EnvEPAS_SAS_Info_1_MACTo_, 1 );
	putvalue ( EnvADAS_SteeringCtrl_DataTo_, 1 );
	putvalue ( EnvMACKVERI4To_, 1 );
	putvalue ( EnvABS_Diag_RxTo_, 1 );
	putvalue ( EnvWheelData2To_, 1 );
	putvalue ( Envcrashoutput_brk_MACTo_, 1 );
//	putvalue ( EnvDirectYawMomentControlRequestTo_, 1 );
	putvalue ( EnvAEB_Longitudinal_Request_Pt_MACTo_, 1 );
	putvalue ( EnvBrakeSysFeatures_MACTo_, 1 );
	putvalue ( EnvCBCM_Autosar_NMTo_, 1 );
	putvalue ( EnvWheelData_1_MACTo_, 1 );
	putvalue ( EnvGCC_Config_MgmtTo_, 1 );
	putvalue ( EnvMACKSEND8To_, 1 );
	putvalue ( EnvFunctional_Diag_RequestTo_, 1 );
	putvalue ( EnvEngine_ConfTo_, 1 );
	putvalue ( EnvTransGearDataTo_, 1 );
	putvalue ( EnvMACKSEND2To_, 1 );
	putvalue ( EnvADAS_HMI_Information4To_, 1 );
	putvalue ( EnvEngVehicleSpThrottleTo_, 1 );
	putvalue ( EnvRBCM_Information2To_, 1 );
	putvalue ( EnvRCMSerialNumberTo_, 1 );
	putvalue ( EnvTPMS_ControlTo_, 1 );
	putvalue ( EnvCBCM_IllumStatusTo_, 1 );
	putvalue ( EnvEPAS_CCP_RxTo_, 1 );
	putvalue ( EnvMACKSEND4To_, 1 );
	putvalue ( EnvDCM_MessageTo_, 1 );
	putvalue ( EnvEPAS_Diag_TxTo_, 1 );
	putvalue ( EnvABS_Diag_TxTo_, 1 );
	putvalue ( Envcrashoutput_MACTo_, 1 );
	putvalue ( EnvMACKID_MACKUSAGETo_, 1 );
	putvalue ( EnvRCM_Long_Acc_MACTo_, 1 );
	putvalue ( EnvYAW_Rate_Brake_Control_1_2_MACTo_, 1 );
//	putvalue ( EnvFSC_AEBReq_InfoTo_, 1 );
	putvalue ( EnvRCM_Yaw_Rate_MACTo_, 1 );
	putvalue ( EnvABS_Autosar_NMTo_, 1 );
	putvalue ( EnvSteering_Column_SwitchTo_, 1 );
	putvalue ( EnvBCM_Information1To_, 1 );
	putvalue ( EnvEPAS_Bus_StatusTo_, 1 );
	putvalue ( EnvMACKVERI3To_, 1 );
	putvalue ( EnvADAS_HMI_Information12To_, 1 );
	putvalue ( EnvBrakeSysFeaturesTo_, 1 );
	putvalue ( EnvCruise_Multi_Switch_2_MACTo_, 1 );
	putvalue ( EnvSISS_RqstTo_, 1 );
	putvalue ( EnvVDT_RCM_EDRTo_, 1 );
	putvalue ( EnvMACKSEND5To_, 1 );
	putvalue ( EnvADAS_HMI_Information5To_, 1 );
	putvalue ( EnvRCM_ISO_SCRAP_RxTo_, 1 );
	putvalue ( EnvADAS_Longitudinal_Req_Brk_MACTo_, 1 );
	putvalue ( EnvSmartKeylessRequestTo_, 1 );
	putvalue ( EnvEPAS_Diag_RxTo_, 1 );
	putvalue ( EnvSteering_Wheel_AngleTo_, 1 );
	putvalue ( EnvVCM_Customize_Status_01To_, 1 );
	putvalue ( EnvRCMStatusMessage_MACTo_, 1 );
	putvalue ( EnvRCM_ISO_SCRAP_TxTo_, 1 );
	putvalue ( EnvMACKVERI1To_, 1 );
	putvalue ( EnvYAW_Rate_Brake_ControlTo_, 1 );
	putvalue ( EnvMACKSEND1To_, 1 );
	putvalue ( EnvCruise_Multi_Switch_1_MACTo_, 1 );
	putvalue ( EnvADAS_HMI_Information1To_, 1 );
	putvalue ( EnvBCM_Information1_MACTo_, 1 );
	putvalue ( EnvEPAS_CCP_TxTo_, 1 );
	putvalue ( EnvMACKSEND7To_, 1 );
	putvalue ( EnvPush_Start_StatusTo_, 1 );
	putvalue ( EnvCGW_SyncTo_, 1 );
	putvalue ( EnvEPAS_Info_MACTo_, 1 );
//	putvalue ( EnvADAS_AP_Collision_Data1To_, 1 );
	putvalue ( EnvADAS_SteeringCtrlReq_DataTo_, 1 );
	putvalue ( EnvRCMStatusMessage_2_MACTo_, 1 );
	putvalue ( EnvYAW_Rate_Brake_Control_1_1_MACTo_, 1 );
	putvalue ( EnvWheelData_2_MACTo_, 1 );
	putvalue ( EnvHvac_Control_Information2To_, 1 );
	putvalue ( EnvWheelSpeedTo_, 1 );

	putvalue(EnvENG1D70Time_, MSG_ENG1D70.GenMsgCycleTime);
	putvalue(EnvABG1S01Time_, MSG_ABG1S01.GenMsgCycleTime);
	putvalue(EnvENG1S60Time_, MSG_ENG1S60.GenMsgCycleTime);
	putvalue(EnvEPB_info_1_MACTime_, MSG_EPB_info_1_MAC.GenMsgCycleTime);
	putvalue(EnvFSC_AEBHmi_InfoTime_, MSG_FSC_AEBHmi_Info.GenMsgCycleTime);
	putvalue(EnvFSC_AEBReq_Info_MACTime_, MSG_FSC_AEBReq_Info_MAC.GenMsgCycleTime);
//	putvalue(EnvADAS_AP_Collision_Data2Time_, MSG_ADAS_AP_Collision_Data2.GenMsgCycleTime);
	putvalue(EnvSAS_G_Info2Time_, MSG_SAS_G_Info2.GenMsgCycleTime);
	putvalue(EnvRCM_Diag_RxTime_, MSG_RCM_Diag_Rx.GenMsgCycleTime);
	putvalue(EnvIP_Switch_InformationTime_, MSG_IP_Switch_Information.GenMsgCycleTime);
	putvalue(EnvAEB_Longitudinal_Req_Brk_MACTime_, MSG_AEB_Longitudinal_Req_Brk_MAC.GenMsgCycleTime);
	putvalue(EnvYAW_Rate_Brake_Control_2_2_MACTime_, MSG_YAW_Rate_Brake_Control_2_2_MAC.GenMsgCycleTime);
	putvalue(EnvEPAS_SAS_Info_2_MACTime_, MSG_EPAS_SAS_Info_2_MAC.GenMsgCycleTime);
	putvalue(EnvMACKSEND6Time_, MSG_MACKSEND6.GenMsgCycleTime);
	putvalue(EnvLocateTime_InfoTime_, MSG_LocateTime_Info.GenMsgCycleTime);
	putvalue(EnvRCM_Bus_StatusTime_, MSG_RCM_Bus_Status.GenMsgCycleTime);
	putvalue(EnvEngControlDataTime_, MSG_EngControlData.GenMsgCycleTime);
	putvalue(EnvDesiredTorqBrk_MACTime_, MSG_DesiredTorqBrk_MAC.GenMsgCycleTime);
	putvalue(EnvCBCM_DriveSelection_InfoTime_, MSG_CBCM_DriveSelection_Info.GenMsgCycleTime);
	putvalue(EnvRCM_Late_Acc_MACTime_, MSG_RCM_Late_Acc_MAC.GenMsgCycleTime);
	putvalue(EnvMACKVERI2Time_, MSG_MACKVERI2.GenMsgCycleTime);
	putvalue(EnvVDT_Trigger_Control2Time_, MSG_VDT_Trigger_Control2.GenMsgCycleTime);
	putvalue(EnvRCM_Diag_TxTime_, MSG_RCM_Diag_Tx.GenMsgCycleTime);
	putvalue(EnvDoor_D_MessageTime_, MSG_Door_D_Message.GenMsgCycleTime);
	putvalue(EnvSAS_G_Info1Time_, MSG_SAS_G_Info1.GenMsgCycleTime);
	putvalue(EnvECM_StatusTime_, MSG_ECM_Status.GenMsgCycleTime);
	putvalue(EnvADAS_HMI_Information2Time_, MSG_ADAS_HMI_Information2.GenMsgCycleTime);
	putvalue(EnvHvac_Control_Information2_MACTime_, MSG_Hvac_Control_Information2_MAC.GenMsgCycleTime);
	putvalue(EnvLongitudinal_Lateral_deltaVTime_, MSG_Longitudinal_Lateral_deltaV.GenMsgCycleTime);
	putvalue(EnvYAW_Rate_Brake_Control_2_1_MACTime_, MSG_YAW_Rate_Brake_Control_2_1_MAC.GenMsgCycleTime);
	putvalue(EnvMACKSEND3Time_, MSG_MACKSEND3.GenMsgCycleTime);
	putvalue(EnvEPAS_SAS_Info_1_MACTime_, MSG_EPAS_SAS_Info_1_MAC.GenMsgCycleTime);
	putvalue(EnvADAS_SteeringCtrl_DataTime_, MSG_ADAS_SteeringCtrl_Data.GenMsgCycleTime);
	putvalue(EnvMACKVERI4Time_, MSG_MACKVERI4.GenMsgCycleTime);
	putvalue(EnvABS_Diag_RxTime_, MSG_ABS_Diag_Rx.GenMsgCycleTime);
	putvalue(EnvWheelData2Time_, MSG_WheelData2.GenMsgCycleTime);
	putvalue(Envcrashoutput_brk_MACTime_, MSG_crashoutput_brk_MAC.GenMsgCycleTime);
//	putvalue(EnvDirectYawMomentControlRequestTime_, MSG_DirectYawMomentControlRequest.GenMsgCycleTime);
	putvalue(EnvAEB_Longitudinal_Request_Pt_MACTime_, MSG_AEB_Longitudinal_Request_Pt_MAC.GenMsgCycleTime);
	putvalue(EnvBrakeSysFeatures_MACTime_, MSG_BrakeSysFeatures_MAC.GenMsgCycleTime);
	putvalue(EnvCBCM_Autosar_NMTime_, MSG_CBCM_Autosar_NM.GenMsgCycleTime);
	putvalue(EnvWheelData_1_MACTime_, MSG_WheelData_1_MAC.GenMsgCycleTime);
	putvalue(EnvGCC_Config_MgmtTime_, MSG_GCC_Config_Mgmt.GenMsgCycleTime);
	putvalue(EnvMACKSEND8Time_, MSG_MACKSEND8.GenMsgCycleTime);
	putvalue(EnvFunctional_Diag_RequestTime_, MSG_Functional_Diag_Request.GenMsgCycleTime);
	putvalue(EnvEngine_ConfTime_, MSG_Engine_Conf.GenMsgCycleTime);
	putvalue(EnvTransGearDataTime_, MSG_TransGearData.GenMsgCycleTime);
	putvalue(EnvMACKSEND2Time_, MSG_MACKSEND2.GenMsgCycleTime);
	putvalue(EnvADAS_HMI_Information4Time_, MSG_ADAS_HMI_Information4.GenMsgCycleTime);
	putvalue(EnvEngVehicleSpThrottleTime_, MSG_EngVehicleSpThrottle.GenMsgCycleTime);
	putvalue(EnvRBCM_Information2Time_, MSG_RBCM_Information2.GenMsgCycleTime);
	putvalue(EnvRCMSerialNumberTime_, MSG_RCMSerialNumber.GenMsgCycleTime);
	putvalue(EnvTPMS_ControlTime_, MSG_TPMS_Control.GenMsgCycleTime);
	putvalue(EnvCBCM_IllumStatusTime_, MSG_CBCM_IllumStatus.GenMsgCycleTime);
	putvalue(EnvEPAS_CCP_RxTime_, MSG_EPAS_CCP_Rx.GenMsgCycleTime);
	putvalue(EnvMACKSEND4Time_, MSG_MACKSEND4.GenMsgCycleTime);
	putvalue(EnvDCM_MessageTime_, MSG_DCM_Message.GenMsgCycleTime);
	putvalue(EnvEPAS_Diag_TxTime_, MSG_EPAS_Diag_Tx.GenMsgCycleTime);
	putvalue(EnvABS_Diag_TxTime_, MSG_ABS_Diag_Tx.GenMsgCycleTime);
	putvalue(Envcrashoutput_MACTime_, MSG_crashoutput_MAC.GenMsgCycleTime);
	putvalue(EnvMACKID_MACKUSAGETime_, MSG_MACKID_MACKUSAGE.GenMsgCycleTime);
	putvalue(EnvRCM_Long_Acc_MACTime_, MSG_RCM_Long_Acc_MAC.GenMsgCycleTime);
	putvalue(EnvYAW_Rate_Brake_Control_1_2_MACTime_, MSG_YAW_Rate_Brake_Control_1_2_MAC.GenMsgCycleTime);
//	putvalue(EnvFSC_AEBReq_InfoTime_, MSG_FSC_AEBReq_Info.GenMsgCycleTime);
	putvalue(EnvRCM_Yaw_Rate_MACTime_, MSG_RCM_Yaw_Rate_MAC.GenMsgCycleTime);
	putvalue(EnvABS_Autosar_NMTime_, MSG_ABS_Autosar_NM.GenMsgCycleTime);
	putvalue(EnvSteering_Column_SwitchTime_, MSG_Steering_Column_Switch.GenMsgCycleTime);
	putvalue(EnvBCM_Information1Time_, MSG_BCM_Information1.GenMsgCycleTime);
	putvalue(EnvEPAS_Bus_StatusTime_, MSG_EPAS_Bus_Status.GenMsgCycleTime);
	putvalue(EnvMACKVERI3Time_, MSG_MACKVERI3.GenMsgCycleTime);
	putvalue(EnvADAS_HMI_Information12Time_, MSG_ADAS_HMI_Information12.GenMsgCycleTime);
	putvalue(EnvBrakeSysFeaturesTime_, MSG_BrakeSysFeatures.GenMsgCycleTime);
	putvalue(EnvCruise_Multi_Switch_2_MACTime_, MSG_Cruise_Multi_Switch_2_MAC.GenMsgCycleTime);
	putvalue(EnvSISS_RqstTime_, MSG_SISS_Rqst.GenMsgCycleTime);
	putvalue(EnvVDT_RCM_EDRTime_, MSG_VDT_RCM_EDR.GenMsgCycleTime);
	putvalue(EnvMACKSEND5Time_, MSG_MACKSEND5.GenMsgCycleTime);
	putvalue(EnvADAS_HMI_Information5Time_, MSG_ADAS_HMI_Information5.GenMsgCycleTime);
	putvalue(EnvRCM_ISO_SCRAP_RxTime_, MSG_RCM_ISO_SCRAP_Rx.GenMsgCycleTime);
	putvalue(EnvADAS_Longitudinal_Req_Brk_MACTime_, MSG_ADAS_Longitudinal_Req_Brk_MAC.GenMsgCycleTime);
	putvalue(EnvSmartKeylessRequestTime_, MSG_SmartKeylessRequest.GenMsgCycleTime);
	putvalue(EnvEPAS_Diag_RxTime_, MSG_EPAS_Diag_Rx.GenMsgCycleTime);
	putvalue(EnvSteering_Wheel_AngleTime_, MSG_Steering_Wheel_Angle.GenMsgCycleTime);
	putvalue(EnvVCM_Customize_Status_01Time_, MSG_VCM_Customize_Status_01.GenMsgCycleTime);
	putvalue(EnvRCMStatusMessage_MACTime_, MSG_RCMStatusMessage_MAC.GenMsgCycleTime);
	putvalue(EnvRCM_ISO_SCRAP_TxTime_, MSG_RCM_ISO_SCRAP_Tx.GenMsgCycleTime);
	putvalue(EnvMACKVERI1Time_, MSG_MACKVERI1.GenMsgCycleTime);
	putvalue(EnvYAW_Rate_Brake_ControlTime_, MSG_YAW_Rate_Brake_Control.GenMsgCycleTime);
	putvalue(EnvMACKSEND1Time_, MSG_MACKSEND1.GenMsgCycleTime);
	putvalue(EnvCruise_Multi_Switch_1_MACTime_, MSG_Cruise_Multi_Switch_1_MAC.GenMsgCycleTime);
	putvalue(EnvADAS_HMI_Information1Time_, MSG_ADAS_HMI_Information1.GenMsgCycleTime);
	putvalue(EnvBCM_Information1_MACTime_, MSG_BCM_Information1_MAC.GenMsgCycleTime);
	putvalue(EnvEPAS_CCP_TxTime_, MSG_EPAS_CCP_Tx.GenMsgCycleTime);
	putvalue(EnvMACKSEND7Time_, MSG_MACKSEND7.GenMsgCycleTime);
	putvalue(EnvPush_Start_StatusTime_, MSG_Push_Start_Status.GenMsgCycleTime);
	putvalue(EnvCGW_SyncTime_, MSG_CGW_Sync.GenMsgCycleTime);
	putvalue(EnvEPAS_Info_MACTime_, MSG_EPAS_Info_MAC.GenMsgCycleTime);
//	putvalue(EnvADAS_AP_Collision_Data1Time_, MSG_ADAS_AP_Collision_Data1.GenMsgCycleTime);
	putvalue(EnvADAS_SteeringCtrlReq_DataTime_, MSG_ADAS_SteeringCtrlReq_Data.GenMsgCycleTime);
	putvalue(EnvRCMStatusMessage_2_MACTime_, MSG_RCMStatusMessage_2_MAC.GenMsgCycleTime);
	putvalue(EnvYAW_Rate_Brake_Control_1_1_MACTime_, MSG_YAW_Rate_Brake_Control_1_1_MAC.GenMsgCycleTime);
	putvalue(EnvWheelData_2_MACTime_, MSG_WheelData_2_MAC.GenMsgCycleTime);
	putvalue(EnvHvac_Control_Information2Time_, MSG_Hvac_Control_Information2.GenMsgCycleTime);
	putvalue(EnvWheelSpeedTime_, MSG_WheelSpeed.GenMsgCycleTime);

	putvalue(EnvENG1D70Dlc_, MSG_ENG1D70.Dlc);
	putvalue(EnvABG1S01Dlc_, MSG_ABG1S01.Dlc);
	putvalue(EnvENG1S60Dlc_, MSG_ENG1S60.Dlc);
	putvalue(EnvEPB_info_1_MACDlc_, MSG_EPB_info_1_MAC.Dlc);
	putvalue(EnvFSC_AEBHmi_InfoDlc_, MSG_FSC_AEBHmi_Info.Dlc);
	putvalue(EnvFSC_AEBReq_Info_MACDlc_, MSG_FSC_AEBReq_Info_MAC.Dlc);
//	putvalue(EnvADAS_AP_Collision_Data2Dlc_, MSG_ADAS_AP_Collision_Data2.Dlc);
	putvalue(EnvSAS_G_Info2Dlc_, MSG_SAS_G_Info2.Dlc);
	putvalue(EnvRCM_Diag_RxDlc_, MSG_RCM_Diag_Rx.Dlc);
	putvalue(EnvIP_Switch_InformationDlc_, MSG_IP_Switch_Information.Dlc);
	putvalue(EnvAEB_Longitudinal_Req_Brk_MACDlc_, MSG_AEB_Longitudinal_Req_Brk_MAC.Dlc);
	putvalue(EnvYAW_Rate_Brake_Control_2_2_MACDlc_, MSG_YAW_Rate_Brake_Control_2_2_MAC.Dlc);
	putvalue(EnvEPAS_SAS_Info_2_MACDlc_, MSG_EPAS_SAS_Info_2_MAC.Dlc);
	putvalue(EnvMACKSEND6Dlc_, MSG_MACKSEND6.Dlc);
	putvalue(EnvLocateTime_InfoDlc_, MSG_LocateTime_Info.Dlc);
	putvalue(EnvRCM_Bus_StatusDlc_, MSG_RCM_Bus_Status.Dlc);
	putvalue(EnvEngControlDataDlc_, MSG_EngControlData.Dlc);
	putvalue(EnvDesiredTorqBrk_MACDlc_, MSG_DesiredTorqBrk_MAC.Dlc);
	putvalue(EnvCBCM_DriveSelection_InfoDlc_, MSG_CBCM_DriveSelection_Info.Dlc);
	putvalue(EnvRCM_Late_Acc_MACDlc_, MSG_RCM_Late_Acc_MAC.Dlc);
	putvalue(EnvMACKVERI2Dlc_, MSG_MACKVERI2.Dlc);
	putvalue(EnvVDT_Trigger_Control2Dlc_, MSG_VDT_Trigger_Control2.Dlc);
	putvalue(EnvRCM_Diag_TxDlc_, MSG_RCM_Diag_Tx.Dlc);
	putvalue(EnvDoor_D_MessageDlc_, MSG_Door_D_Message.Dlc);
	putvalue(EnvSAS_G_Info1Dlc_, MSG_SAS_G_Info1.Dlc);
	putvalue(EnvECM_StatusDlc_, MSG_ECM_Status.Dlc);
	putvalue(EnvADAS_HMI_Information2Dlc_, MSG_ADAS_HMI_Information2.Dlc);
	putvalue(EnvHvac_Control_Information2_MACDlc_, MSG_Hvac_Control_Information2_MAC.Dlc);
	putvalue(EnvLongitudinal_Lateral_deltaVDlc_, MSG_Longitudinal_Lateral_deltaV.Dlc);
	putvalue(EnvYAW_Rate_Brake_Control_2_1_MACDlc_, MSG_YAW_Rate_Brake_Control_2_1_MAC.Dlc);
	putvalue(EnvMACKSEND3Dlc_, MSG_MACKSEND3.Dlc);
	putvalue(EnvEPAS_SAS_Info_1_MACDlc_, MSG_EPAS_SAS_Info_1_MAC.Dlc);
	putvalue(EnvADAS_SteeringCtrl_DataDlc_, MSG_ADAS_SteeringCtrl_Data.Dlc);
	putvalue(EnvMACKVERI4Dlc_, MSG_MACKVERI4.Dlc);
	putvalue(EnvABS_Diag_RxDlc_, MSG_ABS_Diag_Rx.Dlc);
	putvalue(EnvWheelData2Dlc_, MSG_WheelData2.Dlc);
	putvalue(Envcrashoutput_brk_MACDlc_, MSG_crashoutput_brk_MAC.Dlc);
//	putvalue(EnvDirectYawMomentControlRequestDlc_, MSG_DirectYawMomentControlRequest.Dlc);
	putvalue(EnvAEB_Longitudinal_Request_Pt_MACDlc_, MSG_AEB_Longitudinal_Request_Pt_MAC.Dlc);
	putvalue(EnvBrakeSysFeatures_MACDlc_, MSG_BrakeSysFeatures_MAC.Dlc);
	putvalue(EnvCBCM_Autosar_NMDlc_, MSG_CBCM_Autosar_NM.Dlc);
	putvalue(EnvWheelData_1_MACDlc_, MSG_WheelData_1_MAC.Dlc);
	putvalue(EnvGCC_Config_MgmtDlc_, MSG_GCC_Config_Mgmt.Dlc);
	putvalue(EnvMACKSEND8Dlc_, MSG_MACKSEND8.Dlc);
	putvalue(EnvFunctional_Diag_RequestDlc_, MSG_Functional_Diag_Request.Dlc);
	putvalue(EnvEngine_ConfDlc_, MSG_Engine_Conf.Dlc);
	putvalue(EnvTransGearDataDlc_, MSG_TransGearData.Dlc);
	putvalue(EnvMACKSEND2Dlc_, MSG_MACKSEND2.Dlc);
	putvalue(EnvADAS_HMI_Information4Dlc_, MSG_ADAS_HMI_Information4.Dlc);
	putvalue(EnvEngVehicleSpThrottleDlc_, MSG_EngVehicleSpThrottle.Dlc);
	putvalue(EnvRBCM_Information2Dlc_, MSG_RBCM_Information2.Dlc);
	putvalue(EnvRCMSerialNumberDlc_, MSG_RCMSerialNumber.Dlc);
	putvalue(EnvTPMS_ControlDlc_, MSG_TPMS_Control.Dlc);
	putvalue(EnvCBCM_IllumStatusDlc_, MSG_CBCM_IllumStatus.Dlc);
	putvalue(EnvEPAS_CCP_RxDlc_, MSG_EPAS_CCP_Rx.Dlc);
	putvalue(EnvMACKSEND4Dlc_, MSG_MACKSEND4.Dlc);
	putvalue(EnvDCM_MessageDlc_, MSG_DCM_Message.Dlc);
	putvalue(EnvEPAS_Diag_TxDlc_, MSG_EPAS_Diag_Tx.Dlc);
	putvalue(EnvABS_Diag_TxDlc_, MSG_ABS_Diag_Tx.Dlc);
	putvalue(Envcrashoutput_MACDlc_, MSG_crashoutput_MAC.Dlc);
	putvalue(EnvMACKID_MACKUSAGEDlc_, MSG_MACKID_MACKUSAGE.Dlc);
	putvalue(EnvRCM_Long_Acc_MACDlc_, MSG_RCM_Long_Acc_MAC.Dlc);
	putvalue(EnvYAW_Rate_Brake_Control_1_2_MACDlc_, MSG_YAW_Rate_Brake_Control_1_2_MAC.Dlc);
//	putvalue(EnvFSC_AEBReq_InfoDlc_, MSG_FSC_AEBReq_Info.Dlc);
	putvalue(EnvRCM_Yaw_Rate_MACDlc_, MSG_RCM_Yaw_Rate_MAC.Dlc);
	putvalue(EnvABS_Autosar_NMDlc_, MSG_ABS_Autosar_NM.Dlc);
	putvalue(EnvSteering_Column_SwitchDlc_, MSG_Steering_Column_Switch.Dlc);
	putvalue(EnvBCM_Information1Dlc_, MSG_BCM_Information1.Dlc);
	putvalue(EnvEPAS_Bus_StatusDlc_, MSG_EPAS_Bus_Status.Dlc);
	putvalue(EnvMACKVERI3Dlc_, MSG_MACKVERI3.Dlc);
	putvalue(EnvADAS_HMI_Information12Dlc_, MSG_ADAS_HMI_Information12.Dlc);
	putvalue(EnvBrakeSysFeaturesDlc_, MSG_BrakeSysFeatures.Dlc);
	putvalue(EnvCruise_Multi_Switch_2_MACDlc_, MSG_Cruise_Multi_Switch_2_MAC.Dlc);
	putvalue(EnvSISS_RqstDlc_, MSG_SISS_Rqst.Dlc);
	putvalue(EnvVDT_RCM_EDRDlc_, MSG_VDT_RCM_EDR.Dlc);
	putvalue(EnvMACKSEND5Dlc_, MSG_MACKSEND5.Dlc);
	putvalue(EnvADAS_HMI_Information5Dlc_, MSG_ADAS_HMI_Information5.Dlc);
	putvalue(EnvRCM_ISO_SCRAP_RxDlc_, MSG_RCM_ISO_SCRAP_Rx.Dlc);
	putvalue(EnvADAS_Longitudinal_Req_Brk_MACDlc_, MSG_ADAS_Longitudinal_Req_Brk_MAC.Dlc);
	putvalue(EnvSmartKeylessRequestDlc_, MSG_SmartKeylessRequest.Dlc);
	putvalue(EnvEPAS_Diag_RxDlc_, MSG_EPAS_Diag_Rx.Dlc);
	putvalue(EnvSteering_Wheel_AngleDlc_, MSG_Steering_Wheel_Angle.Dlc);
	putvalue(EnvVCM_Customize_Status_01Dlc_, MSG_VCM_Customize_Status_01.Dlc);
	putvalue(EnvRCMStatusMessage_MACDlc_, MSG_RCMStatusMessage_MAC.Dlc);
	putvalue(EnvRCM_ISO_SCRAP_TxDlc_, MSG_RCM_ISO_SCRAP_Tx.Dlc);
	putvalue(EnvMACKVERI1Dlc_, MSG_MACKVERI1.Dlc);
	putvalue(EnvYAW_Rate_Brake_ControlDlc_, MSG_YAW_Rate_Brake_Control.Dlc);
	putvalue(EnvMACKSEND1Dlc_, MSG_MACKSEND1.Dlc);
	putvalue(EnvCruise_Multi_Switch_1_MACDlc_, MSG_Cruise_Multi_Switch_1_MAC.Dlc);
	putvalue(EnvADAS_HMI_Information1Dlc_, MSG_ADAS_HMI_Information1.Dlc);
	putvalue(EnvBCM_Information1_MACDlc_, MSG_BCM_Information1_MAC.Dlc);
	putvalue(EnvEPAS_CCP_TxDlc_, MSG_EPAS_CCP_Tx.Dlc);
	putvalue(EnvMACKSEND7Dlc_, MSG_MACKSEND7.Dlc);
	putvalue(EnvPush_Start_StatusDlc_, MSG_Push_Start_Status.Dlc);
	putvalue(EnvCGW_SyncDlc_, MSG_CGW_Sync.Dlc);
	putvalue(EnvEPAS_Info_MACDlc_, MSG_EPAS_Info_MAC.Dlc);
//	putvalue(EnvADAS_AP_Collision_Data1Dlc_, MSG_ADAS_AP_Collision_Data1.Dlc);
	putvalue(EnvADAS_SteeringCtrlReq_DataDlc_, MSG_ADAS_SteeringCtrlReq_Data.Dlc);
	putvalue(EnvRCMStatusMessage_2_MACDlc_, MSG_RCMStatusMessage_2_MAC.Dlc);
	putvalue(EnvYAW_Rate_Brake_Control_1_1_MACDlc_, MSG_YAW_Rate_Brake_Control_1_1_MAC.Dlc);
	putvalue(EnvWheelData_2_MACDlc_, MSG_WheelData_2_MAC.Dlc);
	putvalue(EnvHvac_Control_Information2Dlc_, MSG_Hvac_Control_Information2.Dlc);
	putvalue(EnvWheelSpeedDlc_, MSG_WheelSpeed.Dlc);

	settimer(T_MSG_ENG1D70, getvalue(EnvENG1D70Time_));
	settimer(T_MSG_ABG1S01, getvalue(EnvABG1S01Time_));
	settimer(T_MSG_ENG1S60, getvalue(EnvENG1S60Time_));
	settimer(T_MSG_EPB_info_1_MAC, getvalue(EnvEPB_info_1_MACTime_));
	settimer(T_MSG_FSC_AEBHmi_Info, getvalue(EnvFSC_AEBHmi_InfoTime_));
	settimer(T_MSG_FSC_AEBReq_Info_MAC, getvalue(EnvFSC_AEBReq_Info_MACTime_));
//	settimer(T_MSG_ADAS_AP_Collision_Data2, getvalue(EnvADAS_AP_Collision_Data2Time_));
	settimer(T_MSG_SAS_G_Info2, getvalue(EnvSAS_G_Info2Time_));
	settimer(T_MSG_RCM_Diag_Rx, getvalue(EnvRCM_Diag_RxTime_));
	settimer(T_MSG_IP_Switch_Information, getvalue(EnvIP_Switch_InformationTime_));
	settimer(T_MSG_AEB_Longitudinal_Req_Brk_MAC, getvalue(EnvAEB_Longitudinal_Req_Brk_MACTime_));
	settimer(T_MSG_YAW_Rate_Brake_Control_2_2_MAC, getvalue(EnvYAW_Rate_Brake_Control_2_2_MACTime_));
	settimer(T_MSG_EPAS_SAS_Info_2_MAC, getvalue(EnvEPAS_SAS_Info_2_MACTime_));
	settimer(T_MSG_MACKSEND6, getvalue(EnvMACKSEND6Time_));
	settimer(T_MSG_LocateTime_Info, getvalue(EnvLocateTime_InfoTime_));
	settimer(T_MSG_RCM_Bus_Status, getvalue(EnvRCM_Bus_StatusTime_));
	settimer(T_MSG_EngControlData, getvalue(EnvEngControlDataTime_));
	settimer(T_MSG_DesiredTorqBrk_MAC, getvalue(EnvDesiredTorqBrk_MACTime_));
	settimer(T_MSG_CBCM_DriveSelection_Info, getvalue(EnvCBCM_DriveSelection_InfoTime_));
	settimer(T_MSG_RCM_Late_Acc_MAC, getvalue(EnvRCM_Late_Acc_MACTime_));
	settimer(T_MSG_MACKVERI2, getvalue(EnvMACKVERI2Time_));
	settimer(T_MSG_VDT_Trigger_Control2, getvalue(EnvVDT_Trigger_Control2Time_));
	settimer(T_MSG_RCM_Diag_Tx, getvalue(EnvRCM_Diag_TxTime_));
	settimer(T_MSG_Door_D_Message, getvalue(EnvDoor_D_MessageTime_));
	settimer(T_MSG_SAS_G_Info1, getvalue(EnvSAS_G_Info1Time_));
	settimer(T_MSG_ECM_Status, getvalue(EnvECM_StatusTime_));
	settimer(T_MSG_ADAS_HMI_Information2, getvalue(EnvADAS_HMI_Information2Time_));
	settimer(T_MSG_Hvac_Control_Information2_MAC, getvalue(EnvHvac_Control_Information2_MACTime_));
	settimer(T_MSG_Longitudinal_Lateral_deltaV, getvalue(EnvLongitudinal_Lateral_deltaVTime_));
	settimer(T_MSG_YAW_Rate_Brake_Control_2_1_MAC, getvalue(EnvYAW_Rate_Brake_Control_2_1_MACTime_));
	settimer(T_MSG_MACKSEND3, getvalue(EnvMACKSEND3Time_));
	settimer(T_MSG_EPAS_SAS_Info_1_MAC, getvalue(EnvEPAS_SAS_Info_1_MACTime_));
	settimer(T_MSG_ADAS_SteeringCtrl_Data, getvalue(EnvADAS_SteeringCtrl_DataTime_));
	settimer(T_MSG_MACKVERI4, getvalue(EnvMACKVERI4Time_));
	settimer(T_MSG_ABS_Diag_Rx, getvalue(EnvABS_Diag_RxTime_));
	settimer(T_MSG_WheelData2, getvalue(EnvWheelData2Time_));
	settimer(T_MSG_crashoutput_brk_MAC, getvalue(Envcrashoutput_brk_MACTime_));
//	settimer(T_MSG_DirectYawMomentControlRequest, getvalue(EnvDirectYawMomentControlRequestTime_));
	settimer(T_MSG_AEB_Longitudinal_Request_Pt_MAC, getvalue(EnvAEB_Longitudinal_Request_Pt_MACTime_));
	settimer(T_MSG_BrakeSysFeatures_MAC, getvalue(EnvBrakeSysFeatures_MACTime_));
	settimer(T_MSG_CBCM_Autosar_NM, getvalue(EnvCBCM_Autosar_NMTime_));
	settimer(T_MSG_WheelData_1_MAC, getvalue(EnvWheelData_1_MACTime_));
	settimer(T_MSG_GCC_Config_Mgmt, getvalue(EnvGCC_Config_MgmtTime_));
	settimer(T_MSG_MACKSEND8, getvalue(EnvMACKSEND8Time_));
	settimer(T_MSG_Functional_Diag_Request, getvalue(EnvFunctional_Diag_RequestTime_));
	settimer(T_MSG_Engine_Conf, getvalue(EnvEngine_ConfTime_));
	settimer(T_MSG_TransGearData, getvalue(EnvTransGearDataTime_));
	settimer(T_MSG_MACKSEND2, getvalue(EnvMACKSEND2Time_));
	settimer(T_MSG_ADAS_HMI_Information4, getvalue(EnvADAS_HMI_Information4Time_));
	settimer(T_MSG_EngVehicleSpThrottle, getvalue(EnvEngVehicleSpThrottleTime_));
	settimer(T_MSG_RBCM_Information2, getvalue(EnvRBCM_Information2Time_));
	settimer(T_MSG_RCMSerialNumber, getvalue(EnvRCMSerialNumberTime_));
	settimer(T_MSG_TPMS_Control, getvalue(EnvTPMS_ControlTime_));
	settimer(T_MSG_CBCM_IllumStatus, getvalue(EnvCBCM_IllumStatusTime_));
	settimer(T_MSG_EPAS_CCP_Rx, getvalue(EnvEPAS_CCP_RxTime_));
	settimer(T_MSG_MACKSEND4, getvalue(EnvMACKSEND4Time_));
	settimer(T_MSG_DCM_Message, getvalue(EnvDCM_MessageTime_));
	settimer(T_MSG_EPAS_Diag_Tx, getvalue(EnvEPAS_Diag_TxTime_));
	settimer(T_MSG_ABS_Diag_Tx, getvalue(EnvABS_Diag_TxTime_));
	settimer(T_MSG_crashoutput_MAC, getvalue(Envcrashoutput_MACTime_));
	settimer(T_MSG_MACKID_MACKUSAGE, getvalue(EnvMACKID_MACKUSAGETime_));
	settimer(T_MSG_RCM_Long_Acc_MAC, getvalue(EnvRCM_Long_Acc_MACTime_));
	settimer(T_MSG_YAW_Rate_Brake_Control_1_2_MAC, getvalue(EnvYAW_Rate_Brake_Control_1_2_MACTime_));
//	settimer(T_MSG_FSC_AEBReq_Info, getvalue(EnvFSC_AEBReq_InfoTime_));
	settimer(T_MSG_RCM_Yaw_Rate_MAC, getvalue(EnvRCM_Yaw_Rate_MACTime_));
	settimer(T_MSG_ABS_Autosar_NM, getvalue(EnvABS_Autosar_NMTime_));
	settimer(T_MSG_Steering_Column_Switch, getvalue(EnvSteering_Column_SwitchTime_));
	settimer(T_MSG_BCM_Information1, getvalue(EnvBCM_Information1Time_));
	settimer(T_MSG_EPAS_Bus_Status, getvalue(EnvEPAS_Bus_StatusTime_));
	settimer(T_MSG_MACKVERI3, getvalue(EnvMACKVERI3Time_));
	settimer(T_MSG_ADAS_HMI_Information12, getvalue(EnvADAS_HMI_Information12Time_));
	settimer(T_MSG_BrakeSysFeatures, getvalue(EnvBrakeSysFeaturesTime_));
	settimer(T_MSG_Cruise_Multi_Switch_2_MAC, getvalue(EnvCruise_Multi_Switch_2_MACTime_));
	settimer(T_MSG_SISS_Rqst, getvalue(EnvSISS_RqstTime_));
	settimer(T_MSG_VDT_RCM_EDR, getvalue(EnvVDT_RCM_EDRTime_));
	settimer(T_MSG_MACKSEND5, getvalue(EnvMACKSEND5Time_));
	settimer(T_MSG_ADAS_HMI_Information5, getvalue(EnvADAS_HMI_Information5Time_));
	settimer(T_MSG_RCM_ISO_SCRAP_Rx, getvalue(EnvRCM_ISO_SCRAP_RxTime_));
	settimer(T_MSG_ADAS_Longitudinal_Req_Brk_MAC, getvalue(EnvADAS_Longitudinal_Req_Brk_MACTime_));
	settimer(T_MSG_SmartKeylessRequest, getvalue(EnvSmartKeylessRequestTime_));
	settimer(T_MSG_EPAS_Diag_Rx, getvalue(EnvEPAS_Diag_RxTime_));
	settimer(T_MSG_Steering_Wheel_Angle, getvalue(EnvSteering_Wheel_AngleTime_));
	settimer(T_MSG_VCM_Customize_Status_01, getvalue(EnvVCM_Customize_Status_01Time_));
	settimer(T_MSG_RCMStatusMessage_MAC, getvalue(EnvRCMStatusMessage_MACTime_));
	settimer(T_MSG_RCM_ISO_SCRAP_Tx, getvalue(EnvRCM_ISO_SCRAP_TxTime_));
	settimer(T_MSG_MACKVERI1, getvalue(EnvMACKVERI1Time_));
	settimer(T_MSG_YAW_Rate_Brake_Control, getvalue(EnvYAW_Rate_Brake_ControlTime_));
	settimer(T_MSG_MACKSEND1, getvalue(EnvMACKSEND1Time_));
	settimer(T_MSG_Cruise_Multi_Switch_1_MAC, getvalue(EnvCruise_Multi_Switch_1_MACTime_));
	settimer(T_MSG_ADAS_HMI_Information1, getvalue(EnvADAS_HMI_Information1Time_));
	settimer(T_MSG_BCM_Information1_MAC, getvalue(EnvBCM_Information1_MACTime_));
	settimer(T_MSG_EPAS_CCP_Tx, getvalue(EnvEPAS_CCP_TxTime_));
	settimer(T_MSG_MACKSEND7, getvalue(EnvMACKSEND7Time_));
	settimer(T_MSG_Push_Start_Status, getvalue(EnvPush_Start_StatusTime_));
	settimer(T_MSG_CGW_Sync, getvalue(EnvCGW_SyncTime_));
	settimer(T_MSG_EPAS_Info_MAC, getvalue(EnvEPAS_Info_MACTime_));
//	settimer(T_MSG_ADAS_AP_Collision_Data1, getvalue(EnvADAS_AP_Collision_Data1Time_));
	settimer(T_MSG_ADAS_SteeringCtrlReq_Data, getvalue(EnvADAS_SteeringCtrlReq_DataTime_));
	settimer(T_MSG_RCMStatusMessage_2_MAC, getvalue(EnvRCMStatusMessage_2_MACTime_));
	settimer(T_MSG_YAW_Rate_Brake_Control_1_1_MAC, getvalue(EnvYAW_Rate_Brake_Control_1_1_MACTime_));
	settimer(T_MSG_WheelData_2_MAC, getvalue(EnvWheelData_2_MACTime_));
	settimer(T_MSG_Hvac_Control_Information2, getvalue(EnvHvac_Control_Information2Time_));
	settimer(T_MSG_WheelSpeed, getvalue(EnvWheelSpeedTime_));

  // Customer project modify
  putValue(EnvBCM_Information1_MACTo_, 1);
  putValue(EnvCruise_Multi_Switch_1_MACTo_,1);
  putValue(EnvCruise_Multi_Switch_2_MACTo_, 0);
  putValue(EnvWheelData_2_MACTo_, 1);
  putValue(EnvHvac_Control_Information2_MACTo_, 1);  
  putValue(EnvBrkOnOffSwtch_D_Actl_2_, 1);
  putValue(EnvVehVActlBrk_D_Qf_,3);
  putValue(EnvShiftPos_D_Trg_,11);
  
  glbHandle = OpenFileRead("TripCounter.txt", 0);
  if(glbHandle != 0) {
    while ( fileGetString(buffer,elcount(buffer),glbHandle)!=0 ) {};
    glbValue = atol (buffer);
    putValue(EnvCGW_Sync_TripCnt_, glbValue + 1);
    fileClose(glbValue);
	}
   //putValue(EnvEngVehicleSpThrottleTo_,0);
   //putValue(EnvDirectYawMomentControlRequestTo_,0);
   //putValue(EnvADAS_HMI_Information4To_,0);
}
//on timer T_MSG_ADAS_AP_Collision_Data2 
//{
//	MSG_ADAS_AP_Collision_Data2.ADAS_Fu_Crash_Pos_Y = getvalue ( EnvADAS_Fu_Crash_Pos_Y_);
//	MSG_ADAS_AP_Collision_Data2.ADAS_Fu_Relative_Pos_Y = getvalue ( EnvADAS_Fu_Relative_Pos_Y_);
//	MSG_ADAS_AP_Collision_Data2.ADAS_Fu_Relative_Pos_X = getvalue ( EnvADAS_Fu_Relative_Pos_X_);
//	MSG_ADAS_AP_Collision_Data2.ADAS_Fu_Relative_Vel_Y = getvalue ( EnvADAS_Fu_Relative_Vel_Y_);
//
//	/*  Output  */
//	
//	MSG_ADAS_AP_Collision_Data2.Dlc = getvalue ( EnvADAS_AP_Collision_Data2Dlc_);
//	 
//	if(getvalue(EnvADAS_AP_Collision_Data2To_))
//	{
//		output(MSG_ADAS_AP_Collision_Data2);
//	}
//	else
//	{
//		Write("ADAS_AP_Collision_Data2 Message is not sent ");
//	}
//	 
//	settimer(T_MSG_ADAS_AP_Collision_Data2,  getvalue(EnvADAS_AP_Collision_Data2Time_));
//	 
//
//}
//on timer T_MSG_SAS_G_Info2 
//{
//	MSG_SAS_G_Info2.SAS_dVy_AACN = getvalue ( EnvSAS_dVy_AACN_);
//	MSG_SAS_G_Info2.SAS_dVx_AACN = getvalue ( EnvSAS_dVx_AACN_);
//	MSG_SAS_G_Info2.SAS_dVx_Event = getvalue ( EnvSAS_dVx_Event_);
//	MSG_SAS_G_Info2.SAS_dVy_Periodic = getvalue ( EnvSAS_dVy_Periodic_);
//	MSG_SAS_G_Info2.SAS_dVx_Periodic = getvalue ( EnvSAS_dVx_Periodic_);
//
//	/*  Output  */
//	
//	MSG_SAS_G_Info2.Dlc = getvalue ( EnvSAS_G_Info2Dlc_);
//	 
//	if(getvalue(EnvSAS_G_Info2To_))
//	{
//		output(MSG_SAS_G_Info2);
//	}
//	else
//	{
//		Write("SAS_G_Info2 Message is not sent ");
//	}
//	 
//	settimer(T_MSG_SAS_G_Info2,  getvalue(EnvSAS_G_Info2Time_));
//	 
//
//}
//on timer T_MSG_RCM_Diag_Rx 
/* ************
  This event need to be commented out for DSM
************ */
//{
//	MSG_RCM_Diag_Rx.RCM_Diag_Sig_Rx = getvalue ( EnvRCM_Diag_Sig_Rx_);
//
//	/*  Output  */
//	
//	MSG_RCM_Diag_Rx.Dlc = getvalue ( EnvRCM_Diag_RxDlc_);
//	 
//	if(getvalue(EnvRCM_Diag_RxTo_))
//	{
//		output(MSG_RCM_Diag_Rx);
//	}
//	else
//	{
//		Write("RCM_Diag_Rx Message is not sent ");
//	}
//	 
//	settimer(T_MSG_RCM_Diag_Rx,  getvalue(EnvRCM_Diag_RxTime_));
//	 
//
//}
on timer T_MSG_ENG1D70 
{
	MSG_ENG1D70.EDRENG04 = getvalue ( EnvEDRENG04_);
	MSG_ENG1D70.EDRENG03 = getvalue ( EnvEDRENG03_);
	MSG_ENG1D70.EDRENG02 = getvalue ( EnvEDRENG02_);
	MSG_ENG1D70.EDRENG01 = getvalue ( EnvEDRENG01_);

	/*  Output  */
	
	MSG_ENG1D70.Dlc = getvalue ( EnvENG1D70Dlc_);
	 
	if(getvalue(EnvENG1D70To_))
	{
		output(MSG_ENG1D70);
	}
	else
	{
		Write("ENG1D70 Message is not sent ");
	}
	 
	settimer(T_MSG_ENG1D70,  getvalue(EnvENG1D70Time_));
	 

}
//on timer T_MSG_ABG1S01 
//{
//	MSG_ABG1S01.SM3B1 = getvalue ( EnvSM3B1_);
//	MSG_ABG1S01.CDT_HV = getvalue ( EnvCDT_HV_);
//	MSG_ABG1S01.CDT = getvalue ( EnvCDT_);
//
//	/*  Output  */
//	
//	MSG_ABG1S01.Dlc = getvalue ( EnvABG1S01Dlc_);
//	 
//	if(getvalue(EnvABG1S01To_))
//	{
//		output(MSG_ABG1S01);
//	}
//	else
//	{
//		Write("ABG1S01 Message is not sent ");
//	}
//	 
//	settimer(T_MSG_ABG1S01,  getvalue(EnvABG1S01Time_));
//	 
//
//}

//on timer T_MSG_ENG1S60 
//{
//	MSG_ENG1S60.SFTWNG = getvalue ( EnvSFTWNG_);
//	MSG_ENG1S60.CDTHVANS = getvalue ( EnvCDTHVANS_);
//
//	/*  Output  */
//	
//	MSG_ENG1S60.Dlc = getvalue ( EnvENG1S60Dlc_);
//	 
//	if(getvalue(EnvENG1S60To_))
//	{
//		output(MSG_ENG1S60);
//	}
//	else
//	{
//		Write("ENG1S60 Message is not sent ");
//	}
//	 
//	settimer(T_MSG_ENG1S60,  getvalue(EnvENG1S60Time_));
//	 
//
//}
on timer T_MSG_EPB_info_1_MAC 
{
	MSG_EPB_info_1_MAC.EPB_info_1_MACTx = getvalue ( EnvEPB_info_1_MACTx_);
	MSG_EPB_info_1_MAC.EPB_info_1_FVTx = getvalue ( EnvEPB_info_1_FVTx_);
	MSG_EPB_info_1_MAC.ID_203_No_Cs = getvalue ( EnvID_203_No_Cs_);
	MSG_EPB_info_1_MAC.ID_203_No_Cnt = getvalue ( EnvID_203_No_Cnt_);
	MSG_EPB_info_1_MAC.EPB_DisplayRequest5_RCM = getvalue ( EnvEPB_DisplayRequest5_RCM_);
	MSG_EPB_info_1_MAC.EPB_DisplayRequest4_RCM = getvalue ( EnvEPB_DisplayRequest4_RCM_);
	MSG_EPB_info_1_MAC.EPB_DisplayRequest3_RCM = getvalue ( EnvEPB_DisplayRequest3_RCM_);
	MSG_EPB_info_1_MAC.EPB_Status_sa = getvalue ( EnvEPB_Status_sa_);
	MSG_EPB_info_1_MAC.EPB_SwitchPosition_sa = getvalue ( EnvEPB_SwitchPosition_sa_);
	MSG_EPB_info_1_MAC.EPB_EnableExternalApply_DSC = getvalue ( EnvEPB_EnableExternalApply_DSC_);
	MSG_EPB_info_1_MAC.EPB_EnableDecelRequest_sa = getvalue ( EnvEPB_EnableDecelRequest_sa_);
	MSG_EPB_info_1_MAC.EPB_DecelRequest = getvalue ( EnvEPB_DecelRequest_);

	/*  Output  */
	
	MSG_EPB_info_1_MAC.Dlc = getvalue ( EnvEPB_info_1_MACDlc_);
	 
	if(getvalue(EnvEPB_info_1_MACTo_))
	{
		output(MSG_EPB_info_1_MAC);
	}
	else
	{
		Write("EPB_info_1_MAC Message is not sent ");
	}
	 
	settimer(T_MSG_EPB_info_1_MAC,  getvalue(EnvEPB_info_1_MACTime_));
	 

}
on timer T_MSG_FSC_AEBHmi_Info 
{
	MSG_FSC_AEBHmi_Info.FSC_AEBHmi_Info_No_Cs = getvalue ( EnvFSC_AEBHmi_Info_No_Cs_);
	MSG_FSC_AEBHmi_Info.FSC_AEBHmi_Info_No_Cnt = getvalue ( EnvFSC_AEBHmi_Info_No_Cnt_);
	MSG_FSC_AEBHmi_Info.AEB_VRU_state = getvalue ( EnvAEB_VRU_state_);

	/*  Output  */
	
	MSG_FSC_AEBHmi_Info.Dlc = getvalue ( EnvFSC_AEBHmi_InfoDlc_);
	 
	if(getvalue(EnvFSC_AEBHmi_InfoTo_))
	{
		output(MSG_FSC_AEBHmi_Info);
	}
	else
	{
		Write("FSC_AEBHmi_Info Message is not sent ");
	}
	 
	settimer(T_MSG_FSC_AEBHmi_Info,  getvalue(EnvFSC_AEBHmi_InfoTime_));
	 

}
on timer T_MSG_FSC_AEBReq_Info_MAC 
{
	MSG_FSC_AEBReq_Info_MAC.FSC_AEBReq_Info_MACTx = getvalue ( EnvFSC_AEBReq_Info_MACTx_);
	MSG_FSC_AEBReq_Info_MAC.FSC_AEBReq_Info_FVTx = getvalue ( EnvFSC_AEBReq_Info_FVTx_);
	MSG_FSC_AEBReq_Info_MAC.FSC_AEB_Fail = getvalue ( EnvFSC_AEB_Fail_);
	MSG_FSC_AEBReq_Info_MAC.Req_AEB_VRU_Set_Flag = getvalue ( EnvReq_AEB_VRU_Set_Flag_);
	MSG_FSC_AEBReq_Info_MAC.Req_AEB_VRU_Acceleration = getvalue ( EnvReq_AEB_VRU_Acceleration_);
	MSG_FSC_AEBReq_Info_MAC.AEB_VRU_Prefill_Level = getvalue ( EnvAEB_VRU_Prefill_Level_);
	MSG_FSC_AEBReq_Info_MAC.ID080_E2E_CNTProfile2 = getvalue ( EnvID080_E2E_CNTProfile2_);
	MSG_FSC_AEBReq_Info_MAC.Req_AEB_VRU_Brake_Inhibit = getvalue ( EnvReq_AEB_VRU_Brake_Inhibit_);
	MSG_FSC_AEBReq_Info_MAC.ID080_E2E_CRCProfile2 = getvalue ( EnvID080_E2E_CRCProfile2_);

	/*  Output  */
	
	MSG_FSC_AEBReq_Info_MAC.Dlc = getvalue ( EnvFSC_AEBReq_Info_MACDlc_);
	 
	if(getvalue(EnvFSC_AEBReq_Info_MACTo_))
	{
		output(MSG_FSC_AEBReq_Info_MAC);
	}
	else
	{
		Write("FSC_AEBReq_Info_MAC Message is not sent ");
	}
	 
	settimer(T_MSG_FSC_AEBReq_Info_MAC,  getvalue(EnvFSC_AEBReq_Info_MACTime_));
	 

}
on timer T_MSG_IP_Switch_Information 
{
	MSG_IP_Switch_Information.HazardSw_D_Actl = getvalue ( EnvHazardSw_D_Actl_);
	MSG_IP_Switch_Information.RearDef_B_Rq = getvalue ( EnvRearDef_B_Rq_);
	MSG_IP_Switch_Information.FrontDef_B_Rq = getvalue ( EnvFrontDef_B_Rq_);
	MSG_IP_Switch_Information.PanelHeaterSwitchIn_RH = getvalue ( EnvPanelHeaterSwitchIn_RH_);
	MSG_IP_Switch_Information.PanelHeaterSwitchIn_LH = getvalue ( EnvPanelHeaterSwitchIn_LH_);
	MSG_IP_Switch_Information.SteeringHeaterSwitchIn = getvalue ( EnvSteeringHeaterSwitchIn_);
	MSG_IP_Switch_Information.SeatVentilationSwitchIn_RH = getvalue ( EnvSeatVentilationSwitchIn_RH_);
	MSG_IP_Switch_Information.SeatHeaterSwitchIn_RH = getvalue ( EnvSeatHeaterSwitchIn_RH_);
	MSG_IP_Switch_Information.SeatVentilationSwitchIn_LH = getvalue ( EnvSeatVentilationSwitchIn_LH_);
	MSG_IP_Switch_Information.SeatHeaterSwitchIn_LH = getvalue ( EnvSeatHeaterSwitchIn_LH_);
	MSG_IP_Switch_Information.ipREARmode = getvalue ( EnvipREARmode_);
	MSG_IP_Switch_Information.ipECOmode = getvalue ( EnvipECOmode_);
	MSG_IP_Switch_Information.ipAImode = getvalue ( EnvipAImode_);
	MSG_IP_Switch_Information.ipADmode = getvalue ( EnvipADmode_);
	MSG_IP_Switch_Information.ipACmode = getvalue ( EnvipACmode_);
	MSG_IP_Switch_Information.ipBlwLvl = getvalue ( EnvipBlwLvl_);
	MSG_IP_Switch_Information.ipTSetPs = getvalue ( EnvipTSetPs_);
	MSG_IP_Switch_Information.ipTSetDr = getvalue ( EnvipTSetDr_);

	/*  Output  */
	MSG_IP_Switch_Information.Dlc = getvalue ( EnvIP_Switch_InformationDlc_);
	if(getvalue(EnvIP_Switch_InformationTo_))
	{
		output(MSG_IP_Switch_Information);
	}
	else
	{
		// Write("IP_Switch_Information Message is not sent ");
	}
	 
	settimer(T_MSG_IP_Switch_Information,  getvalue(EnvIP_Switch_InformationTime_));
	 

}
on timer T_MSG_AEB_Longitudinal_Req_Brk_MAC 
{
//  byte payloadLength = 4;
//  qword truncatedAuthenticator;
//  dword truncatedAuthenticatorBitLength = 28;
//  qword freshness;
//  dword truncatedFreshnessBitLength = 4;
//  dword freshnessValueBitLength = 48;
//  long result;
	MSG_AEB_Longitudinal_Req_Brk_MAC.AEB_Longitudinal_Req_Brk_MACTx = getvalue ( EnvAEB_Longitudinal_Req_Brk_MACTx_);
	MSG_AEB_Longitudinal_Req_Brk_MAC.AEB_Longitudinal_Req_Brk_FVTx = getvalue ( EnvAEB_Longitudinal_Req_Brk_FVTx_);
	MSG_AEB_Longitudinal_Req_Brk_MAC.AEB_Fail_Flag_Brk = getvalue ( EnvAEB_Fail_Flag_Brk_);
	MSG_AEB_Longitudinal_Req_Brk_MAC.AEB_Warning_Jerk_Flag = getvalue ( EnvAEB_Warning_Jerk_Flag_);
	MSG_AEB_Longitudinal_Req_Brk_MAC.AEB_Prefill_Level = getvalue ( EnvAEB_Prefill_Level_);
	MSG_AEB_Longitudinal_Req_Brk_MAC.AEB_BA_Level = getvalue ( EnvAEB_BA_Level_);
	MSG_AEB_Longitudinal_Req_Brk_MAC.Request_AEB_B_Deceleration = getvalue ( EnvRequest_AEB_B_Deceleration_);
	MSG_AEB_Longitudinal_Req_Brk_MAC.ID212_E2E_CNTProfile2 = getvalue ( EnvID212_E2E_CNTProfile2_);
	MSG_AEB_Longitudinal_Req_Brk_MAC.Request_AEB_B_Flag = getvalue ( EnvRequest_AEB_B_Flag_);
	MSG_AEB_Longitudinal_Req_Brk_MAC.AEB_Types_brk = getvalue ( EnvAEB_Types_brk_);
	MSG_AEB_Longitudinal_Req_Brk_MAC.ID212_E2E_CRCProfile2 = getvalue ( EnvID212_E2E_CRCProfile2_);

	/*  Output  */
	
	MSG_AEB_Longitudinal_Req_Brk_MAC.Dlc = getvalue ( EnvAEB_Longitudinal_Req_Brk_MACDlc_);
	 
	if(getvalue(EnvAEB_Longitudinal_Req_Brk_MACTo_))
	{
//    if((tripCnt_AEBLongReqBrk != g_TripCnt) | (resetCnt_AEBLongReqBrk != g_ResetCnt)) {
//      tripCnt_AEBLongReqBrk = g_TripCnt;
//      resetCnt_AEBLongReqBrk = g_ResetCnt;
//      if(resetCnt_AEBLongReqBrk < 0xFFFFF) {
//        msgCnt_AEBLongReqBrk = 1;
//      }
//      else {
//        msgCnt_AEBLongReqBrk = 0xFF;
//      }
//    }
//    else{
//      if(msgCnt_AEBLongReqBrk < 0xFF) {
//        msgCnt_AEBLongReqBrk += 1;
//      }
//      else {
//        msgCnt_AEBLongReqBrk = 0xFF;
//      }
//   }
//    resetFlag_AEBLongReqBrk = resetCnt_AEBLongReqBrk & 0x03;
//    freshness = ((tripCnt_AEBLongReqBrk << 32) | (resetCnt_AEBLongReqBrk << 12)
//    | (msgCnt_AEBLongReqBrk << 4) | (resetFlag_AEBLongReqBrk << 2));
//    payload_AEBLongReqBrk[0] =  MSG_AEB_Longitudinal_Req_Brk_MAC.byte(0);
//    payload_AEBLongReqBrk[1] =  MSG_AEB_Longitudinal_Req_Brk_MAC.byte(1);
//    payload_AEBLongReqBrk[2] =  MSG_AEB_Longitudinal_Req_Brk_MAC.byte(2);
//    payload_AEBLongReqBrk[3] =  MSG_AEB_Longitudinal_Req_Brk_MAC.byte(3);
//  	result = LocalSecurityCalculateAuthenticator(MSG_AEB_Longitudinal_Req_Brk_MAC.id, payload_AEBLongReqBrk, payloadLength, truncatedAuthenticator, truncatedAuthenticatorBitLength, freshness, truncatedFreshnessBitLength, freshnessValueBitLength);
//    
//    putValue(EnvAEB_Longitudinal_Req_Brk_FVTx_, freshness);
//    putValue(EnvAEB_Longitudinal_Req_Brk_MACTx_, truncatedAuthenticator);
//    MSG_AEB_Longitudinal_Req_Brk_MAC.AEB_Longitudinal_Req_Brk_MACTx = getvalue ( EnvAEB_Longitudinal_Req_Brk_MACTx_);
//  	MSG_AEB_Longitudinal_Req_Brk_MAC.AEB_Longitudinal_Req_Brk_FVTx = getvalue ( EnvAEB_Longitudinal_Req_Brk_FVTx_);
//  
//    if(@EnvFAEB_Longitudinal_Req_Brk_MAC){
//      MSG_AEB_Longitudinal_Req_Brk_MAC.AEB_Longitudinal_Req_Brk_MACTx = getvalue ( EnvAEB_Longitudinal_Req_Brk_MACTx_) / 2;
//    }
		output(MSG_AEB_Longitudinal_Req_Brk_MAC);
  }
	  else
	  {
		 Write("AEB_Longitudinal_Req_Brk_MAC Message is not sent ");
	  }
	 
	settimer(T_MSG_AEB_Longitudinal_Req_Brk_MAC,  getvalue(EnvAEB_Longitudinal_Req_Brk_MACTime_));
	 

}
//on timer T_MSG_YAW_Rate_Brake_Control_2_2_MAC 
//{
//	MSG_YAW_Rate_Brake_Control_2_2_MAC.YAW_Rate_Brake_Control_2_2_MACTx = getvalue ( EnvYAW_Rate_Brake_Control_2_2_MACTx_);
//	MSG_YAW_Rate_Brake_Control_2_2_MAC.YAW_Rate_Brake_Control_2_2_FVTx = getvalue ( EnvYAW_Rate_Brake_Control_2_2_FVTx_);
//	MSG_YAW_Rate_Brake_Control_2_2_MAC.VehSensSig2_2_No_Cs = getvalue ( EnvVehSensSig2_2_No_Cs_);
//	MSG_YAW_Rate_Brake_Control_2_2_MAC.VehSensSig2_2_No_Cnt = getvalue ( EnvVehSensSig2_2_No_Cnt_);
//	MSG_YAW_Rate_Brake_Control_2_2_MAC.VehYawComp_W_Actl_2 = getvalue ( EnvVehYawComp_W_Actl_2_);
//
//	/*  Output  */
//	
//	MSG_YAW_Rate_Brake_Control_2_2_MAC.Dlc = getvalue ( EnvYAW_Rate_Brake_Control_2_2_MACDlc_);
//	 
//	if(getvalue(EnvYAW_Rate_Brake_Control_2_2_MACTo_))
//	{
//		output(MSG_YAW_Rate_Brake_Control_2_2_MAC);
//	}
//	else
//	{
//		Write("YAW_Rate_Brake_Control_2_2_MAC Message is not sent ");
//	}
//	 
//	settimer(T_MSG_YAW_Rate_Brake_Control_2_2_MAC,  getvalue(EnvYAW_Rate_Brake_Control_2_2_MACTime_));
//	 
//
//}
on timer T_MSG_EPAS_SAS_Info_2_MAC 
{
//  byte payloadLength = 4;
//  qword truncatedAuthenticator;
//  dword truncatedAuthenticatorBitLength = 28;
//  qword freshness;
//  dword truncatedFreshnessBitLength = 4;
//  dword freshnessValueBitLength = 48;
//  long result;
	MSG_EPAS_SAS_Info_2_MAC.EPAS_SAS_Info_2_MACTx = getvalue ( EnvEPAS_SAS_Info_2_MACTx_);
	MSG_EPAS_SAS_Info_2_MAC.EPAS_SAS_Info_2_FVTx = getvalue ( EnvEPAS_SAS_Info_2_FVTx_);
	MSG_EPAS_SAS_Info_2_MAC.SteWhlComp_An_Est = getvalue ( EnvSteWhlComp_An_Est_);
	MSG_EPAS_SAS_Info_2_MAC.SasCntComplt_B_Actl = getvalue ( EnvSasCntComplt_B_Actl_);
	MSG_EPAS_SAS_Info_2_MAC.SteAngEstAn_No_Cnt = getvalue ( EnvSteAngEstAn_No_Cnt_);
	MSG_EPAS_SAS_Info_2_MAC.Sas_FailStatus = getvalue ( EnvSas_FailStatus_);
	MSG_EPAS_SAS_Info_2_MAC.SteWhlCompAnEst_D_Qf = getvalue ( EnvSteWhlCompAnEst_D_Qf_);
	MSG_EPAS_SAS_Info_2_MAC.SteAngEstAn_No_Cs = getvalue ( EnvSteAngEstAn_No_Cs_);

	/*  Output  */
	if(data_selection == 0x03)
	{
	if(use_case == 0) // use case 1: Invalid - Unobtain 
	{
		if (Unobtain_pattern != 0)
		{
			if (Invalid_pattern > 0)
			{
				Invalid_pattern--;
				putvalue(EnvEPAS_SAS_Info_2_MACTo_,1);
				MSG_EPAS_SAS_Info_2_MAC.SteWhlCompAnEst_D_Qf = 0;
			}else
			{
				putvalue(EnvEPAS_SAS_Info_2_MACTo_,0);
        Unobtain_pattern--;
			}
		}else
			{
        putvalue(EnvEPAS_SAS_Info_2_MACTo_,1);
				Invalid_pattern = getvalue(Env_24EDR_Invalid_)-1;
				Unobtain_pattern = getvalue(Env_24EDR_Unobtain_);
			}
	}else if (use_case == 1) //use case 2 : invalid - valid
	{
		if(Valid_pattern > 0)
		{
			if(Invalid_pattern > 0)
			{
				Invalid_pattern--;
				MSG_EPAS_SAS_Info_2_MAC.SteWhlCompAnEst_D_Qf = 0;
			}else
			{
				Valid_pattern --;
			}
		}else
		{
      MSG_EPAS_SAS_Info_2_MAC.SteWhlCompAnEst_D_Qf = 0;
			Invalid_pattern = getvalue(Env_24EDR_Invalid_)-1;
			Valid_pattern = getvalue(Env_24EDR_Valid_);
		}
		
	}else if (use_case == 2) //use case 2: unobtain - valid
  {
    if(Valid_pattern > 0)
		{
			if(Unobtain_pattern != 0)
			{
				Unobtain_pattern--;
				putvalue(EnvEPAS_SAS_Info_2_MACTo_,0);
			}else
			{
				Valid_pattern --;
        putvalue(EnvEPAS_SAS_Info_2_MACTo_,1);
			}
		}else
		{
			putvalue(EnvEPAS_SAS_Info_2_MACTo_,0);
			Unobtain_pattern = getvalue(Env_24EDR_Unobtain_)-1;
			Valid_pattern = getvalue(Env_24EDR_Valid_);
		}
  }
	}
	
	MSG_EPAS_SAS_Info_2_MAC.Dlc = getvalue ( EnvEPAS_SAS_Info_2_MACDlc_);
	 
  if(getvalue(EnvEPAS_SAS_Info_2_MACTo_))
	{
//    if((tripCnt_EPASSASInfo2 != g_TripCnt) | (resetCnt_EPASSASInfo2 != g_ResetCnt)) {
//      tripCnt_EPASSASInfo2 = g_TripCnt;
//      resetCnt_EPASSASInfo2 = g_ResetCnt;
//      if(resetCnt_EPASSASInfo2 < 0xFFFFF) {
//        msgCnt_EPASSASInfo2 = 1;
//      }
//      else {
//        msgCnt_EPASSASInfo2 = 0xFF;
//      }
//    }
//    else{
//      if(msgCnt_EPASSASInfo2 < 0xFF) {
//        msgCnt_EPASSASInfo2 += 1;
//      }
//      else {
//        msgCnt_EPASSASInfo2 = 0xFF;
//      }
//    }
//    resetFlag_EPASSASInfo2 = resetCnt_EPASSASInfo2 & 0x03;
//    freshness = ((tripCnt_EPASSASInfo2 << 32) | (resetCnt_EPASSASInfo2 << 12)
//    | (msgCnt_EPASSASInfo2 << 4) | (resetFlag_EPASSASInfo2 << 2));
//    payload_EPASSASInfo2[0] =  MSG_EPAS_SAS_Info_2_MAC.byte(0);
//    payload_EPASSASInfo2[1] =  MSG_EPAS_SAS_Info_2_MAC.byte(1);
//    payload_EPASSASInfo2[2] =  MSG_EPAS_SAS_Info_2_MAC.byte(2);
//    payload_EPASSASInfo2[3] =  MSG_EPAS_SAS_Info_2_MAC.byte(3);
//  	result = LocalSecurityCalculateAuthenticator(MSG_EPAS_SAS_Info_2_MAC.id, payload_EPASSASInfo2, payloadLength, truncatedAuthenticator, truncatedAuthenticatorBitLength, freshness, truncatedFreshnessBitLength, freshnessValueBitLength);
//    
//    putValue(EnvEPAS_SAS_Info_2_FVTx_, freshness);
//    putValue(EnvEPAS_SAS_Info_2_MACTx_, truncatedAuthenticator);
//    MSG_EPAS_SAS_Info_2_MAC.EPAS_SAS_Info_2_MACTx = getvalue ( EnvEPAS_SAS_Info_2_MACTx_);
//  	MSG_EPAS_SAS_Info_2_MAC.EPAS_SAS_Info_2_FVTx = getvalue ( EnvEPAS_SAS_Info_2_FVTx_);
//    
//    if(@EnvFEPAS_SAS_Info_2_MAC){
//      MSG_EPAS_SAS_Info_2_MAC.EPAS_SAS_Info_2_MACTx = getvalue ( EnvEPAS_SAS_Info_2_MACTx_) / 2;
//    }
		output(MSG_EPAS_SAS_Info_2_MAC);
	}
	else
	{
		 Write("EPAS_SAS_Info_2_MAC Message is not sent ");
	}
	 
	settimer(T_MSG_EPAS_SAS_Info_2_MAC,  getvalue(EnvEPAS_SAS_Info_2_MACTime_));
	 

}
//on timer T_MSG_MACKSEND6 
//{
//	MSG_MACKSEND6.MACKSEND6_2 = getvalue ( EnvMACKSEND6_2_);
//	MSG_MACKSEND6.MACKSEND6_1 = getvalue ( EnvMACKSEND6_1_);
//
//	/*  Output  */
//	
//	MSG_MACKSEND6.Dlc = getvalue ( EnvMACKSEND6Dlc_);
//	 
//	if(getvalue(EnvMACKSEND6To_))
//	{
//		output(MSG_MACKSEND6);
//	}
//	else
//	{
//		Write("MACKSEND6 Message is not sent ");
//	}
//	 
//	settimer(T_MSG_MACKSEND6,  getvalue(EnvMACKSEND6Time_));
//	 
//
//}
on timer T_MSG_LocateTime_Info 
{
	MSG_LocateTime_Info.GMT_Second_ByGPS = getvalue ( EnvGMT_Second_ByGPS_);
	MSG_LocateTime_Info.GMT_Minutes_ByGPS = getvalue ( EnvGMT_Minutes_ByGPS_);
	MSG_LocateTime_Info.GMT_Hour_ByGPS = getvalue ( EnvGMT_Hour_ByGPS_);
	MSG_LocateTime_Info.GMT_Date_ByGPS = getvalue ( EnvGMT_Date_ByGPS_);
	MSG_LocateTime_Info.GMT_Month_ByGPS = getvalue ( EnvGMT_Month_ByGPS_);
	MSG_LocateTime_Info.GMT_Year_ByGPS = getvalue ( EnvGMT_Year_ByGPS_);
	MSG_LocateTime_Info.HorizonByGPS = getvalue ( EnvHorizonByGPS_);
//	MSG_LocateTime_Info.Curnt_Second_ByGPS = getvalue ( EnvCurnt_Second_ByGPS_);
//	MSG_LocateTime_Info.Curnt_Minutes_ByGPS = getvalue ( EnvCurnt_Minutes_ByGPS_);
//	MSG_LocateTime_Info.Curnt_Hour_ByGPS = getvalue ( EnvCurnt_Hour_ByGPS_);
	MSG_LocateTime_Info.LongitudeByGPS = getvalue ( EnvLongitudeByGPS_);
//	MSG_LocateTime_Info.Curnt_Date_ByGPS = getvalue ( EnvCurnt_Date_ByGPS_);
//	MSG_LocateTime_Info.Curnt_Month_ByGPS = getvalue ( EnvCurnt_Month_ByGPS_);
//	MSG_LocateTime_Info.Curnt_Year_ByGPS = getvalue ( EnvCurnt_Year_ByGPS_);
	MSG_LocateTime_Info.LatitudeByGPS = getvalue ( EnvLatitudeByGPS_);
	MSG_LocateTime_Info.LocateTime_Info_Data_Number = getvalue ( EnvLocateTime_Info_Data_Number_);

	/*  Output  */
	
	MSG_LocateTime_Info.Dlc = getvalue ( EnvLocateTime_InfoDlc_);
	 
  if(getvalue(EnvLocateTime_Info_Data_Number_)== 0x00)
	{
    MSG_LocateTime_Info.Curnt_Date_ByGPS = getvalue ( EnvCurnt_Date_ByGPS_);
    MSG_LocateTime_Info.Curnt_Month_ByGPS = getvalue ( EnvCurnt_Month_ByGPS_);
    MSG_LocateTime_Info.Curnt_Year_ByGPS = getvalue ( EnvCurnt_Year_ByGPS_);
	}
	if(getvalue(EnvLocateTime_Info_Data_Number_)== 0x01)
	{
    MSG_LocateTime_Info.Curnt_Second_ByGPS = getvalue ( EnvCurnt_Second_ByGPS_);
    MSG_LocateTime_Info.Curnt_Minutes_ByGPS = getvalue ( EnvCurnt_Minutes_ByGPS_);
    MSG_LocateTime_Info.Curnt_Hour_ByGPS = getvalue ( EnvCurnt_Hour_ByGPS_);
	}
  
	if(getvalue(EnvLocateTime_InfoTo_))
	{
		output(MSG_LocateTime_Info);
	}
	else
	{
		// Write("LocateTime_Info Message is not sent ");
	}
  
  if(getvalue(EnvLocateTime_Info_Data_Number_)== 0x00)
  {
    putValue(EnvLocateTime_Info_Data_Number_,0x01);
  }
   else
  {
    putValue(EnvLocateTime_Info_Data_Number_,0x00);
  }
	 
	settimer(T_MSG_LocateTime_Info,  getvalue(EnvLocateTime_InfoTime_));
}
//on timer T_MSG_RCM_Bus_Status 
//{
//	MSG_RCM_Bus_Status.DiagSupt_Status_RCM = getvalue ( EnvDiagSupt_Status_RCM_);
//	MSG_RCM_Bus_Status.TrigPriority_RCM = getvalue ( EnvTrigPriority_RCM_);
//	MSG_RCM_Bus_Status.TrigReq_RCM = getvalue ( EnvTrigReq_RCM_);
//	MSG_RCM_Bus_Status.DTC3_Sts_RCM = getvalue ( EnvDTC3_Sts_RCM_);
//	MSG_RCM_Bus_Status.DTC3_Nbr_RCM = getvalue ( EnvDTC3_Nbr_RCM_);
//	MSG_RCM_Bus_Status.DTC2_Sts_RCM = getvalue ( EnvDTC2_Sts_RCM_);
//	MSG_RCM_Bus_Status.DTC2_Nbr_RCM = getvalue ( EnvDTC2_Nbr_RCM_);
//	MSG_RCM_Bus_Status.DTC1_Sts_RCM = getvalue ( EnvDTC1_Sts_RCM_);
//	MSG_RCM_Bus_Status.DTC1_Nbr_RCM = getvalue ( EnvDTC1_Nbr_RCM_);
//	MSG_RCM_Bus_Status.DataNumber_RCM = getvalue ( EnvDataNumber_RCM_);
//
//	/*  Output  */
//	
//	MSG_RCM_Bus_Status.Dlc = getvalue ( EnvRCM_Bus_StatusDlc_);
//	 
//	if(getvalue(EnvRCM_Bus_StatusTo_))
//	{
//		output(MSG_RCM_Bus_Status);
//	}
//	else
//	{
//		Write("RCM_Bus_Status Message is not sent ");
//	}
//	 
//	settimer(T_MSG_RCM_Bus_Status,  getvalue(EnvRCM_Bus_StatusTime_));
//	 
//
//}
on timer T_MSG_EngControlData 
{
	MSG_EngControlData.TrnTotTq_Rt_Est = getvalue ( EnvTrnTotTq_Rt_Est_);
	MSG_EngControlData.VehVLim_Warning = getvalue ( EnvVehVLim_Warning_);
	MSG_EngControlData.AirCondRec_B_Rq = getvalue ( EnvAirCondRec_B_Rq_);
	MSG_EngControlData.AWD_State_Req_165 = getvalue ( EnvAWD_State_Req_165_);
	MSG_EngControlData.VehVLim_OverVS_KD = getvalue ( EnvVehVLim_OverVS_KD_);
	MSG_EngControlData.NeutralSwActv_D_Actl = getvalue ( EnvNeutralSwActv_D_Actl_);
	MSG_EngControlData.GearPos_D_TrgMt = getvalue ( EnvGearPos_D_TrgMt_);
	MSG_EngControlData.GearRvrseActv_B_Actl = getvalue ( EnvGearRvrseActv_B_Actl_);
	MSG_EngControlData.EngAoutIdl_N_RqVsc = getvalue ( EnvEngAoutIdl_N_RqVsc_);
	MSG_EngControlData.BrkOnOffSwtch_D_Actl_2 = getvalue ( EnvBrkOnOffSwtch_D_Actl_2_);
	MSG_EngControlData.AWDTrgt_I_Req_165 = getvalue ( EnvAWDTrgt_I_Req_165_);

	/*  Output  */
	
	if(data_selection == 0x02)
	{
		
	if(use_case == 0) // use case 1: Invalid - Unobtain 
	{
		if (Unobtain_pattern != 0)
		{
			if (Invalid_pattern > 0)
			{
				Invalid_pattern--;
				putvalue(EnvEngControlDataTo_,1);
				MSG_EngControlData.BrkOnOffSwtch_D_Actl_2 = 0;
			}else
			{
				putvalue(EnvEngControlDataTo_,0);
        Unobtain_pattern--;
			}
		}else
			{
        putvalue(EnvEngControlDataTo_,1);
				Invalid_pattern = getvalue(Env_24EDR_Invalid_)-1;
				Unobtain_pattern = getvalue(Env_24EDR_Unobtain_);
			}
	}else if (use_case == 1) //use case 2 : invalid - valid
	{
		
		if(Valid_pattern > 0)
		{
			if(Invalid_pattern > 0) {
        write("hnn81hc: BrakeOnOff Invalid: valid %d invalid %d ", Invalid_pattern, Valid_pattern);
				Invalid_pattern--;
				MSG_EngControlData.BrkOnOffSwtch_D_Actl_2 = 0;
			}else
			{
        write("hnn81hc: BrakeOnOff Valid: valid %d invalid %d ", Invalid_pattern, Valid_pattern);
				Valid_pattern --;
			}
		}else
		{
      MSG_EngControlData.BrkOnOffSwtch_D_Actl_2 = 0;
			Invalid_pattern = getvalue(Env_24EDR_Invalid_)-1;
			Valid_pattern = getvalue(Env_24EDR_Valid_);
      write("hnn81hc: Reset valid %d invalid %d ", Invalid_pattern, Valid_pattern);
		}
		
	}else if (use_case == 2) //use case 2: unobtain - valid
  {
    if(Valid_pattern > 0)
		{
			if(Unobtain_pattern != 0)
			{
				Unobtain_pattern--;
				putvalue(EnvEngControlDataTo_,0);
			}else
			{
				Valid_pattern --;
        putvalue(EnvEngControlDataTo_,1);
			}
		}else
		{
			putvalue(EnvEngControlDataTo_,0);
			Unobtain_pattern = getvalue(Env_24EDR_Unobtain_)-1;
			Valid_pattern = getvalue(Env_24EDR_Valid_);
		}
  }	
  }
	MSG_EngControlData.Dlc = getvalue ( EnvEngControlDataDlc_);
	 
	if(getvalue(EnvEngControlDataTo_))
	{
		output(MSG_EngControlData);
	}
	else
	{
		// Write("EngControlData Message is not sent ");
	}
	 
	settimer(T_MSG_EngControlData,  getvalue(EnvEngControlDataTime_));
	 

}
on timer T_MSG_DesiredTorqBrk_MAC 
{
//  byte payloadLength = 4;
//  qword truncatedAuthenticator;
//  dword truncatedAuthenticatorBitLength = 28;
//  qword freshness;
//  dword truncatedFreshnessBitLength = 4;
//  dword freshnessValueBitLength = 48;
//  long result;
	MSG_DesiredTorqBrk_MAC.DesiredTorqBrk_MACTx = getvalue ( EnvDesiredTorqBrk_MACTx_);
	MSG_DesiredTorqBrk_MAC.DesiredTorqBrk_FVTx = getvalue ( EnvDesiredTorqBrk_FVTx_);
	MSG_DesiredTorqBrk_MAC.PrplWhlTqRqMn_MAC_No_Cs = getvalue ( EnvPrplWhlTqRqMn_MAC_No_Cs_);
	MSG_DesiredTorqBrk_MAC.PrplWhlTqRqMn_MAC_No_Cnt = getvalue ( EnvPrplWhlTqRqMn_MAC_No_Cnt_);
	MSG_DesiredTorqBrk_MAC.Abs_B_Falt = getvalue ( EnvAbs_B_Falt_);
	MSG_DesiredTorqBrk_MAC.TsaCtlActv_B_Actl = getvalue ( EnvTsaCtlActv_B_Actl_);
	MSG_DesiredTorqBrk_MAC.RolStabCtlActv_B_Actl = getvalue ( EnvRolStabCtlActv_B_Actl_);
	MSG_DesiredTorqBrk_MAC.PrplDrgCtlActv_B_Actl = getvalue ( EnvPrplDrgCtlActv_B_Actl_);
	MSG_DesiredTorqBrk_MAC.TracCtlPtActv_B_Actl = getvalue ( EnvTracCtlPtActv_B_Actl_);
	MSG_DesiredTorqBrk_MAC.TracCtlBrkActv_B_Actl = getvalue ( EnvTracCtlBrkActv_B_Actl_);
	MSG_DesiredTorqBrk_MAC.DSC_OnOff_status_1 = getvalue ( EnvDSC_OnOff_status_1_);
	MSG_DesiredTorqBrk_MAC.StabCtlBrkActv_B_Actl = getvalue ( EnvStabCtlBrkActv_B_Actl_);
	MSG_DesiredTorqBrk_MAC.BrkAsst_B_Actl = getvalue ( EnvBrkAsst_B_Actl_);
	MSG_DesiredTorqBrk_MAC.AbsActv_B_Actl = getvalue ( EnvAbsActv_B_Actl_);
	MSG_DesiredTorqBrk_MAC.EbdActv_B_Actl = getvalue ( EnvEbdActv_B_Actl_);

	/*  Output  */
	if((data_selection == 0x0D)||(data_selection == 0x14)||(data_selection == 0x15))
	{
	if(use_case == 0) // use case 1: Invalid - Unobtain 
	{
		if (Unobtain_pattern != 0)
		{
			if (Invalid_pattern > 0)
			{
				Invalid_pattern--;
				putvalue(EnvDesiredTorqBrk_MACTo_,1);
				MSG_DesiredTorqBrk_MAC.PrplWhlTqRqMn_MAC_No_Cs = 0;
			}else
			{
				putvalue(EnvDesiredTorqBrk_MACTo_,0);
        Unobtain_pattern--;
			}
		}else
			{
        putvalue(EnvDesiredTorqBrk_MACTo_,1);
				Invalid_pattern = getvalue(Env_24EDR_Invalid_)-1;
				Unobtain_pattern = getvalue(Env_24EDR_Unobtain_);
			}
	}else if (use_case == 1) //use case 2 : invalid - valid
	{
		if(Valid_pattern > 0)
		{
			if(Invalid_pattern > 0)
			{
				Invalid_pattern--;
				MSG_DesiredTorqBrk_MAC.PrplWhlTqRqMn_MAC_No_Cs = 0;
			}else
			{
				Valid_pattern --;
			}
		}else
		{
		MSG_DesiredTorqBrk_MAC.PrplWhlTqRqMn_MAC_No_Cs = 0;
			Invalid_pattern = getvalue(Env_24EDR_Invalid_)-1;
			Valid_pattern = getvalue(Env_24EDR_Valid_);
		}
		
	}else if (use_case == 2) //use case 2: unobtain - valid
  {
    if(Valid_pattern > 0)
		{
			if(Unobtain_pattern != 0)
			{
				Unobtain_pattern--;
				putvalue(EnvDesiredTorqBrk_MACTo_,0);
			}else
			{
				Valid_pattern --;
        putvalue(EnvDesiredTorqBrk_MACTo_,1);
			}
		}else
		{
			putvalue(EnvDesiredTorqBrk_MACTo_,0);
			Unobtain_pattern = getvalue(Env_24EDR_Unobtain_)-1;
			Valid_pattern = getvalue(Env_24EDR_Valid_);
		}
  }
	}	
	MSG_DesiredTorqBrk_MAC.Dlc = getvalue ( EnvDesiredTorqBrk_MACDlc_);
	 
	if(getvalue(EnvDesiredTorqBrk_MACTo_))
	{
//    if((tripCnt_DesiredTorqBrk != g_TripCnt) | (resetCnt_DesiredTorqBrk != g_ResetCnt)) {
//      tripCnt_DesiredTorqBrk = g_TripCnt;
//      resetCnt_DesiredTorqBrk = g_ResetCnt;
//      if(resetCnt_DesiredTorqBrk < 0xFFFFF) {
//        msgCnt_DesiredTorqBrk = 1;
//      }
//      else {
//        msgCnt_DesiredTorqBrk = 0xFF;
//      }
//    }
//    else{
//      if(msgCnt_DesiredTorqBrk < 0xFF) {
//        msgCnt_DesiredTorqBrk += 1;
//      }
//      else {
//        msgCnt_DesiredTorqBrk = 0xFF;
//      }
//    }
//    resetFlag_DesiredTorqBrk = resetCnt_DesiredTorqBrk & 0x03;
//    freshness = ((tripCnt_DesiredTorqBrk << 32) | (resetCnt_DesiredTorqBrk << 12)
//    | (msgCnt_DesiredTorqBrk << 4) | (resetFlag_DesiredTorqBrk << 2));
//    payload_DesiredTorqBrk[0] =  MSG_DesiredTorqBrk_MAC.byte(0);
//    payload_DesiredTorqBrk[1] =  MSG_DesiredTorqBrk_MAC.byte(1);
//    payload_DesiredTorqBrk[2] =  MSG_DesiredTorqBrk_MAC.byte(2);
//    payload_DesiredTorqBrk[3] =  MSG_DesiredTorqBrk_MAC.byte(3);
//  	result = LocalSecurityCalculateAuthenticator(MSG_DesiredTorqBrk_MAC.id, payload_DesiredTorqBrk, payloadLength, truncatedAuthenticator, truncatedAuthenticatorBitLength, freshness, truncatedFreshnessBitLength, freshnessValueBitLength);
//    
//    putValue(EnvDesiredTorqBrk_FVTx_, freshness);
//    putValue(EnvDesiredTorqBrk_MACTx_, truncatedAuthenticator);
//    MSG_DesiredTorqBrk_MAC.DesiredTorqBrk_MACTx = getvalue ( EnvDesiredTorqBrk_MACTx_);
//  	MSG_DesiredTorqBrk_MAC.DesiredTorqBrk_FVTx = getvalue ( EnvDesiredTorqBrk_FVTx_);
//    
//    if(@EnvFDesiredTorqBrk_MAC){
//      MSG_DesiredTorqBrk_MAC.DesiredTorqBrk_MACTx = getvalue ( EnvDesiredTorqBrk_MACTx_) / 2;
//    }
		output(MSG_DesiredTorqBrk_MAC);
	}
	else
	{
		Write("DesiredTorqBrk_MAC Message is not sent ");
	}
	 
	settimer(T_MSG_DesiredTorqBrk_MAC,  getvalue(EnvDesiredTorqBrk_MACTime_));	 

}
//on timer T_MSG_CBCM_DriveSelection_Info 
//{
//	MSG_CBCM_DriveSelection_Info.Auto_XevNormal_Mode_D_Rq = getvalue ( EnvAuto_XevNormal_Mode_D_Rq_);
//	MSG_CBCM_DriveSelection_Info.Not_Select_Xevmode_D_Rq = getvalue ( EnvNot_Select_Xevmode_D_Rq_);
//	MSG_CBCM_DriveSelection_Info.Auto_Normal_Mode_D_Rq = getvalue ( EnvAuto_Normal_Mode_D_Rq_);
//	MSG_CBCM_DriveSelection_Info.Not_Select_Drivemode_D_Rq = getvalue ( EnvNot_Select_Drivemode_D_Rq_);
//	MSG_CBCM_DriveSelection_Info.Trailer_Connect_D_Rq = getvalue ( EnvTrailer_Connect_D_Rq_);
//	MSG_CBCM_DriveSelection_Info.Drive_Mode_List_Popup = getvalue ( EnvDrive_Mode_List_Popup_);
//	MSG_CBCM_DriveSelection_Info.Xev_Mode_Charge_Permission = getvalue ( EnvXev_Mode_Charge_Permission_);
//	MSG_CBCM_DriveSelection_Info.Xev_Mode_Ev_Permission = getvalue ( EnvXev_Mode_Ev_Permission_);
//	MSG_CBCM_DriveSelection_Info.Xev_Mode_Status = getvalue ( EnvXev_Mode_Status_);
//	MSG_CBCM_DriveSelection_Info.Drive_Mode_Towing_Permission = getvalue ( EnvDrive_Mode_Towing_Permission_);
//	MSG_CBCM_DriveSelection_Info.Drive_Mode_Offroad_Permission = getvalue ( EnvDrive_Mode_Offroad_Permission_);
//	MSG_CBCM_DriveSelection_Info.Drive_Mode_Sport_Permission = getvalue ( EnvDrive_Mode_Sport_Permission_);
//	MSG_CBCM_DriveSelection_Info.Drive_Mode_Normal_Permission = getvalue ( EnvDrive_Mode_Normal_Permission_);
//	MSG_CBCM_DriveSelection_Info.Drive_Mode_List_Info = getvalue ( EnvDrive_Mode_List_Info_);
//	MSG_CBCM_DriveSelection_Info.Drive_Mode_Status = getvalue ( EnvDrive_Mode_Status_);
//
//	/*  Output  */
//	
//	MSG_CBCM_DriveSelection_Info.Dlc = getvalue ( EnvCBCM_DriveSelection_InfoDlc_);
//	 
//	if(getvalue(EnvCBCM_DriveSelection_InfoTo_))
//	{
//		output(MSG_CBCM_DriveSelection_Info);
//	}
//	else
//	{
//		Write("CBCM_DriveSelection_Info Message is not sent ");
//	}
//	 
//	settimer(T_MSG_CBCM_DriveSelection_Info,  getvalue(EnvCBCM_DriveSelection_InfoTime_));
//	 
//
//}
//on timer T_MSG_RCM_Late_Acc_MAC 
//{
//	MSG_RCM_Late_Acc_MAC.RCM_Late_Acc_MACTx = getvalue ( EnvRCM_Late_Acc_MACTx_);
//	MSG_RCM_Late_Acc_MAC.RCM_Late_Acc_FVTx = getvalue ( EnvRCM_Late_Acc_FVTx_);
//	MSG_RCM_Late_Acc_MAC.Lateral_Acceleration = getvalue ( EnvLateral_Acceleration_);
//	MSG_RCM_Late_Acc_MAC.ID071_E2E_CNTProfile2 = getvalue ( EnvID071_E2E_CNTProfile2_);
//	MSG_RCM_Late_Acc_MAC.Signal_State_Lateral_Acceleratio = getvalue ( EnvSignal_State_Lateral_Acceleratio_);
//	MSG_RCM_Late_Acc_MAC.ID071_E2E_CRCProfile2 = getvalue ( EnvID071_E2E_CRCProfile2_);
//
//	/*  Output  */
//	
//	MSG_RCM_Late_Acc_MAC.Dlc = getvalue ( EnvRCM_Late_Acc_MACDlc_);
//	 
//	if(getvalue(EnvRCM_Late_Acc_MACTo_))
//	{
//		output(MSG_RCM_Late_Acc_MAC);
//	}
//	else
//	{
//		Write("RCM_Late_Acc_MAC Message is not sent ");
//	}
//	 
//	settimer(T_MSG_RCM_Late_Acc_MAC,  getvalue(EnvRCM_Late_Acc_MACTime_));
//	 
//
//}
//on timer T_MSG_MACKVERI2 
//{
//	MSG_MACKVERI2.MACKVERI2_2 = getvalue ( EnvMACKVERI2_2_);
//	MSG_MACKVERI2.MACKVERI2_1 = getvalue ( EnvMACKVERI2_1_);
//
//	/*  Output  */
//	
//	MSG_MACKVERI2.Dlc = getvalue ( EnvMACKVERI2Dlc_);
//	 
//	if(getvalue(EnvMACKVERI2To_))
//	{
//		output(MSG_MACKVERI2);
//	}
//	else
//	{
//		Write("MACKVERI2 Message is not sent ");
//	}
//	 
//	settimer(T_MSG_MACKVERI2,  getvalue(EnvMACKVERI2Time_));
//	 
//
//}
on timer T_MSG_VDT_Trigger_Control2 
{
	MSG_VDT_Trigger_Control2.VDT_Cancel_Resp_Counter2 = getvalue ( EnvVDT_Cancel_Resp_Counter2_);
	MSG_VDT_Trigger_Control2.VDT_Resp_Counter2 = getvalue ( EnvVDT_Resp_Counter2_);
	MSG_VDT_Trigger_Control2.VDT_INV_ODR2_ReqTCU = getvalue ( EnvVDT_INV_ODR2_ReqTCU_);
	MSG_VDT_Trigger_Control2.VDT_INV_ODR2_Rq = getvalue ( EnvVDT_INV_ODR2_Rq_);
	MSG_VDT_Trigger_Control2.VDT_ECM_ODR1_ReqTCU = getvalue ( EnvVDT_ECM_ODR1_ReqTCU_);
	MSG_VDT_Trigger_Control2.VDT_ECM_ODR1_Rq = getvalue ( EnvVDT_ECM_ODR1_Rq_);
	MSG_VDT_Trigger_Control2.VDT_RCM_ODR1_ReqTCU = getvalue ( EnvVDT_RCM_ODR1_ReqTCU_);
	MSG_VDT_Trigger_Control2.VDT_RCM_ODR1_Rq = getvalue ( EnvVDT_RCM_ODR1_Rq_);
	MSG_VDT_Trigger_Control2.TCU_SW_Update_Resp = getvalue ( EnvTCU_SW_Update_Resp_);
	MSG_VDT_Trigger_Control2.VDT_Cancel_PreAC_Resp = getvalue ( EnvVDT_Cancel_PreAC_Resp_);
	MSG_VDT_Trigger_Control2.VDT_PreAC_Resp = getvalue ( EnvVDT_PreAC_Resp_);
	MSG_VDT_Trigger_Control2.VDT_Cancel_Charge_Resp = getvalue ( EnvVDT_Cancel_Charge_Resp_);
	MSG_VDT_Trigger_Control2.VDT_Charge_Resp = getvalue ( EnvVDT_Charge_Resp_);

	/*  Output  */
	
	MSG_VDT_Trigger_Control2.Dlc = getvalue ( EnvVDT_Trigger_Control2Dlc_);
	 
	if(getvalue(EnvVDT_Trigger_Control2To_))
	{
		output(MSG_VDT_Trigger_Control2);
	}
	else
	{
		// Write("VDT_Trigger_Control2 Message is not sent ");
	}
	 
	settimer(T_MSG_VDT_Trigger_Control2,  getvalue(EnvVDT_Trigger_Control2Time_));
	 

}
//on timer T_MSG_RCM_Diag_Tx 
//{
//	MSG_RCM_Diag_Tx.RCM_Diag_Sig_Tx = getvalue ( EnvRCM_Diag_Sig_Tx_);
//
//	/*  Output  */
//	
//	MSG_RCM_Diag_Tx.Dlc = getvalue ( EnvRCM_Diag_TxDlc_);
//	 
//	if(getvalue(EnvRCM_Diag_TxTo_))
//	{
//		output(MSG_RCM_Diag_Tx);
//	}
//	else
//	{
//		Write("RCM_Diag_Tx Message is not sent ");
//	}
//	 
//	settimer(T_MSG_RCM_Diag_Tx,  getvalue(EnvRCM_Diag_TxTime_));
//	 
//
//}
//on timer T_MSG_Door_D_Message 
//{
//	MSG_Door_D_Message.DOORDMSG_No_Cs = getvalue ( EnvDOORDMSG_No_Cs_);
//	MSG_Door_D_Message.DOORDMSG_No_Cnt = getvalue ( EnvDOORDMSG_No_Cnt_);
//	MSG_Door_D_Message.Move_AutoDposMirror_Res = getvalue ( EnvMove_AutoDposMirror_Res_);
//	MSG_Door_D_Message.BackupBatteryOut_Drv_U_Act = getvalue ( EnvBackupBatteryOut_Drv_U_Act_);
//	MSG_Door_D_Message.MirrorLED1_status = getvalue ( EnvMirrorLED1_status_);
//	MSG_Door_D_Message.DrLock_Message_D_Rsp = getvalue ( EnvDrLock_Message_D_Rsp_);
//	MSG_Door_D_Message.DrivingPositionRequest = getvalue ( EnvDrivingPositionRequest_);
//	MSG_Door_D_Message.Mirror_AjustSelSW_Status = getvalue ( EnvMirror_AjustSelSW_Status_);
//	MSG_Door_D_Message.MirrorFoldRequest = getvalue ( EnvMirrorFoldRequest_);
//	MSG_Door_D_Message.MirrorAdjustRequest = getvalue ( EnvMirrorAdjustRequest_);
//	MSG_Door_D_Message.MirrorAdjst_Manual_Status = getvalue ( EnvMirrorAdjst_Manual_Status_);
//	MSG_Door_D_Message.MirrorAdjst_Status = getvalue ( EnvMirrorAdjst_Status_);
//	MSG_Door_D_Message.Erase_MirrorMem_Res = getvalue ( EnvErase_MirrorMem_Res_);
//	MSG_Door_D_Message.Recall_MirrorMem_Res = getvalue ( EnvRecall_MirrorMem_Res_);
//	MSG_Door_D_Message.Record_MirrorMem_Res = getvalue ( EnvRecord_MirrorMem_Res_);
//	MSG_Door_D_Message.PW_Move_R = getvalue ( EnvPW_Move_R_);
//	MSG_Door_D_Message.PW_Move_P = getvalue ( EnvPW_Move_P_);
//	MSG_Door_D_Message.PWcut_D_Actl = getvalue ( EnvPWcut_D_Actl_);
//	MSG_Door_D_Message.DrvDLMotorDriveStat = getvalue ( EnvDrvDLMotorDriveStat_);
//	MSG_Door_D_Message.Ctrl_DLSw_Drv_Stat = getvalue ( EnvCtrl_DLSw_Drv_Stat_);
//	MSG_Door_D_Message.LockLinkSwDrv_D_Actl = getvalue ( EnvLockLinkSwDrv_D_Actl_);
//	MSG_Door_D_Message.DrStatDrv_D_Qf = getvalue ( EnvDrStatDrv_D_Qf_);
//	MSG_Door_D_Message.DrStatDrv_B_Actl = getvalue ( EnvDrStatDrv_B_Actl_);
//
//	/*  Output  */
//	
//	MSG_Door_D_Message.Dlc = getvalue ( EnvDoor_D_MessageDlc_);
//	 
//	if(getvalue(EnvDoor_D_MessageTo_))
//	{
//		output(MSG_Door_D_Message);
//	}
//	else
//	{
//		Write("Door_D_Message Message is not sent ");
//	}
//	 
//	settimer(T_MSG_Door_D_Message,  getvalue(EnvDoor_D_MessageTime_));
//	 
//
//}
//on timer T_MSG_SAS_G_Info1 
//{
//	MSG_SAS_G_Info1.SAS_Gz = getvalue ( EnvSAS_Gz_);
//	MSG_SAS_G_Info1.SAS_Gy = getvalue ( EnvSAS_Gy_);
//	MSG_SAS_G_Info1.SAS_Gx = getvalue ( EnvSAS_Gx_);
//
//	/*  Output  */
//	
//	MSG_SAS_G_Info1.Dlc = getvalue ( EnvSAS_G_Info1Dlc_);
//	 
//	if(getvalue(EnvSAS_G_Info1To_))
//	{
//		output(MSG_SAS_G_Info1);
//	}
//	else
//	{
//		Write("SAS_G_Info1 Message is not sent ");
//	}
//	 
//	settimer(T_MSG_SAS_G_Info1,  getvalue(EnvSAS_G_Info1Time_));
//	 
//
//}
on timer T_MSG_ECM_Status 
{
	MSG_ECM_Status.Xev_Charge_Req_PCM = getvalue ( EnvXev_Charge_Req_PCM_);
	MSG_ECM_Status.PTGeneralWarn_Mirror = getvalue ( EnvPTGeneralWarn_Mirror_);
	MSG_ECM_Status.Drive_Mode_Req_PCM = getvalue ( EnvDrive_Mode_Req_PCM_);
	MSG_ECM_Status.Drive_Mode_Towing_Req_PCM = getvalue ( EnvDrive_Mode_Towing_Req_PCM_);
	MSG_ECM_Status.Drive_Mode_OffRoad_Req_PCM = getvalue ( EnvDrive_Mode_OffRoad_Req_PCM_);
	MSG_ECM_Status.Drive_Mode_Sport_Req_PCM = getvalue ( EnvDrive_Mode_Sport_Req_PCM_);
	MSG_ECM_Status.Drive_Mode_Normal_Req_PCM = getvalue ( EnvDrive_Mode_Normal_Req_PCM_);
	MSG_ECM_Status.ATFalseStartWarning = getvalue ( EnvATFalseStartWarning_);
	MSG_ECM_Status.BattRgenStat_B_Actl = getvalue ( EnvBattRgenStat_B_Actl_);
	MSG_ECM_Status.RegenBrkFailWarning = getvalue ( EnvRegenBrkFailWarning_);
	MSG_ECM_Status.BmsWarn_B_Rq = getvalue ( EnvBmsWarn_B_Rq_);
	MSG_ECM_Status.SmtAclInh_B_Actl = getvalue ( EnvSmtAclInh_B_Actl_);
	MSG_ECM_Status.BrakeSw_Fail_Warning = getvalue ( EnvBrakeSw_Fail_Warning_);
	MSG_ECM_Status.BOS_Active_B_Actl = getvalue ( EnvBOS_Active_B_Actl_);
	MSG_ECM_Status.DriveMode_Hold_Rq_PCM = getvalue ( EnvDriveMode_Hold_Rq_PCM_);
	MSG_ECM_Status.GlobalConfgWarn_B_Rq = getvalue ( EnvGlobalConfgWarn_B_Rq_);
	MSG_ECM_Status.CrankingTime = getvalue ( EnvCrankingTime_);
	MSG_ECM_Status.ApedOnN_B_Rq = getvalue ( EnvApedOnN_B_Rq_);
	MSG_ECM_Status.IG_OFF_Delay_Request = getvalue ( EnvIG_OFF_Delay_Request_);
	MSG_ECM_Status.Crank_wait = getvalue ( EnvCrank_wait_);
	MSG_ECM_Status.SilGearPosActl_D_Dsply = getvalue ( EnvSilGearPosActl_D_Dsply_);
	MSG_ECM_Status.Xev_Ev_Req_PCM = getvalue ( EnvXev_Ev_Req_PCM_);
	MSG_ECM_Status.VspLmtAlarm_B_Rq = getvalue ( EnvVspLmtAlarm_B_Rq_);
	MSG_ECM_Status.PTGeneralWarn_B_Rq = getvalue ( EnvPTGeneralWarn_B_Rq_);
	MSG_ECM_Status.SRLY_state = getvalue ( EnvSRLY_state_);
	MSG_ECM_Status.SilGearPos_D_Dsply = getvalue ( EnvSilGearPos_D_Dsply_);
	MSG_ECM_Status.VspLmtWarn_B_Rq = getvalue ( EnvVspLmtWarn_B_Rq_);
	MSG_ECM_Status.KeyState = getvalue ( EnvKeyState_);
	MSG_ECM_Status.ShiftIndicatorLight = getvalue ( EnvShiftIndicatorLight_);
	MSG_ECM_Status.PowerSourceStatus = getvalue ( EnvPowerSourceStatus_);

	/*  Output  */
	
	MSG_ECM_Status.Dlc = getvalue ( EnvECM_StatusDlc_);
	 
	if(getvalue(EnvECM_StatusTo_))
	{
		output(MSG_ECM_Status);
	}
	else
	{
		// Write("ECM_Status Message is not sent ");
	}
	 
	settimer(T_MSG_ECM_Status,  getvalue(EnvECM_StatusTime_));
	 

}
on timer T_MSG_ADAS_HMI_Information2 
{
	MSG_ADAS_HMI_Information2.LDP_alarm = getvalue ( EnvLDP_alarm_);
	MSG_ADAS_HMI_Information2.LDP_fallback = getvalue ( EnvLDP_fallback_);
	MSG_ADAS_HMI_Information2.LDP_EV_failure = getvalue ( EnvLDP_EV_failure_);
	MSG_ADAS_HMI_Information2.LDP_EV_tmp_failure = getvalue ( EnvLDP_EV_tmp_failure_);
	MSG_ADAS_HMI_Information2.LDP_EV_warning_rh = getvalue ( EnvLDP_EV_warning_rh_);
	MSG_ADAS_HMI_Information2.LDP_EV_warning_lh = getvalue ( EnvLDP_EV_warning_lh_);
	MSG_ADAS_HMI_Information2.LDP_lane_lh = getvalue ( EnvLDP_lane_lh_);
	MSG_ADAS_HMI_Information2.LDP_lane_rh = getvalue ( EnvLDP_lane_rh_);
	MSG_ADAS_HMI_Information2.LDP_state = getvalue ( EnvLDP_state_);
	MSG_ADAS_HMI_Information2.BSM_EV_failure = getvalue ( EnvBSM_EV_failure_);
	MSG_ADAS_HMI_Information2.BSM_EV_tmp_failure = getvalue ( EnvBSM_EV_tmp_failure_);
	MSG_ADAS_HMI_Information2.BSM_EV_warning_rh = getvalue ( EnvBSM_EV_warning_rh_);
	MSG_ADAS_HMI_Information2.BSM_EV_warning_lh = getvalue ( EnvBSM_EV_warning_lh_);
	MSG_ADAS_HMI_Information2.BSM_fallback = getvalue ( EnvBSM_fallback_);
	MSG_ADAS_HMI_Information2.BSM_target_lh = getvalue ( EnvBSM_target_lh_);
	MSG_ADAS_HMI_Information2.BSM_target_rh = getvalue ( EnvBSM_target_rh_);
	MSG_ADAS_HMI_Information2.BSM_state = getvalue ( EnvBSM_state_);
	MSG_ADAS_HMI_Information2.RDP_alarm = getvalue ( EnvRDP_alarm_);
	MSG_ADAS_HMI_Information2.RDP_fallback = getvalue ( EnvRDP_fallback_);
	MSG_ADAS_HMI_Information2.RDP_EV_failure = getvalue ( EnvRDP_EV_failure_);
	MSG_ADAS_HMI_Information2.RDP_EV_tmp_failure = getvalue ( EnvRDP_EV_tmp_failure_);
	MSG_ADAS_HMI_Information2.RDP_roadedge_lh = getvalue ( EnvRDP_roadedge_lh_);
	MSG_ADAS_HMI_Information2.RDP_roadedge_rh = getvalue ( EnvRDP_roadedge_rh_);
	MSG_ADAS_HMI_Information2.RDP_state = getvalue ( EnvRDP_state_);

	/*  Output  */
	if(data_selection == 0x0E)
	{ 
	if(use_case == 0) // use case 1: Invalid - Unobtain 
	{
		if (Unobtain_pattern != 0)
		{
			if (Invalid_pattern > 0)
			{
				Invalid_pattern--;
				putvalue(EnvADAS_HMI_Information2To_,1);
				MSG_ADAS_HMI_Information2.RDP_state  = 5;
			}else
			{
				putvalue(EnvADAS_HMI_Information2To_,0);
        Unobtain_pattern--;
			}
		}else
			{
        putvalue(EnvADAS_HMI_Information2To_,1);
				Invalid_pattern = getvalue(Env_24EDR_Invalid_)-1;
				Unobtain_pattern = getvalue(Env_24EDR_Unobtain_);
			}
	}else if (use_case == 1) //use case 2 : invalid - valid
	{
		if(Valid_pattern > 0)
		{
			if(Invalid_pattern > 0)
			{
				Invalid_pattern--;
				MSG_ADAS_HMI_Information2.RDP_state  = 5;
			}else
			{
				Valid_pattern --;
			}
		}else
		{
		MSG_ADAS_HMI_Information2.RDP_state  = 5;
			Invalid_pattern = getvalue(Env_24EDR_Invalid_)-1;
			Valid_pattern = getvalue(Env_24EDR_Valid_);
		}
		
	}else if (use_case == 2) //use case 2: unobtain - valid
  {
    if(Valid_pattern > 0)
		{
			if(Unobtain_pattern != 0)
			{
				Unobtain_pattern--;
				putvalue(EnvADAS_HMI_Information2To_,0);
			}else
			{
				Valid_pattern --;
        putvalue(EnvADAS_HMI_Information2To_,1);
			}
		}else
		{
			putvalue(EnvADAS_HMI_Information2To_,0);
			Unobtain_pattern = getvalue(Env_24EDR_Unobtain_)-1;
			Valid_pattern = getvalue(Env_24EDR_Valid_);
		}
  }
	}	
	MSG_ADAS_HMI_Information2.Dlc = getvalue ( EnvADAS_HMI_Information2Dlc_);
	 
	if(getvalue(EnvADAS_HMI_Information2To_))
	{
		output(MSG_ADAS_HMI_Information2);
	}
	else
	{
	//	Write("ADAS_HMI_Information2 Message is not sent ");
	}
	 
	settimer(T_MSG_ADAS_HMI_Information2,  getvalue(EnvADAS_HMI_Information2Time_));
	 

}
//	}
//	else
//	{
//		Write("ADAS_HMI_Information2 Message is not sent ");
//	}
//	 
//	settimer(T_MSG_ADAS_HMI_Information2,  getvalue(EnvADAS_HMI_Information2Time_));
//	 
//
//}
on timer T_MSG_Hvac_Control_Information2_MAC 
{
//  byte payloadLength = 4;
//  qword truncatedAuthenticator;
//  dword truncatedAuthenticatorBitLength = 28;
//  qword freshness;
//  dword truncatedFreshnessBitLength = 4;
//  dword freshnessValueBitLength = 48;
//  long result;
	MSG_Hvac_Control_Information2_MAC.Hvac_Control_Information2_MACTx = getvalue ( EnvHvac_Control_Information2_MACTx_);
	MSG_Hvac_Control_Information2_MAC.Hvac_Control_Information2_FVTx = getvalue ( EnvHvac_Control_Information2_FVTx_);
//	MSG_Hvac_Control_Information2_MAC.Hvac_Control_Information2_MACTx = 0;
//	MSG_Hvac_Control_Information2_MAC.Hvac_Control_Information2_FVTx = 0;
	MSG_Hvac_Control_Information2_MAC.View_RPC_APS_Sw_D_Qf = getvalue ( EnvView_RPC_APS_Sw_D_Qf_);
	MSG_Hvac_Control_Information2_MAC.View_RPC_APS_Sw_B_Actl = getvalue ( EnvView_RPC_APS_Sw_B_Actl_);
	MSG_Hvac_Control_Information2_MAC.HdcSw_D_Actl = getvalue ( EnvHdcSw_D_Actl_);
	MSG_Hvac_Control_Information2_MAC.FirstRowBuckleDriver = getvalue ( EnvFirstRowBuckleDriver_);
	MSG_Hvac_Control_Information2_MAC.ID42A_E2E_CNTProfile2 = getvalue ( EnvID42A_E2E_CNTProfile2_);
	MSG_Hvac_Control_Information2_MAC.ID42A_E2E_CRCProfile2 = getvalue ( EnvID42A_E2E_CRCProfile2_);

	/*  Output  */
	
//	MSG_Hvac_Control_Information2_MAC.Dlc = getvalue ( EnvHvac_Control_Information2_MACDlc_);
	 
	if(getvalue(EnvHvac_Control_Information2_MACTo_))
	{
//    if((tripCnt_HvacControlInformation2 != g_TripCnt) | (resetCnt_HvacControlInformation2 != g_ResetCnt)) {
//      tripCnt_HvacControlInformation2 = g_TripCnt;
//      resetCnt_HvacControlInformation2 = g_ResetCnt;
//      if(resetCnt_HvacControlInformation2 < 0xFFFFF) {
//        msgCnt_HvacControlInformation2 = 1;
//      }
//      else {
//        msgCnt_HvacControlInformation2 = 0xFF;
//      }
//    }
//    else{
//      if(msgCnt_HvacControlInformation2 < 0xFF) {
//        msgCnt_HvacControlInformation2 += 1;
//      }
//      else {
//        msgCnt_HvacControlInformation2 = 0xFF;
//      }
//    }
//    resetFlag_HvacControlInformation2 = resetCnt_HvacControlInformation2 & 0x03;
//    freshness = ((tripCnt_HvacControlInformation2 << 32) | (resetCnt_HvacControlInformation2 << 12)
//    | (msgCnt_HvacControlInformation2 << 4) | (resetFlag_HvacControlInformation2 << 2));
//    payload_HvacControlInformation2[0] =  MSG_Hvac_Control_Information2_MAC.byte(0);
//    payload_HvacControlInformation2[1] =  MSG_Hvac_Control_Information2_MAC.byte(1);
//    payload_HvacControlInformation2[2] =  MSG_Hvac_Control_Information2_MAC.byte(2);
//    payload_HvacControlInformation2[3] =  MSG_Hvac_Control_Information2_MAC.byte(3);
//  	result = LocalSecurityCalculateAuthenticator(MSG_Hvac_Control_Information2_MAC.id, payload_HvacControlInformation2, payloadLength, truncatedAuthenticator, truncatedAuthenticatorBitLength, freshness, truncatedFreshnessBitLength, freshnessValueBitLength);
//    
//    putValue(EnvHvac_Control_Information2_FVTx_, freshness);
//    putValue(EnvHvac_Control_Information2_MACTx_, truncatedAuthenticator);
//    MSG_Hvac_Control_Information2_MAC.Hvac_Control_Information2_MACTx = getvalue ( EnvHvac_Control_Information2_MACTx_);
//  	MSG_Hvac_Control_Information2_MAC.Hvac_Control_Information2_FVTx = getvalue ( EnvHvac_Control_Information2_FVTx_);
//    
//    
//  	MSG_Hvac_Control_Information2_MAC.Dlc = getvalue ( EnvHvac_Control_Information2_MACDlc_);
//    if (@EnvFHvac_Control_Info2_MAC) {
//      MSG_Hvac_Control_Information2_MAC.Hvac_Control_Information2_MACTx = getvalue ( EnvHvac_Control_Information2_MACTx_) / 2;
//    }
		output(MSG_Hvac_Control_Information2_MAC);
	}
	else
	{
		Write("Hvac_Control_Information2_MAC Message is not sent ");
	}
	 
	settimer(T_MSG_Hvac_Control_Information2_MAC,  50);
	 

}
//on timer T_MSG_Longitudinal_Lateral_deltaV 
//{
//	MSG_Longitudinal_Lateral_deltaV.Maximum_Lateral_deltaV_2 = getvalue ( EnvMaximum_Lateral_deltaV_2_);
//	MSG_Longitudinal_Lateral_deltaV.Maximum_Longitudinal_deltaV_2 = getvalue ( EnvMaximum_Longitudinal_deltaV_2_);
//	MSG_Longitudinal_Lateral_deltaV.Maximum_Lateral_deltaV_1 = getvalue ( EnvMaximum_Lateral_deltaV_1_);
//	MSG_Longitudinal_Lateral_deltaV.Maximum_Longitudinal_deltaV_1 = getvalue ( EnvMaximum_Longitudinal_deltaV_1_);
//
//	/*  Output  */
//	
//	MSG_Longitudinal_Lateral_deltaV.Dlc = getvalue ( EnvLongitudinal_Lateral_deltaVDlc_);
//	 
//	if(getvalue(EnvLongitudinal_Lateral_deltaVTo_))
//	{
//		output(MSG_Longitudinal_Lateral_deltaV);
//	}
//	else
//	{
//		Write("Longitudinal_Lateral_deltaV Message is not sent ");
//	}
//	 
//	settimer(T_MSG_Longitudinal_Lateral_deltaV,  getvalue(EnvLongitudinal_Lateral_deltaVTime_));
//	 
//
//}
//on timer T_MSG_YAW_Rate_Brake_Control_2_1_MAC 
//{
//	MSG_YAW_Rate_Brake_Control_2_1_MAC.YAW_Rate_Brake_Control_2_1_MACTx = getvalue ( EnvYAW_Rate_Brake_Control_2_1_MACTx_);
//	MSG_YAW_Rate_Brake_Control_2_1_MAC.YAW_Rate_Brake_Control_2_1_FVTx = getvalue ( EnvYAW_Rate_Brake_Control_2_1_FVTx_);
//	MSG_YAW_Rate_Brake_Control_2_1_MAC.VehSensSig2_1_No_Cs = getvalue ( EnvVehSensSig2_1_No_Cs_);
//	MSG_YAW_Rate_Brake_Control_2_1_MAC.VehSensSig2_1_No_Cnt = getvalue ( EnvVehSensSig2_1_No_Cnt_);
//	MSG_YAW_Rate_Brake_Control_2_1_MAC.HydraulicHoldCtl_D_Actl = getvalue ( EnvHydraulicHoldCtl_D_Actl_);
//	MSG_YAW_Rate_Brake_Control_2_1_MAC.VehLat_A_Actl = getvalue ( EnvVehLat_A_Actl_);
//	MSG_YAW_Rate_Brake_Control_2_1_MAC.VehLatAActl_D_Qf = getvalue ( EnvVehLatAActl_D_Qf_);
//
//	/*  Output  */
//	
//	MSG_YAW_Rate_Brake_Control_2_1_MAC.Dlc = getvalue ( EnvYAW_Rate_Brake_Control_2_1_MACDlc_);
//	 
//	if(getvalue(EnvYAW_Rate_Brake_Control_2_1_MACTo_))
//	{
//		output(MSG_YAW_Rate_Brake_Control_2_1_MAC);
//	}
//	else
//	{
//		Write("YAW_Rate_Brake_Control_2_1_MAC Message is not sent ");
//	}
//	 
//	settimer(T_MSG_YAW_Rate_Brake_Control_2_1_MAC,  getvalue(EnvYAW_Rate_Brake_Control_2_1_MACTime_));
//	 
//
//}
//on timer T_MSG_MACKSEND3 
//{
//	MSG_MACKSEND3.MACKSEND3_2 = getvalue ( EnvMACKSEND3_2_);
//	MSG_MACKSEND3.MACKSEND3_1 = getvalue ( EnvMACKSEND3_1_);
//
//	/*  Output  */
//	
//	MSG_MACKSEND3.Dlc = getvalue ( EnvMACKSEND3Dlc_);
//	 
//	if(getvalue(EnvMACKSEND3To_))
//	{
//		output(MSG_MACKSEND3);
//	}
//	else
//	{
//		Write("MACKSEND3 Message is not sent ");
//	}
//	 
//	settimer(T_MSG_MACKSEND3,  getvalue(EnvMACKSEND3Time_));
//	 
//
//}
//on timer T_MSG_EPAS_SAS_Info_1_MAC 
//{
//	MSG_EPAS_SAS_Info_1_MAC.EPAS_SAS_Info_1_MACTx = getvalue ( EnvEPAS_SAS_Info_1_MACTx_);
//	MSG_EPAS_SAS_Info_1_MAC.EPAS_SAS_Info_1_FVTx = getvalue ( EnvEPAS_SAS_Info_1_FVTx_);
//	MSG_EPAS_SAS_Info_1_MAC.SteAngReltv_An_Sns = getvalue ( EnvSteAngReltv_An_Sns_);
//	MSG_EPAS_SAS_Info_1_MAC.SteAng_CalStart = getvalue ( EnvSteAng_CalStart_);
//	MSG_EPAS_SAS_Info_1_MAC.SteAngRelAn_No_Cnt = getvalue ( EnvSteAngRelAn_No_Cnt_);
//	MSG_EPAS_SAS_Info_1_MAC.SteAngReltvAnSns_D_Qf = getvalue ( EnvSteAngReltvAnSns_D_Qf_);
//	MSG_EPAS_SAS_Info_1_MAC.SteAng_CalibStatus = getvalue ( EnvSteAng_CalibStatus_);
//	MSG_EPAS_SAS_Info_1_MAC.SteAngRelAn_No_CRC = getvalue ( EnvSteAngRelAn_No_CRC_);
//
//	/*  Output  */
//	
//	MSG_EPAS_SAS_Info_1_MAC.Dlc = getvalue ( EnvEPAS_SAS_Info_1_MACDlc_);
//	 
//	if(getvalue(EnvEPAS_SAS_Info_1_MACTo_))
//	{
//		output(MSG_EPAS_SAS_Info_1_MAC);
//	}
//	else
//	{
//		Write("EPAS_SAS_Info_1_MAC Message is not sent ");
//	}
//	 
//	settimer(T_MSG_EPAS_SAS_Info_1_MAC,  getvalue(EnvEPAS_SAS_Info_1_MACTime_));
//	 
//
//}
//on timer T_MSG_ADAS_SteeringCtrl_Data 
//{
//	MSG_ADAS_SteeringCtrl_Data.SteerMtrCurrent_I_Actl_088 = getvalue ( EnvSteerMtrCurrent_I_Actl_088_);
//	MSG_ADAS_SteeringCtrl_Data.ADAS_Eps_Final_Tq_Actl = getvalue ( EnvADAS_Eps_Final_Tq_Actl_);
//	MSG_ADAS_SteeringCtrl_Data.ADAS_Lock2Lock_An_Const = getvalue ( EnvADAS_Lock2Lock_An_Const_);
//	MSG_ADAS_SteeringCtrl_Data.ADAS_Assist_Tq_Actl = getvalue ( EnvADAS_Assist_Tq_Actl_);
//	MSG_ADAS_SteeringCtrl_Data.ADAS_SteOnOff_D_Actl = getvalue ( EnvADAS_SteOnOff_D_Actl_);
//	MSG_ADAS_SteeringCtrl_Data.ADAS_SteCtlActv_D_Actl = getvalue ( EnvADAS_SteCtlActv_D_Actl_);
//	MSG_ADAS_SteeringCtrl_Data.ADAS_SteCtlData_No_Cnt = getvalue ( EnvADAS_SteCtlData_No_Cnt_);
//	MSG_ADAS_SteeringCtrl_Data.EPS_State_ADAS = getvalue ( EnvEPS_State_ADAS_);
//	MSG_ADAS_SteeringCtrl_Data.ADAS_SteInhbt_B_Flag = getvalue ( EnvADAS_SteInhbt_B_Flag_);
//	MSG_ADAS_SteeringCtrl_Data.ADAS_StrCtrData_No_CRC = getvalue ( EnvADAS_StrCtrData_No_CRC_);
//
//	/*  Output  */
//	
//	MSG_ADAS_SteeringCtrl_Data.Dlc = getvalue ( EnvADAS_SteeringCtrl_DataDlc_);
//	 
//	if(getvalue(EnvADAS_SteeringCtrl_DataTo_))
//	{
//		output(MSG_ADAS_SteeringCtrl_Data);
//	}
//	else
//	{
//		Write("ADAS_SteeringCtrl_Data Message is not sent ");
//	}
//	 
//	settimer(T_MSG_ADAS_SteeringCtrl_Data,  getvalue(EnvADAS_SteeringCtrl_DataTime_));
//	 
//
//}
//on timer T_MSG_MACKVERI4 
//{
//	MSG_MACKVERI4.MACKVERI4_2 = getvalue ( EnvMACKVERI4_2_);
//	MSG_MACKVERI4.MACKVERI4_1 = getvalue ( EnvMACKVERI4_1_);
//
//	/*  Output  */
//	
//	MSG_MACKVERI4.Dlc = getvalue ( EnvMACKVERI4Dlc_);
//	 
//	if(getvalue(EnvMACKVERI4To_))
//	{
//		output(MSG_MACKVERI4);
//	}
//	else
//	{
//		Write("MACKVERI4 Message is not sent ");
//	}
//	 
//	settimer(T_MSG_MACKVERI4,  getvalue(EnvMACKVERI4Time_));
//	 
//
//}
//on timer T_MSG_ABS_Diag_Rx 
//{
//	MSG_ABS_Diag_Rx.ABS_Diag_Sig_Rx = getvalue ( EnvABS_Diag_Sig_Rx_);
//
//	/*  Output  */
//	
//	MSG_ABS_Diag_Rx.Dlc = getvalue ( EnvABS_Diag_RxDlc_);
//	 
//	if(getvalue(EnvABS_Diag_RxTo_))
//	{
//		output(MSG_ABS_Diag_Rx);
//	}
//	else
//	{
//		Write("ABS_Diag_Rx Message is not sent ");
//	}
//	 
//	settimer(T_MSG_ABS_Diag_Rx,  getvalue(EnvABS_Diag_RxTime_));
//	 
//
//}
//on timer T_MSG_WheelData2 
//{
//	MSG_WheelData2.VehVActlBrk2_No_Cs = getvalue ( EnvVehVActlBrk2_No_Cs_);
//	MSG_WheelData2.VehVActlBrk2_No_Cnt = getvalue ( EnvVehVActlBrk2_No_Cnt_);
//	MSG_WheelData2.WhlRotatRl_Direction = getvalue ( EnvWhlRotatRl_Direction_);
//	MSG_WheelData2.WhlRotatRr_Direction = getvalue ( EnvWhlRotatRr_Direction_);
//	MSG_WheelData2.WhlRotatFl_Direction = getvalue ( EnvWhlRotatFl_Direction_);
//	MSG_WheelData2.WhlRotatFr_Direction = getvalue ( EnvWhlRotatFr_Direction_);
//	MSG_WheelData2.WhlRotatRl2_No_Cnt = getvalue ( EnvWhlRotatRl2_No_Cnt_);
//	MSG_WheelData2.WhlRotatRr2_No_Cnt = getvalue ( EnvWhlRotatRr2_No_Cnt_);
//	MSG_WheelData2.WhlRotatFl2_No_Cnt = getvalue ( EnvWhlRotatFl2_No_Cnt_);
//	MSG_WheelData2.WhlRotatFr2_No_Cnt = getvalue ( EnvWhlRotatFr2_No_Cnt_);
//
//	/*  Output  */
//	
//	MSG_WheelData2.Dlc = getvalue ( EnvWheelData2Dlc_);
//	 
//	if(getvalue(EnvWheelData2To_))
//	{
//		output(MSG_WheelData2);
//	}
//	else
//	{
//		Write("WheelData2 Message is not sent ");
//	}
//	 
//	settimer(T_MSG_WheelData2,  getvalue(EnvWheelData2Time_));
//	 
//
//}
//on timer T_MSG_crashoutput_brk_MAC 
//{
//	MSG_crashoutput_brk_MAC.crashoutput_brk_MACTx = getvalue ( Envcrashoutput_brk_MACTx_);
//	MSG_crashoutput_brk_MAC.crashoutput_brk_FVTx = getvalue ( Envcrashoutput_brk_FVTx_);
//	MSG_crashoutput_brk_MAC.RcmStat_B_Actl_brk = getvalue ( EnvRcmStat_B_Actl_brk_);
//	MSG_crashoutput_brk_MAC.threshold_ovr_rollover_brk = getvalue ( Envthreshold_ovr_rollover_brk_);
//	MSG_crashoutput_brk_MAC.threshold_ovr_rear_brk = getvalue ( Envthreshold_ovr_rear_brk_);
//	MSG_crashoutput_brk_MAC.threshold_ovr_side_pass_brk = getvalue ( Envthreshold_ovr_side_pass_brk_);
//	MSG_crashoutput_brk_MAC.ID33F_E2E_CNTProfile2 = getvalue ( EnvID33F_E2E_CNTProfile2_);
//	MSG_crashoutput_brk_MAC.threshold_ovr_side_Driver_brk = getvalue ( Envthreshold_ovr_side_Driver_brk_);
//	MSG_crashoutput_brk_MAC.threshold_ovr_front_brk = getvalue ( Envthreshold_ovr_front_brk_);
//	MSG_crashoutput_brk_MAC.ID33F_E2E_CRCProfile2 = getvalue ( EnvID33F_E2E_CRCProfile2_);
//
//	/*  Output  */
//	
//	MSG_crashoutput_brk_MAC.Dlc = getvalue ( Envcrashoutput_brk_MACDlc_);
//	 
//	if(getvalue(Envcrashoutput_brk_MACTo_))
//	{
//		output(MSG_crashoutput_brk_MAC);
//	}
//	else
//	{
//		Write("crashoutput_brk_MAC Message is not sent ");
//	}
//	 
//	settimer(T_MSG_crashoutput_brk_MAC,  getvalue(Envcrashoutput_brk_MACTime_));
//	 
//
//}
//on timer T_MSG_DirectYawMomentControlRequest 
//{
//	MSG_DirectYawMomentControlRequest.MotRev_N_Actl = getvalue ( EnvMotRev_N_Actl_);
//	MSG_DirectYawMomentControlRequest.DYC_FrontBackRatio = getvalue ( EnvDYC_FrontBackRatio_);
//	MSG_DirectYawMomentControlRequest.DYC_TargetYawMoment = getvalue ( EnvDYC_TargetYawMoment_);
//	MSG_DirectYawMomentControlRequest.DYC_RequestFlag = getvalue ( EnvDYC_RequestFlag_);
//	MSG_DirectYawMomentControlRequest.ID0FE_E2E_CNTProfile2 = getvalue ( EnvID0FE_E2E_CNTProfile2_);
//	//Simulate value for testcase Tsync.
//  data_simulate = getvalue(Env_24EDR_sampleDataT0);
//  if(data_simulate == 0x0C){
//    @EnvMotRev_N_Actl_ += 10;
//  	if (@EnvMotRev_N_Actl_ > 42000){
//  		@EnvMotRev_N_Actl_ = 0;
//  	}
//  }
//  MSG_DirectYawMomentControlRequest.ID0FE_E2E_CRCProfile2 = getvalue ( EnvID0FE_E2E_CRCProfile2_);
//  
//  if(data_selection == 0xC)
//	{
//	if(use_case == 0) // use case 1: Invalid - Unobtain 
//	{ 
//		if (Unobtain_pattern != 0)
//		{
//			if (Invalid_pattern > 0)
//			{
//				Invalid_pattern--;
//				putvalue(EnvDirectYawMomentControlRequestTo_,1);
//				MSG_DirectYawMomentControlRequest.MotRev_N_Actl = 42001;
//			}else
//			{
//				putvalue(EnvDirectYawMomentControlRequestTo_,0);
//        Unobtain_pattern--;
//			}
//		}else
//			{
//        putvalue(EnvDirectYawMomentControlRequestTo_,1);
//				Invalid_pattern = getvalue(Env_24EDR_Invalid_)-1;
//				Unobtain_pattern = getvalue(Env_24EDR_Unobtain_);
//			}
//	}else if (use_case == 1) //use case 2 : invalid - valid
//	{
//		if(Valid_pattern > 0)
//		{
//			if(Invalid_pattern > 0)
//			{
//				Invalid_pattern--;
//        MSG_DirectYawMomentControlRequest.MotRev_N_Actl = 42001;
//			}else
//			{
//				Valid_pattern --;
//			}
//		}else
//		{
//      MSG_DirectYawMomentControlRequest.MotRev_N_Actl = 42001;
//			Invalid_pattern = getvalue(Env_24EDR_Invalid_)-1;
//			Valid_pattern = getvalue(Env_24EDR_Valid_);
//		}
//		
//	}else if (use_case == 2) //use case 2: unobtain - valid
//  {
//    if(Valid_pattern > 0)
//		{
//			if(Unobtain_pattern != 0)
//			{
//				Unobtain_pattern--;
//				putvalue(EnvDirectYawMomentControlRequestTo_,0);
//			}else
//			{
//				Valid_pattern --;
//        putvalue(EnvDirectYawMomentControlRequestTo_,1);
//			}
//		}else
//		{
//			putvalue(EnvDirectYawMomentControlRequestTo_,0);
//			Unobtain_pattern = getvalue(Env_24EDR_Unobtain_)-1;
//			Valid_pattern = getvalue(Env_24EDR_Valid_);
//		}
//  }
//	}
//	/*  Output  */
//	MSG_DirectYawMomentControlRequest.Dlc = getvalue ( EnvDirectYawMomentControlRequestDlc_);
//	 
//	if(getvalue(EnvDirectYawMomentControlRequestTo_))
//	{
//		output(MSG_DirectYawMomentControlRequest);
//	}
//	else
//	{
//		Write("DirectYawMomentControlRequest Message is not sent ");
//	}
//	
//	settimer(T_MSG_DirectYawMomentControlRequest,  getvalue(EnvDirectYawMomentControlRequestTime_));
//	
//
//}
on timer T_MSG_AEB_Longitudinal_Request_Pt_MAC 
{
//  byte payloadLength = 4;
//  qword truncatedAuthenticator;
//  dword truncatedAuthenticatorBitLength = 28;
//  qword freshness;
//  dword truncatedFreshnessBitLength = 4;
//  dword freshnessValueBitLength = 48;
//  long result;
	MSG_AEB_Longitudinal_Request_Pt_MAC.AEB_Longitudinal_Req_Pt_MACTx = getvalue ( EnvAEB_Longitudinal_Req_Pt_MACTx_);
	MSG_AEB_Longitudinal_Request_Pt_MAC.AEB_Longitudinal_Req_Pt_FVTx = getvalue ( EnvAEB_Longitudinal_Req_Pt_FVTx_);
//	MSG_AEB_Longitudinal_Request_Pt_MAC.AEB_Longitudinal_Req_Pt_MACTx = 0;
//	MSG_AEB_Longitudinal_Request_Pt_MAC.AEB_Longitudinal_Req_Pt_FVTx = 0;
	MSG_AEB_Longitudinal_Request_Pt_MAC.Request_AEB_Set_Flag = getvalue ( EnvRequest_AEB_Set_Flag_);
	MSG_AEB_Longitudinal_Request_Pt_MAC.Request_AEB_Acceleration = getvalue ( EnvRequest_AEB_Acceleration_);
	MSG_AEB_Longitudinal_Request_Pt_MAC.AEB_Types_pt = getvalue ( EnvAEB_Types_pt_);
	MSG_AEB_Longitudinal_Request_Pt_MAC.ID213_No_Cnt = getvalue ( EnvID213_No_Cnt_);
	MSG_AEB_Longitudinal_Request_Pt_MAC.AEB_Fail_Flag_Pt = getvalue ( EnvAEB_Fail_Flag_Pt_);
	MSG_AEB_Longitudinal_Request_Pt_MAC.ID213_No_Cs = getvalue ( EnvID213_No_Cs_);

	/*  Output  */
	
	MSG_AEB_Longitudinal_Request_Pt_MAC.Dlc = getvalue ( EnvAEB_Longitudinal_Request_Pt_MACDlc_);
	 
	if(getvalue(EnvAEB_Longitudinal_Request_Pt_MACTo_))
	{
//    if((tripCnt_AEBLongReqPt != g_TripCnt) | (resetCnt_AEBLongReqPt != g_ResetCnt)) {
//      tripCnt_AEBLongReqPt = g_TripCnt;
//      resetCnt_AEBLongReqPt = g_ResetCnt;
//      if(resetCnt_AEBLongReqPt < 0xFFFFF) {
//        msgCnt_AEBLongReqPt = 1;
//      }
//      else {
//        msgCnt_AEBLongReqPt = 0xFF;
//      }
//    }
//    else{
//      if(msgCnt_AEBLongReqPt < 0xFF) {
//        msgCnt_AEBLongReqPt += 1;
//      }
//      else {
//        msgCnt_AEBLongReqPt = 0xFF;
//      }
//    }
//    resetFlag_AEBLongReqPt = resetCnt_AEBLongReqPt & 0x03;
//    freshness = ((tripCnt_AEBLongReqPt << 32) | (resetCnt_AEBLongReqPt << 12)
//    | (msgCnt_AEBLongReqPt << 4) | (resetFlag_AEBLongReqPt << 2));
//    payload_AEBLongReqPt[0] =  MSG_AEB_Longitudinal_Request_Pt_MAC.byte(0);
//    payload_AEBLongReqPt[1] =  MSG_AEB_Longitudinal_Request_Pt_MAC.byte(1);
//    payload_AEBLongReqPt[2] =  MSG_AEB_Longitudinal_Request_Pt_MAC.byte(2);
//    payload_AEBLongReqPt[3] =  MSG_AEB_Longitudinal_Request_Pt_MAC.byte(3);
//  	result = LocalSecurityCalculateAuthenticator(MSG_AEB_Longitudinal_Request_Pt_MAC.id, payload_AEBLongReqPt, payloadLength, truncatedAuthenticator, truncatedAuthenticatorBitLength, freshness, truncatedFreshnessBitLength, freshnessValueBitLength);
//    
//    putValue(EnvAEB_Longitudinal_Req_Pt_FVTx_, freshness);
//    putValue(EnvAEB_Longitudinal_Req_Pt_MACTx_, truncatedAuthenticator);
//    MSG_AEB_Longitudinal_Request_Pt_MAC.AEB_Longitudinal_Req_Pt_MACTx = getvalue ( EnvAEB_Longitudinal_Req_Pt_MACTx_);
//  	MSG_AEB_Longitudinal_Request_Pt_MAC.AEB_Longitudinal_Req_Pt_FVTx = getvalue ( EnvAEB_Longitudinal_Req_Pt_FVTx_);
//    
//    if(@EnvFAEB_Longitudinal_Reqt_Pt_MAC){
//      MSG_AEB_Longitudinal_Request_Pt_MAC.AEB_Longitudinal_Req_Pt_MACTx = getvalue ( EnvAEB_Longitudinal_Req_Pt_MACTx_) / 2;
//    }
		output(MSG_AEB_Longitudinal_Request_Pt_MAC);
	}
	else
	{
		 Write("AEB_Longitudinal_Request_Pt_MAC Message is not sent ");
	}
	 
	settimer(T_MSG_AEB_Longitudinal_Request_Pt_MAC,  getvalue(EnvAEB_Longitudinal_Request_Pt_MACTime_));
	 

}
on timer T_MSG_BrakeSysFeatures_MAC 
{
//  byte payloadLength = 4;
//  qword truncatedAuthenticator;
//  dword truncatedAuthenticatorBitLength = 28;
//  qword freshness;
//  dword truncatedFreshnessBitLength = 4;
//  dword freshnessValueBitLength = 48;
//  long result;
	MSG_BrakeSysFeatures_MAC.BrakeSysFeatures_MACTx = getvalue ( EnvBrakeSysFeatures_MACTx_);
	MSG_BrakeSysFeatures_MAC.BrakeSysFeatures_FVTx = getvalue ( EnvBrakeSysFeatures_FVTx_);
	MSG_BrakeSysFeatures_MAC.BrakeSysFeatures_MAC_No_Cs = getvalue ( EnvBrakeSysFeatures_MAC_No_Cs_);
	MSG_BrakeSysFeatures_MAC.BrakeSysFeatures_MAC_No_Cnt = getvalue ( EnvBrakeSysFeatures_MAC_No_Cnt_);
	MSG_BrakeSysFeatures_MAC.BrkStkRatio = getvalue ( EnvBrkStkRatio_);
	MSG_BrakeSysFeatures_MAC.PrkBrkActv_D_Actl = getvalue ( EnvPrkBrkActv_D_Actl_);
	MSG_BrakeSysFeatures_MAC.DrvSlipCtlMde_D_Ind = getvalue ( EnvDrvSlipCtlMde_D_Ind_);
	MSG_BrakeSysFeatures_MAC.DrvSlipCtlLamp_D_Rq = getvalue ( EnvDrvSlipCtlLamp_D_Rq_);
	MSG_BrakeSysFeatures_MAC.DrvAntiLckLamp_D_Rq = getvalue ( EnvDrvAntiLckLamp_D_Rq_);
	MSG_BrakeSysFeatures_MAC.BrkCtlLamp_D_Rq = getvalue ( EnvBrkCtlLamp_D_Rq_);
	MSG_BrakeSysFeatures_MAC.ParkBrkTelltale_B_Actl = getvalue ( EnvParkBrkTelltale_B_Actl_);
	MSG_BrakeSysFeatures_MAC.BrkLamp_B_Rq = getvalue ( EnvBrkLamp_B_Rq_);

	/*  Output  */
	if(data_selection == 0x09)
	{
	if(use_case == 0) // use case 1: Invalid - Unobtain 
	{
		if (Unobtain_pattern != 0)
		{
			if (Invalid_pattern > 0)
			{
				Invalid_pattern--;
				putvalue(EnvBrakeSysFeatures_MACTo_,1);
				MSG_BrakeSysFeatures_MAC.BrakeSysFeatures_MAC_No_Cs = 0;
			}else
			{
				putvalue(EnvBrakeSysFeatures_MACTo_,0);
        Unobtain_pattern--;
			}
		}else
			{
        putvalue(EnvBrakeSysFeatures_MACTo_,1);
				Invalid_pattern = getvalue(Env_24EDR_Invalid_)-1;
				Unobtain_pattern = getvalue(Env_24EDR_Unobtain_);
			}
	}else if (use_case == 1) //use case 2 : invalid - valid
	{
		if(Valid_pattern > 0)
		{
			if(Invalid_pattern > 0)
			{
				Invalid_pattern--;
				MSG_BrakeSysFeatures_MAC.BrakeSysFeatures_MAC_No_Cs = 0;
			}else
			{
				Valid_pattern --;
			}
		}else
		{
		MSG_BrakeSysFeatures_MAC.BrakeSysFeatures_MAC_No_Cs = 0;
			Invalid_pattern = getvalue(Env_24EDR_Invalid_)-1;
			Valid_pattern = getvalue(Env_24EDR_Valid_);
		}
		
	}else if (use_case == 2) //use case 2: unobtain - valid
  {
    if(Valid_pattern > 0)
		{
			if(Unobtain_pattern != 0)
			{
				Unobtain_pattern--;
				putvalue(EnvBrakeSysFeatures_MACTo_,0);
			}else
			{
				Valid_pattern --;
        putvalue(EnvBrakeSysFeatures_MACTo_,1);
			}
		}else
		{
			putvalue(EnvBrakeSysFeatures_MACTo_,0);
			Unobtain_pattern = getvalue(Env_24EDR_Unobtain_)-1;
			Valid_pattern = getvalue(Env_24EDR_Valid_);
		}
  }
	}	
	MSG_BrakeSysFeatures_MAC.Dlc = getvalue ( EnvBrakeSysFeatures_MACDlc_);
	 
	if(getvalue(EnvBrakeSysFeatures_MACTo_))
	{
//    if((tripCnt_BrakeSysFeatures != g_TripCnt) | (resetCnt_BrakeSysFeatures != g_ResetCnt)) {
//      tripCnt_BrakeSysFeatures = g_TripCnt;
//      resetCnt_BrakeSysFeatures = g_ResetCnt;
//      if(resetCnt_BrakeSysFeatures < 0xFFFFF) {
//        msgCnt_BrakeSysFeatures = 1;
//      }
//      else {
//        msgCnt_BrakeSysFeatures = 0xFF;
//      }
//    }
//    else{
//      if(msgCnt_BrakeSysFeatures < 0xFF) {
//        msgCnt_BrakeSysFeatures += 1;
//      }
//      else {
//        msgCnt_BrakeSysFeatures = 0xFF;
//      }
//    }
//    resetFlag_BrakeSysFeatures = resetCnt_BrakeSysFeatures & 0x03;
//    freshness = ((tripCnt_BrakeSysFeatures << 32) | (resetCnt_BrakeSysFeatures << 12)
//    | (msgCnt_BrakeSysFeatures << 4) | (resetFlag_BrakeSysFeatures << 2));
//    payload_BrakeSysFeatures[0] =  MSG_BrakeSysFeatures_MAC.byte(0);
//    payload_BrakeSysFeatures[1] =  MSG_BrakeSysFeatures_MAC.byte(1);
//    payload_BrakeSysFeatures[2] =  MSG_BrakeSysFeatures_MAC.byte(2);
//    payload_BrakeSysFeatures[3] =  MSG_BrakeSysFeatures_MAC.byte(3);
//  	result = LocalSecurityCalculateAuthenticator(MSG_BrakeSysFeatures_MAC.id, payload_BrakeSysFeatures, payloadLength, truncatedAuthenticator, truncatedAuthenticatorBitLength, freshness, truncatedFreshnessBitLength, freshnessValueBitLength);
//    
//    putValue(EnvBrakeSysFeatures_FVTx_, freshness);
//    putValue(EnvBrakeSysFeatures_MACTx_, truncatedAuthenticator);
//    MSG_BrakeSysFeatures_MAC.BrakeSysFeatures_MACTx = getvalue ( EnvBrakeSysFeatures_MACTx_);
//  	MSG_BrakeSysFeatures_MAC.BrakeSysFeatures_FVTx = getvalue ( EnvBrakeSysFeatures_FVTx_);
//    
//    if(@EnvFBrakeSysFeatures_MAC){
//      MSG_BrakeSysFeatures_MAC.BrakeSysFeatures_MACTx = getvalue ( EnvBrakeSysFeatures_MACTx_) / 2;
//    }
		output(MSG_BrakeSysFeatures_MAC);
	}
	else
	{
		Write("BrakeSysFeatures_MAC Message is not sent ");
	}
	 
	settimer(T_MSG_BrakeSysFeatures_MAC,  getvalue(EnvBrakeSysFeatures_MACTime_));

}
//on timer T_MSG_CBCM_Autosar_NM 
//{
//	MSG_CBCM_Autosar_NM.CGW_NM_UserData5 = getvalue ( EnvCGW_NM_UserData5_);
//	MSG_CBCM_Autosar_NM.CGW_NM_UserData4 = getvalue ( EnvCGW_NM_UserData4_);
//	MSG_CBCM_Autosar_NM.CGW_NM_UserData3 = getvalue ( EnvCGW_NM_UserData3_);
//	MSG_CBCM_Autosar_NM.CGW_NM_UserData2 = getvalue ( EnvCGW_NM_UserData2_);
//	MSG_CBCM_Autosar_NM.CGW_NM_UserData1 = getvalue ( EnvCGW_NM_UserData1_);
//	MSG_CBCM_Autosar_NM.CGW_NM_UserData0 = getvalue ( EnvCGW_NM_UserData0_);
//	MSG_CBCM_Autosar_NM.CGW_NM_RptMsgRequest = getvalue ( EnvCGW_NM_RptMsgRequest_);
//	MSG_CBCM_Autosar_NM.CGW_NM_SourceNodeID = getvalue ( EnvCGW_NM_SourceNodeID_);
//
//	/*  Output  */
//	
//	MSG_CBCM_Autosar_NM.Dlc = getvalue ( EnvCBCM_Autosar_NMDlc_);
//	 
//	if(getvalue(EnvCBCM_Autosar_NMTo_))
//	{
//		output(MSG_CBCM_Autosar_NM);
//	}
//	else
//	{
//		Write("CBCM_Autosar_NM Message is not sent ");
//	}
//	 
//	settimer(T_MSG_CBCM_Autosar_NM,  getvalue(EnvCBCM_Autosar_NMTime_));
//	 
//
//}
//on timer T_MSG_WheelData_1_MAC 
//{
//	MSG_WheelData_1_MAC.WheelData_1_MACTx = getvalue ( EnvWheelData_1_MACTx_);
//	MSG_WheelData_1_MAC.WheelData_1_FVTx = getvalue ( EnvWheelData_1_FVTx_);
//	MSG_WheelData_1_MAC.WhlRotatRl_No_Cnt = getvalue ( EnvWhlRotatRl_No_Cnt_);
//	MSG_WheelData_1_MAC.WhlRotatRr_No_Cnt = getvalue ( EnvWhlRotatRr_No_Cnt_);
//	MSG_WheelData_1_MAC.WhlRotatFl_No_Cnt = getvalue ( EnvWhlRotatFl_No_Cnt_);
//	MSG_WheelData_1_MAC.WhlRotatFr_No_Cnt = getvalue ( EnvWhlRotatFr_No_Cnt_);
//
//	/*  Output  */
//	
//	MSG_WheelData_1_MAC.Dlc = getvalue ( EnvWheelData_1_MACDlc_);
//	 
//	if(getvalue(EnvWheelData_1_MACTo_))
//	{
//		output(MSG_WheelData_1_MAC);
//	}
//	else
//	{
//		Write("WheelData_1_MAC Message is not sent ");
//	}
//	 
//	settimer(T_MSG_WheelData_1_MAC,  getvalue(EnvWheelData_1_MACTime_));
//	 
//
//}
on timer T_MSG_GCC_Config_Mgmt 
{
    MSG_GCC_Config_Mgmt.Central_CRC = getvalue ( EnvCentral_CRC_);
    MSG_GCC_Config_Mgmt.CDID_Total_Number = getvalue ( EnvCDID_Total_Number_);
    MSG_GCC_Config_Mgmt.Reserved_E0_2 = getvalue ( EnvReserved_E0_2_);
    MSG_GCC_Config_Mgmt.Reserved_E0_1 = getvalue ( EnvReserved_E0_1_);
    MSG_GCC_Config_Mgmt.Reserved_95_7 = getvalue ( EnvReserved_95_7_);
    MSG_GCC_Config_Mgmt.Reserved_95_6 = getvalue ( EnvReserved_95_6_);
    MSG_GCC_Config_Mgmt.Reserved_95_5 = getvalue ( EnvReserved_95_5_);
    MSG_GCC_Config_Mgmt.Reserved_95_4 = getvalue ( EnvReserved_95_4_);
    MSG_GCC_Config_Mgmt.Reserved_95_3 = getvalue ( EnvReserved_95_3_);
    MSG_GCC_Config_Mgmt.Reserved_95_2 = getvalue ( EnvReserved_95_2_);
    MSG_GCC_Config_Mgmt.Reserved_95_1 = getvalue ( EnvReserved_95_1_);
    MSG_GCC_Config_Mgmt.Reserved_94_7 = getvalue ( EnvReserved_94_7_);
    MSG_GCC_Config_Mgmt.Reserved_94_6 = getvalue ( EnvReserved_94_6_);
    MSG_GCC_Config_Mgmt.Reserved_94_5 = getvalue ( EnvReserved_94_5_);
    MSG_GCC_Config_Mgmt.Reserved_94_4 = getvalue ( EnvReserved_94_4_);
    MSG_GCC_Config_Mgmt.Reserved_94_3 = getvalue ( EnvReserved_94_3_);
    MSG_GCC_Config_Mgmt.Reserved_94_2 = getvalue ( EnvReserved_94_2_);
    MSG_GCC_Config_Mgmt.Reserved_94_1 = getvalue ( EnvReserved_94_1_);
    MSG_GCC_Config_Mgmt.Reserved_93_7 = getvalue ( EnvReserved_93_7_);
    MSG_GCC_Config_Mgmt.Reserved_93_6 = getvalue ( EnvReserved_93_6_);
    MSG_GCC_Config_Mgmt.Reserved_93_5 = getvalue ( EnvReserved_93_5_);
    MSG_GCC_Config_Mgmt.Reserved_93_4 = getvalue ( EnvReserved_93_4_);
    MSG_GCC_Config_Mgmt.Reserved_93_3 = getvalue ( EnvReserved_93_3_);
    MSG_GCC_Config_Mgmt.Reserved_93_2 = getvalue ( EnvReserved_93_2_);
    MSG_GCC_Config_Mgmt.Reserved_93_1 = getvalue ( EnvReserved_93_1_);
    MSG_GCC_Config_Mgmt.Reserved_92_7 = getvalue ( EnvReserved_92_7_);
    MSG_GCC_Config_Mgmt.Reserved_92_6 = getvalue ( EnvReserved_92_6_);
    MSG_GCC_Config_Mgmt.Reserved_92_5 = getvalue ( EnvReserved_92_5_);
    MSG_GCC_Config_Mgmt.Reserved_92_4 = getvalue ( EnvReserved_92_4_);
    MSG_GCC_Config_Mgmt.Reserved_92_3 = getvalue ( EnvReserved_92_3_);
    MSG_GCC_Config_Mgmt.Reserved_92_2 = getvalue ( EnvReserved_92_2_);
    MSG_GCC_Config_Mgmt.Reserved_92_1 = getvalue ( EnvReserved_92_1_);
    MSG_GCC_Config_Mgmt.Reserved_91_7 = getvalue ( EnvReserved_91_7_);
    MSG_GCC_Config_Mgmt.Reserved_91_6 = getvalue ( EnvReserved_91_6_);
    MSG_GCC_Config_Mgmt.Reserved_91_5 = getvalue ( EnvReserved_91_5_);
    MSG_GCC_Config_Mgmt.Reserved_91_4 = getvalue ( EnvReserved_91_4_);
    MSG_GCC_Config_Mgmt.Reserved_91_3 = getvalue ( EnvReserved_91_3_);
    MSG_GCC_Config_Mgmt.Reserved_91_2 = getvalue ( EnvReserved_91_2_);
    MSG_GCC_Config_Mgmt.Reserved_91_1 = getvalue ( EnvReserved_91_1_);
    MSG_GCC_Config_Mgmt.Reserved_90_7 = getvalue ( EnvReserved_90_7_);
    MSG_GCC_Config_Mgmt.Reserved_90_6 = getvalue ( EnvReserved_90_6_);
    MSG_GCC_Config_Mgmt.Reserved_90_5 = getvalue ( EnvReserved_90_5_);
    MSG_GCC_Config_Mgmt.Reserved_90_4 = getvalue ( EnvReserved_90_4_);
    MSG_GCC_Config_Mgmt.Reserved_90_3 = getvalue ( EnvReserved_90_3_);
    MSG_GCC_Config_Mgmt.Reserved_90_2 = getvalue ( EnvReserved_90_2_);
    MSG_GCC_Config_Mgmt.Reserved_90_1 = getvalue ( EnvReserved_90_1_);
    MSG_GCC_Config_Mgmt.Reserved_82_8 = getvalue ( EnvReserved_82_8_);
    MSG_GCC_Config_Mgmt.Reserved_82_7 = getvalue ( EnvReserved_82_7_);
//    MSG_GCC_Config_Mgmt.ALEXA = getvalue ( EnvALEXA_);
    MSG_GCC_Config_Mgmt.ASE_SYSTEM = getvalue ( EnvASE_SYSTEM_);
    MSG_GCC_Config_Mgmt.WIRELESS_CHARGE = getvalue ( EnvWIRELESS_CHARGE_);
    MSG_GCC_Config_Mgmt.FBUMPER_ASSY_TYPE = getvalue ( EnvFBUMPER_ASSY_TYPE_);
    MSG_GCC_Config_Mgmt.FBUMPER_SHAPE_TYPE = getvalue ( EnvFBUMPER_SHAPE_TYPE_);
    MSG_GCC_Config_Mgmt.EMERGENCY_DRIVER_ASSIST = getvalue ( EnvEMERGENCY_DRIVER_ASSIST_);
    MSG_GCC_Config_Mgmt.VMC_COMMUNICATION_TYPE = getvalue ( EnvVMC_COMMUNICATION_TYPE_);
    MSG_GCC_Config_Mgmt.VMC_POSITION = getvalue ( EnvVMC_POSITION_);
    MSG_GCC_Config_Mgmt.Reserved_82_3 = getvalue ( EnvReserved_82_3_);
    MSG_GCC_Config_Mgmt.INTERSECTION_BRAKE_SUPP = getvalue ( EnvINTERSECTION_BRAKE_SUPP_);
    MSG_GCC_Config_Mgmt.PERSONALIZE_SYSTEM = getvalue ( EnvPERSONALIZE_SYSTEM_);
    MSG_GCC_Config_Mgmt.TAP = getvalue ( EnvTAP_);
    MSG_GCC_Config_Mgmt.Reserved_80_5 = getvalue ( EnvReserved_80_5_);
//    MSG_GCC_Config_Mgmt.ENGINE_POWER_TYPE = getvalue ( EnvENGINE_POWER_TYPE_);
    MSG_GCC_Config_Mgmt.Number_Of_Cylinders = getvalue ( EnvNumber_Of_Cylinders_);
    MSG_GCC_Config_Mgmt.TURBO_ENGINE = getvalue ( EnvTURBO_ENGINE_);
    MSG_GCC_Config_Mgmt.CYLINDER_DEACTIVATION = getvalue ( EnvCYLINDER_DEACTIVATION_);
    MSG_GCC_Config_Mgmt.UPGRADE_ENGINE = getvalue ( EnvUPGRADE_ENGINE_);
    MSG_GCC_Config_Mgmt.ENGINE_TYPE = getvalue ( EnvENGINE_TYPE_);
    MSG_GCC_Config_Mgmt.Reserved_80_3 = getvalue ( EnvReserved_80_3_);
//    MSG_GCC_Config_Mgmt.AC_CHARGING_TYPE = getvalue ( EnvAC_CHARGING_TYPE_);
//    MSG_GCC_Config_Mgmt.DC_CHARGING_TYPE = getvalue ( EnvDC_CHARGING_TYPE_);
    MSG_GCC_Config_Mgmt.AUX_POWER_UNIT = getvalue ( EnvAUX_POWER_UNIT_);
    MSG_GCC_Config_Mgmt.Reserved_80_1 = getvalue ( EnvReserved_80_1_);
    MSG_GCC_Config_Mgmt.XEV_TYPE = getvalue ( EnvXEV_TYPE_);
    MSG_GCC_Config_Mgmt.Reserved_72_3 = getvalue ( EnvReserved_72_3_);
    MSG_GCC_Config_Mgmt.Reserved_72_4 = getvalue ( EnvReserved_72_4_);
    MSG_GCC_Config_Mgmt.REMOTE_ENGINE_START_OPT = getvalue ( EnvREMOTE_ENGINE_START_OPT_);
    MSG_GCC_Config_Mgmt.DOWN_LIGHT = getvalue ( EnvDOWN_LIGHT_);
    MSG_GCC_Config_Mgmt.KEYLESS_WINDOW_CONTROL = getvalue ( EnvKEYLESS_WINDOW_CONTROL_);
    MSG_GCC_Config_Mgmt.KEY_LESS_COMPT = getvalue ( EnvKEY_LESS_COMPT_);
    MSG_GCC_Config_Mgmt.SMART_KEYLESS = getvalue ( EnvSMART_KEYLESS_);
    MSG_GCC_Config_Mgmt.KEY_LESS_ENTRY = getvalue ( EnvKEY_LESS_ENTRY_);
    MSG_GCC_Config_Mgmt.Reserved_72_2 = getvalue ( EnvReserved_72_2_);
    MSG_GCC_Config_Mgmt.REMINDER_CONTROL_SPEC = getvalue ( EnvREMINDER_CONTROL_SPEC_);
    MSG_GCC_Config_Mgmt.SEAT_BELT_WARNING_SYSTEM = getvalue ( EnvSEAT_BELT_WARNING_SYSTEM_);
    MSG_GCC_Config_Mgmt.OCCUPANT_SENSING_SYSTEM = getvalue ( EnvOCCUPANT_SENSING_SYSTEM_);
    MSG_GCC_Config_Mgmt.Reserved_70_4 = getvalue ( EnvReserved_70_4_);
    MSG_GCC_Config_Mgmt.R_SEAT_NO2_TYPE = getvalue ( EnvR_SEAT_NO2_TYPE_);
    MSG_GCC_Config_Mgmt.R_SEAT_NO1_TYPE = getvalue ( EnvR_SEAT_NO1_TYPE_);
    MSG_GCC_Config_Mgmt.EXTERIOR_ALERT_TYPE = getvalue ( EnvEXTERIOR_ALERT_TYPE_);
    MSG_GCC_Config_Mgmt.CPD_CONTROL_TYPE = getvalue ( EnvCPD_CONTROL_TYPE_);
    MSG_GCC_Config_Mgmt.Reserved_70_3 = getvalue ( EnvReserved_70_3_);
    MSG_GCC_Config_Mgmt.F_SEAT_VENTILATION = getvalue ( EnvF_SEAT_VENTILATION_);
    MSG_GCC_Config_Mgmt.F_SEAT_TYPE = getvalue ( EnvF_SEAT_TYPE_);
    MSG_GCC_Config_Mgmt.Reserved_70_2 = getvalue ( EnvReserved_70_2_);
    MSG_GCC_Config_Mgmt.R_SEAT_WARMER = getvalue ( EnvR_SEAT_WARMER_);
    MSG_GCC_Config_Mgmt.F_SEAT_WARMER = getvalue ( EnvF_SEAT_WARMER_);
    MSG_GCC_Config_Mgmt.Reserved_70_1 = getvalue ( EnvReserved_70_1_);
    MSG_GCC_Config_Mgmt.F_SEAT_LIFT_MECHANISM = getvalue ( EnvF_SEAT_LIFT_MECHANISM_);
    MSG_GCC_Config_Mgmt.SEAT_MATERIAL = getvalue ( EnvSEAT_MATERIAL_);
    MSG_GCC_Config_Mgmt.Reserved_63_1 = getvalue ( EnvReserved_63_1_);
    MSG_GCC_Config_Mgmt.Vehicle_Height = getvalue ( EnvVehicle_Height_);
    MSG_GCC_Config_Mgmt.Vehicle_Width = getvalue ( EnvVehicle_Width_);
    MSG_GCC_Config_Mgmt.Vehicle_Length = getvalue ( EnvVehicle_Length_);
    MSG_GCC_Config_Mgmt.Reserved_62_2 = getvalue ( EnvReserved_62_2_);
    MSG_GCC_Config_Mgmt.TOUCH_PANEL = getvalue ( EnvTOUCH_PANEL_);
    MSG_GCC_Config_Mgmt.DISPLAY_SIZE = getvalue ( EnvDISPLAY_SIZE_);
    MSG_GCC_Config_Mgmt.HD_Radio = getvalue ( EnvHD_Radio_);
    MSG_GCC_Config_Mgmt.TELEMATICS_COM_UNIT = getvalue ( EnvTELEMATICS_COM_UNIT_);
    MSG_GCC_Config_Mgmt.B_CALL = getvalue ( EnvB_CALL_);
    MSG_GCC_Config_Mgmt.CMU_Spec = getvalue ( EnvCMU_Spec_);
    MSG_GCC_Config_Mgmt.Number_Of_Seat_Rows = getvalue ( EnvNumber_Of_Seat_Rows_);
    MSG_GCC_Config_Mgmt.Tuner_AM_Range = getvalue ( EnvTuner_AM_Range_);
    MSG_GCC_Config_Mgmt.Pandora = getvalue ( EnvPandora_);
    MSG_GCC_Config_Mgmt.Mobile_911 = getvalue ( EnvMobile_911_);
    MSG_GCC_Config_Mgmt.HDMI = getvalue ( EnvHDMI_);
    MSG_GCC_Config_Mgmt.LW = getvalue ( EnvLW_);
    MSG_GCC_Config_Mgmt.Limit_Of_DAB_Range = getvalue ( EnvLimit_Of_DAB_Range_);
    MSG_GCC_Config_Mgmt.ELK_CUSTOMIZE_TYPE = getvalue ( EnvELK_CUSTOMIZE_TYPE_);
    MSG_GCC_Config_Mgmt.Microphone = getvalue ( EnvMicrophone_);
    MSG_GCC_Config_Mgmt.DAA_Default = getvalue ( EnvDAA_Default_);
    MSG_GCC_Config_Mgmt.Carplay = getvalue ( EnvCarplay_);
    MSG_GCC_Config_Mgmt.Android_Auto = getvalue ( EnvAndroid_Auto_);
    MSG_GCC_Config_Mgmt.Wi_Fi_Frequency = getvalue ( EnvWi_Fi_Frequency_);
    MSG_GCC_Config_Mgmt.Commander_Touchpad = getvalue ( EnvCommander_Touchpad_);
    MSG_GCC_Config_Mgmt.TPEG = getvalue ( EnvTPEG_);
    MSG_GCC_Config_Mgmt.Reserved_60_1 = getvalue ( EnvReserved_60_1_);
    MSG_GCC_Config_Mgmt.EMERGENCY_CALL = getvalue ( EnvEMERGENCY_CALL_);
    MSG_GCC_Config_Mgmt.SATELITE_SPEC = getvalue ( EnvSATELITE_SPEC_);
    MSG_GCC_Config_Mgmt.NAVI_MAP_DATA = getvalue ( EnvNAVI_MAP_DATA_);
    MSG_GCC_Config_Mgmt.CD_Ripping = getvalue ( EnvCD_Ripping_);
    MSG_GCC_Config_Mgmt.TV_TUNER = getvalue ( EnvTV_TUNER_);
    MSG_GCC_Config_Mgmt.SPEAKER_TYPE = getvalue ( EnvSPEAKER_TYPE_);
    MSG_GCC_Config_Mgmt.DVD = getvalue ( EnvDVD_);
    MSG_GCC_Config_Mgmt.CD = getvalue ( EnvCD_);
    MSG_GCC_Config_Mgmt.FREQUENCY = getvalue ( EnvFREQUENCY_);
    MSG_GCC_Config_Mgmt.RDS = getvalue ( EnvRDS_);
    MSG_GCC_Config_Mgmt.DAB = getvalue ( EnvDAB_);
    MSG_GCC_Config_Mgmt.Reserved_52_6 = getvalue ( EnvReserved_52_6_);
    MSG_GCC_Config_Mgmt.AT_SHIFT_SW = getvalue ( EnvAT_SHIFT_SW_);
    MSG_GCC_Config_Mgmt.ELECTRIC_SHIFT = getvalue ( EnvELECTRIC_SHIFT_);
    MSG_GCC_Config_Mgmt.Reserved_52_5 = getvalue ( EnvReserved_52_5_);
    MSG_GCC_Config_Mgmt.STG_WHEEL_WARMER = getvalue ( EnvSTG_WHEEL_WARMER_);
    MSG_GCC_Config_Mgmt.TILT_STG = getvalue ( EnvTILT_STG_);
    MSG_GCC_Config_Mgmt.Reserved_52_4 = getvalue ( EnvReserved_52_4_);
    MSG_GCC_Config_Mgmt.DRIVE_SELECTION_MODE = getvalue ( EnvDRIVE_SELECTION_MODE_);
    MSG_GCC_Config_Mgmt.Reserved_52_3 = getvalue ( EnvReserved_52_3_);
    MSG_GCC_Config_Mgmt.DRIVE_SELECTION = getvalue ( EnvDRIVE_SELECTION_);
    MSG_GCC_Config_Mgmt.I_DM = getvalue ( EnvI_DM_);
    MSG_GCC_Config_Mgmt.Reserved_52_2 = getvalue ( EnvReserved_52_2_);
    MSG_GCC_Config_Mgmt.OVER_HEAD_CONSOLE = getvalue ( EnvOVER_HEAD_CONSOLE_);
    MSG_GCC_Config_Mgmt.AT_INTERLOCK_UNLOCK_SYS = getvalue ( EnvAT_INTERLOCK_UNLOCK_SYS_);
    MSG_GCC_Config_Mgmt.BURGLAR_ALARM_SYSTEM = getvalue ( EnvBURGLAR_ALARM_SYSTEM_);
    MSG_GCC_Config_Mgmt.Reserved_50_3 = getvalue ( EnvReserved_50_3_);
    MSG_GCC_Config_Mgmt.TSR_GSR_TYPE = getvalue ( EnvTSR_GSR_TYPE_);
    MSG_GCC_Config_Mgmt.SPEED_METER = getvalue ( EnvSPEED_METER_);
    MSG_GCC_Config_Mgmt.FUEL_CONSUMPTION_UNIT = getvalue ( EnvFUEL_CONSUMPTION_UNIT_);
    MSG_GCC_Config_Mgmt.TRIP_COMPUTER = getvalue ( EnvTRIP_COMPUTER_);
    MSG_GCC_Config_Mgmt.HEAD_UP_DISPLAY = getvalue ( EnvHEAD_UP_DISPLAY_);
    MSG_GCC_Config_Mgmt.WARNING_BUZZER_120KMH = getvalue ( EnvWARNING_BUZZER_120KMH_);
    MSG_GCC_Config_Mgmt.TURN_SIGNAL_SWITCH = getvalue ( EnvTURN_SIGNAL_SWITCH_);
    MSG_GCC_Config_Mgmt.Reserved_50_1 = getvalue ( EnvReserved_50_1_);
    MSG_GCC_Config_Mgmt.MULTI_DOT_DISPLAY = getvalue ( EnvMULTI_DOT_DISPLAY_);
    MSG_GCC_Config_Mgmt.Reserved_50_4 = getvalue ( EnvReserved_50_4_);
    MSG_GCC_Config_Mgmt.IND_STD_OF_SPEED_METER = getvalue ( EnvIND_STD_OF_SPEED_METER_);
    MSG_GCC_Config_Mgmt.Reserved_40_4 = getvalue ( EnvReserved_40_4_);
    MSG_GCC_Config_Mgmt.F_EX_MIRROR_AUTO_FOLD = getvalue ( EnvF_EX_MIRROR_AUTO_FOLD_);
    MSG_GCC_Config_Mgmt.F_EXT_MIRROR_ADJ_MEMORY = getvalue ( EnvF_EXT_MIRROR_ADJ_MEMORY_);
    MSG_GCC_Config_Mgmt.F_EXT_MIRROR_HEATER = getvalue ( EnvF_EXT_MIRROR_HEATER_);
    MSG_GCC_Config_Mgmt.F_EX_MIRROR_POWER_FOLD = getvalue ( EnvF_EX_MIRROR_POWER_FOLD_);
    MSG_GCC_Config_Mgmt.Reserved_40_3 = getvalue ( EnvReserved_40_3_);
//    MSG_GCC_Config_Mgmt.R_SEAT_NO1_SEAT_TRACK = getvalue ( EnvR_SEAT_NO1_SEAT_TRACK_);
    MSG_GCC_Config_Mgmt.ONE_TOUCH_SYSTEM = getvalue ( EnvONE_TOUCH_SYSTEM_);
//    MSG_GCC_Config_Mgmt.R_SEAT_VENTILATION = getvalue ( EnvR_SEAT_VENTILATION_);
    MSG_GCC_Config_Mgmt.WASHER_LEVEL_LAMP = getvalue ( EnvWASHER_LEVEL_LAMP_);
    MSG_GCC_Config_Mgmt.F_WIPER_INTERMITTENT = getvalue ( EnvF_WIPER_INTERMITTENT_);
    MSG_GCC_Config_Mgmt.Reserved_30_6 = getvalue ( EnvReserved_30_6_);
    MSG_GCC_Config_Mgmt.AUTO_DOOR_LOCK = getvalue ( EnvAUTO_DOOR_LOCK_);
    MSG_GCC_Config_Mgmt.Reserved_30_5 = getvalue ( EnvReserved_30_5_);
    MSG_GCC_Config_Mgmt.SUPER_LOCK_SYSTEM = getvalue ( EnvSUPER_LOCK_SYSTEM_);
    MSG_GCC_Config_Mgmt.POWER_DOOR_LOCK_SW = getvalue ( EnvPOWER_DOOR_LOCK_SW_);
    MSG_GCC_Config_Mgmt.POWER_DOOR_LOCK = getvalue ( EnvPOWER_DOOR_LOCK_);
    MSG_GCC_Config_Mgmt.Reserved_30_4 = getvalue ( EnvReserved_30_4_);
    MSG_GCC_Config_Mgmt.Reserved_30_3 = getvalue ( EnvReserved_30_3_);
    MSG_GCC_Config_Mgmt.POWER_BACK_DOOR = getvalue ( EnvPOWER_BACK_DOOR_);
    MSG_GCC_Config_Mgmt.Reserved_30_2 = getvalue ( EnvReserved_30_2_);
    MSG_GCC_Config_Mgmt.Reserved_30_1 = getvalue ( EnvReserved_30_1_);
    MSG_GCC_Config_Mgmt.TRUNK_LID_OPENER = getvalue ( EnvTRUNK_LID_OPENER_);
    MSG_GCC_Config_Mgmt.Reserved_25_4 = getvalue ( EnvReserved_25_4_);
    MSG_GCC_Config_Mgmt.DEFAULT_ONE_TOUCH_TURN = getvalue ( EnvDEFAULT_ONE_TOUCH_TURN_);
    MSG_GCC_Config_Mgmt.ESS = getvalue ( EnvESS_);
    MSG_GCC_Config_Mgmt.R_FOG_LAMP = getvalue ( EnvR_FOG_LAMP_);
    MSG_GCC_Config_Mgmt.F_FOG_LAMP = getvalue ( EnvF_FOG_LAMP_);
    MSG_GCC_Config_Mgmt.Reserved_25_3 = getvalue ( EnvReserved_25_3_);
    MSG_GCC_Config_Mgmt.PASSIVE_COLLISION_SIGNAL = getvalue ( EnvPASSIVE_COLLISION_SIGNAL_);
    MSG_GCC_Config_Mgmt.F_AND_R_SIDE_MARKER_US = getvalue ( EnvF_AND_R_SIDE_MARKER_US_);
    MSG_GCC_Config_Mgmt.AUTO_HEAD_LAMP_ON_OFF = getvalue ( EnvAUTO_HEAD_LAMP_ON_OFF_);
    MSG_GCC_Config_Mgmt.RUNNING_LAMP_CUSTOMIZE = getvalue ( EnvRUNNING_LAMP_CUSTOMIZE_);
    MSG_GCC_Config_Mgmt.F_COMBI_SIGNATURE_ILLUMI = getvalue ( EnvF_COMBI_SIGNATURE_ILLUMI_);
    MSG_GCC_Config_Mgmt.HEAD_LAMP_CLEANER = getvalue ( EnvHEAD_LAMP_CLEANER_);
    MSG_GCC_Config_Mgmt.Headlamp_Control = getvalue ( EnvHeadlamp_Control_);
    MSG_GCC_Config_Mgmt.Reserved_20_3 = getvalue ( EnvReserved_20_3_);
    MSG_GCC_Config_Mgmt.AC_Refrigerant_Gas = getvalue ( EnvAC_Refrigerant_Gas_);
    MSG_GCC_Config_Mgmt.AC_Compressor = getvalue ( EnvAC_Compressor_);
    MSG_GCC_Config_Mgmt.Reserved_20_2 = getvalue ( EnvReserved_20_2_);
    MSG_GCC_Config_Mgmt.Reserved_20_1 = getvalue ( EnvReserved_20_1_);
    MSG_GCC_Config_Mgmt.PreAirCon_OperatingTime = getvalue ( EnvPreAirCon_OperatingTime_);
    MSG_GCC_Config_Mgmt.R_VENT_COOLER = getvalue ( EnvR_VENT_COOLER_);
    MSG_GCC_Config_Mgmt.HUMIDITY_SENSOR = getvalue ( EnvHUMIDITY_SENSOR_);
    MSG_GCC_Config_Mgmt.PTC_HEATER = getvalue ( EnvPTC_HEATER_);
    MSG_GCC_Config_Mgmt.F_AIR_CONDITIONER = getvalue ( EnvF_AIR_CONDITIONER_);
    MSG_GCC_Config_Mgmt.Reserved_16_3 = getvalue ( EnvReserved_16_3_);
    MSG_GCC_Config_Mgmt.Reserved_16_2 = getvalue ( EnvReserved_16_2_);
    MSG_GCC_Config_Mgmt.OCCUPANT_MONITOR_SYSTEM = getvalue ( EnvOCCUPANT_MONITOR_SYSTEM_);
    MSG_GCC_Config_Mgmt.FRONT_SIDE_RADAR = getvalue ( EnvFRONT_SIDE_RADAR_);
    MSG_GCC_Config_Mgmt.TJA_TYPE = getvalue ( EnvTJA_TYPE_);
    MSG_GCC_Config_Mgmt.VIEW_MONITOR_CAMERA = getvalue ( EnvVIEW_MONITOR_CAMERA_);
    MSG_GCC_Config_Mgmt.FRONT_REAR_SIDE_SONAR = getvalue ( EnvFRONT_REAR_SIDE_SONAR_);
    MSG_GCC_Config_Mgmt.DRIVER_MONITOR = getvalue ( EnvDRIVER_MONITOR_);
    MSG_GCC_Config_Mgmt.FRONT_CROSS_TRAFFIC_ALERT = getvalue ( EnvFRONT_CROSS_TRAFFIC_ALERT_);
    MSG_GCC_Config_Mgmt.INTERSECTION_BRAKE_TYPE = getvalue ( EnvINTERSECTION_BRAKE_TYPE_);
    MSG_GCC_Config_Mgmt.BLIND_SPOT_PREVENTION = getvalue ( EnvBLIND_SPOT_PREVENTION_);
    MSG_GCC_Config_Mgmt.Reserved_16_1 = getvalue ( EnvReserved_16_1_);
    MSG_GCC_Config_Mgmt.Reserved_15_3 = getvalue ( EnvReserved_15_3_);
    MSG_GCC_Config_Mgmt.SBS_VRU_TYPE = getvalue ( EnvSBS_VRU_TYPE_);
    MSG_GCC_Config_Mgmt.ADAS_REGULATION_TYPE = getvalue ( EnvADAS_REGULATION_TYPE_);
    MSG_GCC_Config_Mgmt.REMOTE_PARKING = getvalue ( EnvREMOTE_PARKING_);
    MSG_GCC_Config_Mgmt.AUTO_PARKING = getvalue ( EnvAUTO_PARKING_);
    MSG_GCC_Config_Mgmt.ACCELERATION_RESTRAINT = getvalue ( EnvACCELERATION_RESTRAINT_);
    MSG_GCC_Config_Mgmt.REAR_SONAR = getvalue ( EnvREAR_SONAR_);
    MSG_GCC_Config_Mgmt.FRONT_SONAR = getvalue ( EnvFRONT_SONAR_);
    MSG_GCC_Config_Mgmt.PARKING_SENSOR = getvalue ( EnvPARKING_SENSOR_);
    MSG_GCC_Config_Mgmt.REAR_DIRECTION_BASE_SAFETY = getvalue ( EnvREAR_DIRECTION_BASE_SAFETY_);
    MSG_GCC_Config_Mgmt.Reserved_14_2 = getvalue ( EnvReserved_14_2_);
    MSG_GCC_Config_Mgmt.SBS_TARGET_TYPE = getvalue ( EnvSBS_TARGET_TYPE_);
    MSG_GCC_Config_Mgmt.IACC_TYPE = getvalue ( EnvIACC_TYPE_);
    MSG_GCC_Config_Mgmt.HEAD_ON = getvalue ( EnvHEAD_ON_);
    MSG_GCC_Config_Mgmt.LAS_TYPE = getvalue ( EnvLAS_TYPE_);
    MSG_GCC_Config_Mgmt.MRCC_TYPE = getvalue ( EnvMRCC_TYPE_);
    MSG_GCC_Config_Mgmt.Reserved_14_1 = getvalue ( EnvReserved_14_1_);
    MSG_GCC_Config_Mgmt.BLIND_SPOT_MONITORING = getvalue ( EnvBLIND_SPOT_MONITORING_);
    MSG_GCC_Config_Mgmt.REAR_SIDE_RADAR = getvalue ( EnvREAR_SIDE_RADAR_);
    MSG_GCC_Config_Mgmt.FRONT_RADAR = getvalue ( EnvFRONT_RADAR_);
    MSG_GCC_Config_Mgmt.ADJUSTABLE_SPEED_LIMITER = getvalue ( EnvADJUSTABLE_SPEED_LIMITER_);
    MSG_GCC_Config_Mgmt.AUTO_CRUISER = getvalue ( EnvAUTO_CRUISER_);
    MSG_GCC_Config_Mgmt.DAS_TYPE = getvalue ( EnvDAS_TYPE_);
    MSG_GCC_Config_Mgmt.DRIVER_ATTENTION_ALERT = getvalue ( EnvDRIVER_ATTENTION_ALERT_);
    MSG_GCC_Config_Mgmt.TRAFFIC_SIGN_RECOGNITION = getvalue ( EnvTRAFFIC_SIGN_RECOGNITION_);
    MSG_GCC_Config_Mgmt.FRONT_DIRECTION_BASE_SAFETY = getvalue ( EnvFRONT_DIRECTION_BASE_SAFETY_);
    MSG_GCC_Config_Mgmt.HIGH_BEAM_CONTROL = getvalue ( EnvHIGH_BEAM_CONTROL_);
    MSG_GCC_Config_Mgmt.FORWARD_SENSING_CAMERA = getvalue ( EnvFORWARD_SENSING_CAMERA_);
    MSG_GCC_Config_Mgmt.Reserved_13_3 = getvalue ( EnvReserved_13_3_);
    MSG_GCC_Config_Mgmt.Reserved_13_2 = getvalue ( EnvReserved_13_2_);
    MSG_GCC_Config_Mgmt.Reserved_13_1 = getvalue ( EnvReserved_13_1_);
    MSG_GCC_Config_Mgmt.F_TIRE_SIZE = getvalue ( EnvF_TIRE_SIZE_);
    MSG_GCC_Config_Mgmt.Tire_Circumference = getvalue ( EnvTire_Circumference_);
    MSG_GCC_Config_Mgmt.Reserved_12_3 = getvalue ( EnvReserved_12_3_);
    MSG_GCC_Config_Mgmt.EPS_Assist_Map = getvalue ( EnvEPS_Assist_Map_);
    MSG_GCC_Config_Mgmt.Reserved_12_2 = getvalue ( EnvReserved_12_2_);
    MSG_GCC_Config_Mgmt.Booster_Failure_Support = getvalue ( EnvBooster_Failure_Support_);
    MSG_GCC_Config_Mgmt.DYC = getvalue ( EnvDYC_);
    MSG_GCC_Config_Mgmt.Brake_Pad_Material = getvalue ( EnvBrake_Pad_Material_);
    MSG_GCC_Config_Mgmt.Rear_Brake_Size = getvalue ( EnvRear_Brake_Size_);
    MSG_GCC_Config_Mgmt.Front_Brake_Size = getvalue ( EnvFront_Brake_Size_);
    MSG_GCC_Config_Mgmt.Reserved_11_4 = getvalue ( EnvReserved_11_4_);
//    MSG_GCC_Config_Mgmt.NVH_SPEC = getvalue ( EnvNVH_SPEC_);
    MSG_GCC_Config_Mgmt.TIRE_PRESSURE_MONITOR_S = getvalue ( EnvTIRE_PRESSURE_MONITOR_S_);
    MSG_GCC_Config_Mgmt.Reserved_11_2 = getvalue ( EnvReserved_11_2_);
    MSG_GCC_Config_Mgmt.BATTERY_HEATER = getvalue ( EnvBATTERY_HEATER_);
    MSG_GCC_Config_Mgmt.Reserved_11_1 = getvalue ( EnvReserved_11_1_);
    MSG_GCC_Config_Mgmt.TSA = getvalue ( EnvTSA_);
    MSG_GCC_Config_Mgmt.AUTO_HOLD = getvalue ( EnvAUTO_HOLD_);
    MSG_GCC_Config_Mgmt.EPB = getvalue ( EnvEPB_);
    MSG_GCC_Config_Mgmt.Brake_Control = getvalue ( EnvBrake_Control_);
    MSG_GCC_Config_Mgmt.Reserved_10_2 = getvalue ( EnvReserved_10_2_);
    MSG_GCC_Config_Mgmt.CLOSED_FUEL_TANK_SYSTEM = getvalue ( EnvCLOSED_FUEL_TANK_SYSTEM_);
    MSG_GCC_Config_Mgmt.BEV_MAINTENANCE_LIMIT = getvalue ( EnvBEV_MAINTENANCE_LIMIT_);
    MSG_GCC_Config_Mgmt.Reserved_10_1 = getvalue ( EnvReserved_10_1_);
    MSG_GCC_Config_Mgmt.E_OIL_MAINTENANCE_LIMIT = getvalue ( EnvE_OIL_MAINTENANCE_LIMIT_);
    MSG_GCC_Config_Mgmt.REGENERATION_TYPE = getvalue ( EnvREGENERATION_TYPE_);
    MSG_GCC_Config_Mgmt.I_STOP_TYPE = getvalue ( EnvI_STOP_TYPE_);
    MSG_GCC_Config_Mgmt.Reserved_06_2 = getvalue ( EnvReserved_06_2_);
    MSG_GCC_Config_Mgmt.DEVELOPMENT_FUEL = getvalue ( EnvDEVELOPMENT_FUEL_);
    MSG_GCC_Config_Mgmt.PLANT = getvalue ( EnvPLANT_);
    MSG_GCC_Config_Mgmt.Reserved_06_1 = getvalue ( EnvReserved_06_1_);
    MSG_GCC_Config_Mgmt.Steering_Position = getvalue ( EnvSteering_Position_);
    MSG_GCC_Config_Mgmt.ROOF = getvalue ( EnvROOF_);
    MSG_GCC_Config_Mgmt.TRANSMISSION = getvalue ( EnvTRANSMISSION_);
    MSG_GCC_Config_Mgmt.DRIVE = getvalue ( EnvDRIVE_);
    MSG_GCC_Config_Mgmt.ENGINE = getvalue ( EnvENGINE_);
    MSG_GCC_Config_Mgmt.BODY = getvalue ( EnvBODY_);
    MSG_GCC_Config_Mgmt.BRAND = getvalue ( EnvBRAND_);
    MSG_GCC_Config_Mgmt.MARKET = getvalue ( EnvMARKET_);
    MSG_GCC_Config_Mgmt.Reserved_05_1 = getvalue ( EnvReserved_05_1_);
    MSG_GCC_Config_Mgmt.Project_Code_4th = getvalue ( EnvProject_Code_4th_);
    MSG_GCC_Config_Mgmt.Project_Code_3rd = getvalue ( EnvProject_Code_3rd_);
    MSG_GCC_Config_Mgmt.Project_Code_2nd = getvalue ( EnvProject_Code_2nd_);
    MSG_GCC_Config_Mgmt.Project_Code_1st = getvalue ( EnvProject_Code_1st_);
    MSG_GCC_Config_Mgmt.Outer_Color_3 = getvalue ( EnvOuter_Color_3_);
    MSG_GCC_Config_Mgmt.Outer_Color_2 = getvalue ( EnvOuter_Color_2_);
    MSG_GCC_Config_Mgmt.Outer_Color_1 = getvalue ( EnvOuter_Color_1_);
    MSG_GCC_Config_Mgmt.Unit_Serial_Number = getvalue ( EnvUnit_Serial_Number_);
    MSG_GCC_Config_Mgmt.Unit_Destination = getvalue ( EnvUnit_Destination_);
    MSG_GCC_Config_Mgmt.Unit_Series = getvalue ( EnvUnit_Series_);
    MSG_GCC_Config_Mgmt.Unit_Car_Line = getvalue ( EnvUnit_Car_Line_);
    MSG_GCC_Config_Mgmt.VIN_Character_21 = getvalue ( EnvVIN_Character_21_);
    MSG_GCC_Config_Mgmt.VIN_Character_20 = getvalue ( EnvVIN_Character_20_);
    MSG_GCC_Config_Mgmt.VIN_Character_19 = getvalue ( EnvVIN_Character_19_);
    MSG_GCC_Config_Mgmt.VIN_Character_18 = getvalue ( EnvVIN_Character_18_);
    MSG_GCC_Config_Mgmt.VIN_Character_17 = getvalue ( EnvVIN_Character_17_);
    MSG_GCC_Config_Mgmt.VIN_Character_16 = getvalue ( EnvVIN_Character_16_);
    MSG_GCC_Config_Mgmt.VIN_Character_15 = getvalue ( EnvVIN_Character_15_);
    MSG_GCC_Config_Mgmt.VIN_Character_14 = getvalue ( EnvVIN_Character_14_);
    MSG_GCC_Config_Mgmt.VIN_Character_13 = getvalue ( EnvVIN_Character_13_);
    MSG_GCC_Config_Mgmt.VIN_Character_12 = getvalue ( EnvVIN_Character_12_);
    MSG_GCC_Config_Mgmt.VIN_Character_11 = getvalue ( EnvVIN_Character_11_);
    MSG_GCC_Config_Mgmt.VIN_Character_10 = getvalue ( EnvVIN_Character_10_);
    MSG_GCC_Config_Mgmt.VIN_Character_09 = getvalue ( EnvVIN_Character_09_);
    MSG_GCC_Config_Mgmt.VIN_Character_08 = getvalue ( EnvVIN_Character_08_);
    MSG_GCC_Config_Mgmt.VIN_Character_07 = getvalue ( EnvVIN_Character_07_);
    MSG_GCC_Config_Mgmt.VIN_Character_06 = getvalue ( EnvVIN_Character_06_);
    MSG_GCC_Config_Mgmt.VIN_Character_05 = getvalue ( EnvVIN_Character_05_);
    MSG_GCC_Config_Mgmt.VIN_Character_04 = getvalue ( EnvVIN_Character_04_);
    MSG_GCC_Config_Mgmt.VIN_Character_03 = getvalue ( EnvVIN_Character_03_);
    MSG_GCC_Config_Mgmt.VIN_Character_02 = getvalue ( EnvVIN_Character_02_);
    MSG_GCC_Config_Mgmt.VIN_Character_01 = getvalue ( EnvVIN_Character_01_);
    MSG_GCC_Config_Mgmt.EngRunTimer = getvalue ( EnvEngRunTimer_);
    MSG_GCC_Config_Mgmt.BrakePedal = getvalue ( EnvBrakePedal_);
    MSG_GCC_Config_Mgmt.Reserved_F3_1 = getvalue ( EnvReserved_F3_1_);
    MSG_GCC_Config_Mgmt.VehicleSpeed_signal = getvalue ( EnvVehicleSpeed_signal_);
    MSG_GCC_Config_Mgmt.EngineRotationSpeed = getvalue ( EnvEngineRotationSpeed_);
    MSG_GCC_Config_Mgmt.EngClnt = getvalue ( EnvEngClnt_);
    MSG_GCC_Config_Mgmt.Reserved_F2_2 = getvalue ( EnvReserved_F2_2_);
    MSG_GCC_Config_Mgmt.AccelPedalPosition = getvalue ( EnvAccelPedalPosition_);
    MSG_GCC_Config_Mgmt.Reserved_F2_1 = getvalue ( EnvReserved_F2_1_);
    MSG_GCC_Config_Mgmt.SOC = getvalue ( EnvSOC_);
    MSG_GCC_Config_Mgmt.IG_OnTimer = getvalue ( EnvIG_OnTimer_);
    MSG_GCC_Config_Mgmt.ShiftPosition = getvalue ( EnvShiftPosition_);
    MSG_GCC_Config_Mgmt.PwMdeExtern_D_Actl = getvalue ( EnvPwMdeExtern_D_Actl_);
    MSG_GCC_Config_Mgmt.Out_car_temperature = getvalue ( EnvOut_car_temperature_);
    MSG_GCC_Config_Mgmt.MECU_supply_voltage = getvalue ( EnvMECU_supply_voltage_);
    MSG_GCC_Config_Mgmt.Total_Distance = getvalue ( EnvTotal_Distance_);
    MSG_GCC_Config_Mgmt.SOC2_SS = getvalue ( EnvSOC2_SS_);
    MSG_GCC_Config_Mgmt.MotorRPM_SS = getvalue ( EnvMotorRPM_SS_);
    MSG_GCC_Config_Mgmt.Global_Real_Time = getvalue ( EnvGlobal_Real_Time_);
    MSG_GCC_Config_Mgmt.GCC_CfgParam = getvalue ( EnvGCC_CfgParam_);

	/*  Output  */
	
	MSG_GCC_Config_Mgmt.Dlc = getvalue ( EnvGCC_Config_MgmtDlc_);
	 
	if(getvalue(EnvGCC_CfgParam_)== 0xF0)
	{
    MSG_GCC_Config_Mgmt.Global_Real_Time = getvalue ( EnvGlobal_Real_Time_);
    MSG_GCC_Config_Mgmt.MotorRPM_SS = getvalue ( EnvMotorRPM_SS_);
    MSG_GCC_Config_Mgmt.SOC2_SS = getvalue ( EnvSOC2_SS_);
	}
	if(getvalue(EnvGCC_CfgParam_)== 0xF1)
	{
    MSG_GCC_Config_Mgmt.Total_Distance = getvalue ( EnvTotal_Distance_);
    MSG_GCC_Config_Mgmt.MECU_supply_voltage = getvalue ( EnvMECU_supply_voltage_);
    MSG_GCC_Config_Mgmt.Out_car_temperature = getvalue ( EnvOut_car_temperature_);
    MSG_GCC_Config_Mgmt.PwMdeExtern_D_Actl = getvalue ( EnvPwMdeExtern_D_Actl_);
    MSG_GCC_Config_Mgmt.ShiftPosition = getvalue ( EnvShiftPosition_);
	}
  if(getvalue(EnvGCC_CfgParam_)== 0xF2)
	{
	  MSG_GCC_Config_Mgmt.IG_OnTimer = getvalue ( EnvIG_OnTimer_);
    MSG_GCC_Config_Mgmt.SOC = getvalue ( EnvSOC_);
    MSG_GCC_Config_Mgmt.AccelPedalPosition = getvalue ( EnvAccelPedalPosition_);
    MSG_GCC_Config_Mgmt.EngClnt = getvalue ( EnvEngClnt_);
	}
  if(getvalue(EnvGCC_CfgParam_)== 0xF3)
	{
    MSG_GCC_Config_Mgmt.EngineRotationSpeed = getvalue ( EnvEngineRotationSpeed_);
    MSG_GCC_Config_Mgmt.VehicleSpeed_signal = getvalue ( EnvVehicleSpeed_signal_);
	MSG_GCC_Config_Mgmt.BrakePedal = getvalue ( EnvBrakePedal_);
    MSG_GCC_Config_Mgmt.EngRunTimer = getvalue ( EnvEngRunTimer_);
	}
  if(getvalue(EnvGCC_CfgParam_)== 0x06)
	{
   if (@Env_SteeringPosition_Error == 1){
      putValue(EnvSteering_Position_, 1);
      MSG_GCC_Config_Mgmt.Steering_Position = getvalue ( EnvSteering_Position_);
   }else {
      putValue(EnvSteering_Position_, 0);
      MSG_GCC_Config_Mgmt.Steering_Position = getvalue ( EnvSteering_Position_);
   }
	}
	if(getvalue(EnvGCC_Config_MgmtTo_))
	{
		output(MSG_GCC_Config_Mgmt);
	}
	else
	{
		// Write("GCC_Config_Mgmt Message is not sent ");
	}
  if(getvalue(EnvGCC_CfgParam_)== 0xF0)
  {
    putValue(EnvGCC_CfgParam_,0xF1);
  }
    else if(getvalue(EnvGCC_CfgParam_)== 0xF1)
  {
    putValue(EnvGCC_CfgParam_,0xF2);
  } 
    else if (getvalue(EnvGCC_CfgParam_)== 0xF2)
  {
    putValue(EnvGCC_CfgParam_,0xF3);
  }
    else if(getvalue(EnvGCC_CfgParam_)== 0xF3)
  {
    putValue(EnvGCC_CfgParam_,0x06);
  }
    else if(getvalue(EnvGCC_CfgParam_)== 0x06)
  {
    putValue(EnvGCC_CfgParam_,0xF0);
  }
   else
  {
    putValue(EnvGCC_CfgParam_,0xF0);
  }
	 
	settimer(T_MSG_GCC_Config_Mgmt,  getvalue(EnvGCC_Config_MgmtTime_));
	 

}
//on timer T_MSG_MACKSEND8 
//{
//	MSG_MACKSEND8.MACKSEND8_2 = getvalue ( EnvMACKSEND8_2_);
//	MSG_MACKSEND8.MACKSEND8_1 = getvalue ( EnvMACKSEND8_1_);
//
//	/*  Output  */
//	
//	MSG_MACKSEND8.Dlc = getvalue ( EnvMACKSEND8Dlc_);
//	 
//	if(getvalue(EnvMACKSEND8To_))
//	{
//		output(MSG_MACKSEND8);
//	}
//	else
//	{
//		Write("MACKSEND8 Message is not sent ");
//	}
//	 
//	settimer(T_MSG_MACKSEND8,  getvalue(EnvMACKSEND8Time_));
//	 
//
//}
//on timer T_MSG_Functional_Diag_Request 
//{
//	MSG_Functional_Diag_Request.OBD_II_Broadcast_Info = getvalue ( EnvOBD_II_Broadcast_Info_);
//
//	/*  Output  */
//	
//	MSG_Functional_Diag_Request.Dlc = getvalue ( EnvFunctional_Diag_RequestDlc_);
//	 
//	if(getvalue(EnvFunctional_Diag_RequestTo_))
//	{
//		output(MSG_Functional_Diag_Request);
//	}
//	else
//	{
//		Write("Functional_Diag_Request Message is not sent ");
//	}
//	 
//	settimer(T_MSG_Functional_Diag_Request,  getvalue(EnvFunctional_Diag_RequestTime_));
//	 
//
//}
on timer T_MSG_Engine_Conf 
{
	MSG_Engine_Conf.SCR_Variants = getvalue ( EnvSCR_Variants_);
	MSG_Engine_Conf.Filter_Variants = getvalue ( EnvFilter_Variants_);
	MSG_Engine_Conf.Turbo_Variants = getvalue ( EnvTurbo_Variants_);
	MSG_Engine_Conf.EngCltFlow_Cnt_Vlv_Variants = getvalue ( EnvEngCltFlow_Cnt_Vlv_Variants_);
	MSG_Engine_Conf.CylinderDeactivation_Variants = getvalue ( EnvCylinderDeactivation_Variants_);
	MSG_Engine_Conf.OLS_Monitor_Variants = getvalue ( EnvOLS_Monitor_Variants_);
	MSG_Engine_Conf.EngineType_Calibration = getvalue ( EnvEngineType_Calibration_);
	MSG_Engine_Conf.AxleRatioFront = getvalue ( EnvAxleRatioFront_);
	MSG_Engine_Conf.TransmissionType = getvalue ( EnvTransmissionType_);
	MSG_Engine_Conf.FuelType_Delivery = getvalue ( EnvFuelType_Delivery_);
	MSG_Engine_Conf.EngineDisplacement = getvalue ( EnvEngineDisplacement_);

	/*  Output  */
	
	MSG_Engine_Conf.Dlc = getvalue ( EnvEngine_ConfDlc_);
	 
	if(getvalue(EnvEngine_ConfTo_))
	{
		output(MSG_Engine_Conf);
	}
	else
	{
		// Write("Engine_Conf Message is not sent ");
	}
	 
	settimer(T_MSG_Engine_Conf,  getvalue(EnvEngine_ConfTime_));
	 

}
on timer T_MSG_TransGearData 
{
	MSG_TransGearData.ID228_No_Cs = getvalue ( EnvID228_No_Cs_);
	MSG_TransGearData.ID228_No_Cnt = getvalue ( EnvID228_No_Cnt_);
	MSG_TransGearData.ShiftOpeWarning_D_Rq = getvalue ( EnvShiftOpeWarning_D_Rq_);
	MSG_TransGearData.ShiftPos_D_Act = getvalue ( EnvShiftPos_D_Act_);
	MSG_TransGearData.TransmChangeLeverPosition = getvalue ( EnvTransmChangeLeverPosition_);
	MSG_TransGearData.DispAtLvrPos_ArrowReq = getvalue ( EnvDispAtLvrPos_ArrowReq_);
	MSG_TransGearData.ShiftPos_D_Trg = getvalue ( EnvShiftPos_D_Trg_);
	MSG_TransGearData.DispAtLvrPos_Off_Req = getvalue ( EnvDispAtLvrPos_Off_Req_);
	MSG_TransGearData.AT_INDLvl_D_Rq = getvalue ( EnvAT_INDLvl_D_Rq_);
	MSG_TransGearData.AT_FailSafeLvl_D_Rq = getvalue ( EnvAT_FailSafeLvl_D_Rq_);
	MSG_TransGearData.PwrDwn_D_Req_ByTCM = getvalue ( EnvPwrDwn_D_Req_ByTCM_);
	MSG_TransGearData.SBW_INDLvl_D_Rq = getvalue ( EnvSBW_INDLvl_D_Rq_);
	MSG_TransGearData.ParkLockWarning_D_Rq = getvalue ( EnvParkLockWarning_D_Rq_);
	MSG_TransGearData.ShiftrPos_D_Qf = getvalue ( EnvShiftrPos_D_Qf_);
	MSG_TransGearData.SbwWarningLamp_B_Rq = getvalue ( EnvSbwWarningLamp_B_Rq_);
	MSG_TransGearData.TransmParking_D_Act = getvalue ( EnvTransmParking_D_Act_);
	MSG_TransGearData.TrnSlaCtl_B_Rq = getvalue ( EnvTrnSlaCtl_B_Rq_);
	MSG_TransGearData.TrnSlaCtlFlag = getvalue ( EnvTrnSlaCtlFlag_);
	MSG_TransGearData.TrnShifActv_B_Actl = getvalue ( EnvTrnShifActv_B_Actl_);
	MSG_TransGearData.AT_OILTEMPHi_D_Rq = getvalue ( EnvAT_OILTEMPHi_D_Rq_);
	MSG_TransGearData.TrnCnvtClu_D_Actl = getvalue ( EnvTrnCnvtClu_D_Actl_);
	MSG_TransGearData.DispGearPos_FlashReq = getvalue ( EnvDispGearPos_FlashReq_);
	MSG_TransGearData.OD_Hold_Sport_Flash = getvalue ( EnvOD_Hold_Sport_Flash_);
	MSG_TransGearData.DispAtLvrPos_FlashReq = getvalue ( EnvDispAtLvrPos_FlashReq_);
	MSG_TransGearData.DispAtLvrPos_D_Rq = getvalue ( EnvDispAtLvrPos_D_Rq_);
	MSG_TransGearData.DispGearPos_D_Rq = getvalue ( EnvDispGearPos_D_Rq_);

	/*  Output  */
	if(data_selection == 0x04)
	{
	if(use_case == 0) // use case 1: Invalid - Unobtain 
	{
		if (Unobtain_pattern != 0)
		{
			if (Invalid_pattern > 0)
			{
				Invalid_pattern--;
				putvalue(EnvTransGearDataTo_,1);
				MSG_TransGearData.ShiftPos_D_Trg = 0;
			}else
			{
				putvalue(EnvTransGearDataTo_,0);
        Unobtain_pattern--;
			}
		}else
			{
        MSG_TransGearData.ShiftPos_D_Trg = 0;
				Invalid_pattern = getvalue(Env_24EDR_Invalid_)-1;
				Unobtain_pattern = getvalue(Env_24EDR_Unobtain_);
			}
	}else if (use_case == 1) //use case 2 : invalid - valid
	{
		if(Valid_pattern > 0)
		{
			if(Invalid_pattern > 0)
			{
				Invalid_pattern--;
				MSG_TransGearData.ShiftPos_D_Trg = 0;
			}else
			{
				Valid_pattern --;
			}
		}else
		{
      MSG_TransGearData.ShiftPos_D_Trg = 0;
			Invalid_pattern = getvalue(Env_24EDR_Invalid_)-1;
			Valid_pattern = getvalue(Env_24EDR_Valid_);
		}
		
	}else if (use_case == 2) //use case 2: unobtain - valid
  {
    if(Valid_pattern > 0)
		{
			if(Unobtain_pattern != 0)
			{
				Unobtain_pattern--;
				putvalue(EnvTransGearDataTo_,0);
			}else
			{
				Valid_pattern --;
        putvalue(EnvTransGearDataTo_,1);
			}
		}else
		{
			putvalue(EnvTransGearDataTo_,0);
			Unobtain_pattern = getvalue(Env_24EDR_Unobtain_)-1;
			Valid_pattern = getvalue(Env_24EDR_Valid_);
		}
  }
	}	
	MSG_TransGearData.Dlc = getvalue ( EnvTransGearDataDlc_);
	 
	if(getvalue(EnvTransGearDataTo_))
	{
		output(MSG_TransGearData);
	}
	else
	{
		// Write("TransGearData Message is not sent ");
	}
	 
	settimer(T_MSG_TransGearData,  getvalue(EnvTransGearDataTime_));
	 

}
//on timer T_MSG_MACKSEND2 
//{
//	MSG_MACKSEND2.MACKSEND2_2 = getvalue ( EnvMACKSEND2_2_);
//	MSG_MACKSEND2.MACKSEND2_1 = getvalue ( EnvMACKSEND2_1_);
//
//	/*  Output  */
//	
//	MSG_MACKSEND2.Dlc = getvalue ( EnvMACKSEND2Dlc_);
//	 
//	if(getvalue(EnvMACKSEND2To_))
//	{
//		output(MSG_MACKSEND2);
//	}
//	else
//	{
//		Write("MACKSEND2 Message is not sent ");
//	}
//	 
//	settimer(T_MSG_MACKSEND2,  getvalue(EnvMACKSEND2Time_));
//	 
//
//}
on timer T_MSG_ADAS_HMI_Information4 
{
//	MSG_ADAS_HMI_Information4.LKA_EV_reject_sbs = getvalue ( EnvLKA_EV_reject_sbs_);
//	MSG_ADAS_HMI_Information4.LKA_EV_reject_locked = getvalue ( EnvLKA_EV_reject_locked_);
	MSG_ADAS_HMI_Information4.LKA_target = getvalue ( EnvLKA_target_);
	MSG_ADAS_HMI_Information4.LKA_EV_dassw_reject = getvalue ( EnvLKA_EV_dassw_reject_);
	MSG_ADAS_HMI_Information4.LKA_EV_failure = getvalue ( EnvLKA_EV_failure_);
	MSG_ADAS_HMI_Information4.LKA_EV_tmp_failure = getvalue ( EnvLKA_EV_tmp_failure_);
	MSG_ADAS_HMI_Information4.LKA_EV_fallback = getvalue ( EnvLKA_EV_fallback_);
	MSG_ADAS_HMI_Information4.LKA_EV_suspended = getvalue ( EnvLKA_EV_suspended_);
	MSG_ADAS_HMI_Information4.LKA_handsfree = getvalue ( EnvLKA_handsfree_);
	MSG_ADAS_HMI_Information4.LKA_EV_reject = getvalue ( EnvLKA_EV_reject_);
	MSG_ADAS_HMI_Information4.LKA_control_limit_rh = getvalue ( EnvLKA_control_limit_rh_);
	MSG_ADAS_HMI_Information4.LKA_control_limit_lh = getvalue ( EnvLKA_control_limit_lh_);
//	MSG_ADAS_HMI_Information4.LKA_EV_RMF_cancel = getvalue ( EnvLKA_EV_RMF_cancel_);
	MSG_ADAS_HMI_Information4.LKA_fallback = getvalue ( EnvLKA_fallback_);
	MSG_ADAS_HMI_Information4.LKA_EV_inactive_handsfree = getvalue ( EnvLKA_EV_inactive_handsfree_);
	MSG_ADAS_HMI_Information4.LKA_EV_inactive_handson = getvalue ( EnvLKA_EV_inactive_handson_);
	MSG_ADAS_HMI_Information4.ACC_target_distance = getvalue ( EnvACC_target_distance_);
	MSG_ADAS_HMI_Information4.ACC_set_distance = getvalue ( EnvACC_set_distance_);
	MSG_ADAS_HMI_Information4.ACC_set_velocity = getvalue ( EnvACC_set_velocity_);
	MSG_ADAS_HMI_Information4.ACC_EV_dassw_reject = getvalue ( EnvACC_EV_dassw_reject_);
	MSG_ADAS_HMI_Information4.ACC_EV_set_dist = getvalue ( EnvACC_EV_set_dist_);
	MSG_ADAS_HMI_Information4.ACC_EV_failure = getvalue ( EnvACC_EV_failure_);
	MSG_ADAS_HMI_Information4.ACC_EV_tmp_failure = getvalue ( EnvACC_EV_tmp_failure_);
	MSG_ADAS_HMI_Information4.ACC_EV_fallback2 = getvalue ( EnvACC_EV_fallback2_);
	MSG_ADAS_HMI_Information4.ACC_EV_fallback1 = getvalue ( EnvACC_EV_fallback1_);
	MSG_ADAS_HMI_Information4.ACC_EV_suspended = getvalue ( EnvACC_EV_suspended_);
	MSG_ADAS_HMI_Information4.ACC_EV_start = getvalue ( EnvACC_EV_start_);
	MSG_ADAS_HMI_Information4.ACC_shift_position = getvalue ( EnvACC_shift_position_);
	MSG_ADAS_HMI_Information4.ACC_warning = getvalue ( EnvACC_warning_);
	MSG_ADAS_HMI_Information4.ACC_EV_reject = getvalue ( EnvACC_EV_reject_);
	MSG_ADAS_HMI_Information4.ACC_EV_accept = getvalue ( EnvACC_EV_accept_);
	MSG_ADAS_HMI_Information4.ACC_fallback = getvalue ( EnvACC_fallback_);
	MSG_ADAS_HMI_Information4.ACC_target = getvalue ( EnvACC_target_);
	MSG_ADAS_HMI_Information4.ACC_stop = getvalue ( EnvACC_stop_);
	MSG_ADAS_HMI_Information4.ACC_sign = getvalue ( EnvACC_sign_);
	MSG_ADAS_HMI_Information4.ACC_state = getvalue ( EnvACC_state_);
 
  //Simulate value for testcase Tsync.
  data_simulate = getvalue(Env_24EDR_sampleDataT0);
  if(data_simulate == 0x0B){
    @EnvLKA_state_ += 1;
  	if ((@EnvLKA_state_ > 3) & (@EnvLKA_state_ <13) ){
  		@EnvLKA_state_ = 13;
  	}else if(@EnvLKA_state_ > 15){
      @EnvLKA_state_ = 0;
    }
  }
  MSG_ADAS_HMI_Information4.LKA_state = getvalue ( EnvLKA_state_);
	/*  Output  */
	if((data_selection == 0x06)||(data_selection == 0x0A)||(data_selection == 0x0B))
	{
	if(use_case == 0) // use case 1: Invalid - Unobtain 
	{
		if (Unobtain_pattern != 0)
		{
			if (Invalid_pattern > 0)
			{
				Invalid_pattern--;
				putvalue(EnvADAS_HMI_Information4To_,1);
				if (data_selection == 6)
				{
				MSG_ADAS_HMI_Information4.ACC_state = 5;
				}else
				{
				MSG_ADAS_HMI_Information4.LKA_state = 5;	
				}
			}else
			{
				putvalue(EnvADAS_HMI_Information4To_,0);
        Unobtain_pattern--;
			}
		}else
			{
        putvalue(EnvADAS_HMI_Information4To_,1);
				Invalid_pattern = getvalue(Env_24EDR_Invalid_)-1;
				Unobtain_pattern = getvalue(Env_24EDR_Unobtain_);
			}
	}else if (use_case == 1) //use case 2 : invalid - valid
	{
		if(Valid_pattern > 0)
		{
			if(Invalid_pattern > 0)
			{
				Invalid_pattern--;
				if (data_selection == 6)
				{
				MSG_ADAS_HMI_Information4.ACC_state = 5;
				}else
				{
				MSG_ADAS_HMI_Information4.LKA_state = 5;	
				}
			}else
			{
				Valid_pattern --;
			}
		}else
		{
      MSG_ADAS_HMI_Information4.ACC_state = 5;
			Invalid_pattern = getvalue(Env_24EDR_Invalid_)-1;
			Valid_pattern = getvalue(Env_24EDR_Valid_);
		}
		
	}else if (use_case == 2) //use case 2: unobtain - valid
  {
    if(Valid_pattern > 0)
		{
			if(Unobtain_pattern != 0)
			{
				Unobtain_pattern--;
				putvalue(EnvADAS_HMI_Information4To_,0);
			}else
			{
				Valid_pattern --;
        putvalue(EnvADAS_HMI_Information4To_,1);
			}
		}else
		{
			putvalue(EnvADAS_HMI_Information4To_,0);
			Unobtain_pattern = getvalue(Env_24EDR_Unobtain_)-1;
			Valid_pattern = getvalue(Env_24EDR_Valid_);
		}
  }
	}	
	MSG_ADAS_HMI_Information4.Dlc = getvalue ( EnvADAS_HMI_Information4Dlc_);
	 
	if(getvalue(EnvADAS_HMI_Information4To_))
	{
		output(MSG_ADAS_HMI_Information4);
	}
	else
	{
	}
	 
	settimer(T_MSG_ADAS_HMI_Information4,  getvalue(EnvADAS_HMI_Information4Time_));
	 

}
on timer T_MSG_EngVehicleSpThrottle 
{
	MSG_EngVehicleSpThrottle.ID202_E2E_CRCProfile1 = getvalue ( EnvID202_E2E_CRCProfile1_);
	MSG_EngVehicleSpThrottle.ApedPosPcActl_D_Qf = getvalue ( EnvApedPosPcActl_D_Qf_);
	MSG_EngVehicleSpThrottle.ID202_E2E_CNTProfile1 = getvalue ( EnvID202_E2E_CNTProfile1_);
	MSG_EngVehicleSpThrottle.DcdcWarningDisp_B_Rq_202 = getvalue ( EnvDcdcWarningDisp_B_Rq_202_);
	MSG_EngVehicleSpThrottle.ApedPos_Pc_ActlArb = getvalue ( EnvApedPos_Pc_ActlArb_);
	MSG_EngVehicleSpThrottle.EngAout_N_ReqTacho = getvalue ( EnvEngAout_N_ReqTacho_);
	MSG_EngVehicleSpThrottle.EngAout_D_ReqTachoGain = getvalue ( EnvEngAout_D_ReqTachoGain_);

  //Simulate value for testcase Tsync.
  data_simulate = getvalue(Env_24EDR_sampleDataT0);
  if(data_simulate == 0x01){
    @EnvApedPos_Pc_ActlArb_ += 100;
  	if (@EnvApedPos_Pc_ActlArb_ > 10000){
  		@EnvApedPos_Pc_ActlArb_ = 0;
  	}
  }else if(data_simulate == 0x08){
    @EnvEngAout_N_Actl_ += 10;
	  if (@EnvEngAout_N_Actl_ > 8190){
		  @EnvEngAout_N_Actl_ = 0;
	  }
  }
  
  MSG_EngVehicleSpThrottle.EngAout_N_Actl = getvalue ( EnvEngAout_N_Actl_);
	/*  Output  */
	if(data_selection == 0x01)
	{
	if(use_case == 0) // use case 1: Invalid - Unobtain 
	{
		if (Unobtain_pattern != 0)
		{
			if (Invalid_pattern > 0)
			{
				Invalid_pattern--;
				putvalue(EnvEngVehicleSpThrottleTo_,1);
				MSG_EngVehicleSpThrottle.ApedPosPcActl_D_Qf = 0;
			}else
			{
				putvalue(EnvEngVehicleSpThrottleTo_,0);
        Unobtain_pattern--;
			}
		}else
			{
        putvalue(EnvEngVehicleSpThrottleTo_,1);
				Invalid_pattern = getvalue(Env_24EDR_Invalid_)-1;
				Unobtain_pattern = getvalue(Env_24EDR_Unobtain_);
			}
	}else if (use_case == 1) //use case 2 : invalid - valid
	{
		if(Valid_pattern > 0)
		{
			if(Invalid_pattern > 0)
			{
				Invalid_pattern--;
				MSG_EngVehicleSpThrottle.ApedPosPcActl_D_Qf = 0;
			}else
			{
				Valid_pattern --;
			}
		}else
		{
      MSG_EngVehicleSpThrottle.ApedPosPcActl_D_Qf = 0;
			Invalid_pattern = getvalue(Env_24EDR_Invalid_)-1;
			Valid_pattern = getvalue(Env_24EDR_Valid_);
		}
		
	}else if (use_case == 2) //use case 2: unobtain - valid
  {
    if(Valid_pattern > 0)
		{
			if(Unobtain_pattern != 0)
			{
				Unobtain_pattern--;
				putvalue(EnvEngVehicleSpThrottleTo_,0);
			}else
			{
				Valid_pattern --;
        putvalue(EnvEngVehicleSpThrottleTo_,1);
			}
		}else
		{
			putvalue(EnvEngVehicleSpThrottleTo_,0);
			Unobtain_pattern = getvalue(Env_24EDR_Unobtain_)-1;
			Valid_pattern = getvalue(Env_24EDR_Valid_);
		}
  }
	}
  if(data_selection == 0x08)
	{
	if(use_case == 0) // use case 1: Invalid - Unobtain 
	{
		if (Unobtain_pattern != 0)
		{
			if (Invalid_pattern > 0)
			{
				Invalid_pattern--;
				putvalue(EnvEngVehicleSpThrottleTo_,1);
				MSG_EngVehicleSpThrottle.EngAout_N_Actl = 8191;
			}else
			{
				putvalue(EnvEngVehicleSpThrottleTo_,0);
        Unobtain_pattern--;
			}
		}else
			{
        putvalue(EnvEngVehicleSpThrottleTo_,1);
				Invalid_pattern = getvalue(Env_24EDR_Invalid_)-1;
				Unobtain_pattern = getvalue(Env_24EDR_Unobtain_);
			}
	}else if (use_case == 1) //use case 2 : invalid - valid
	{
		if(Valid_pattern > 0)
		{
			if(Invalid_pattern > 0)
			{
				Invalid_pattern--;
				MSG_EngVehicleSpThrottle.EngAout_N_Actl = 8191;
			}else
			{
				Valid_pattern --;
			}
		}else
		{
      MSG_EngVehicleSpThrottle.EngAout_N_Actl = 8191;
			Invalid_pattern = getvalue(Env_24EDR_Invalid_)-1;
			Valid_pattern = getvalue(Env_24EDR_Valid_);
		}
		
	}else if (use_case == 2) //use case 2: unobtain - valid
  {
    if(Valid_pattern > 0)
		{
			if(Unobtain_pattern != 0)
			{
				Unobtain_pattern--;
				putvalue(EnvEngVehicleSpThrottleTo_,0);
			}else
			{
				Valid_pattern --;
        putvalue(EnvEngVehicleSpThrottleTo_,1);
			}
		}else
		{
			putvalue(EnvEngVehicleSpThrottleTo_,0);
			Unobtain_pattern = getvalue(Env_24EDR_Unobtain_)-1;
			Valid_pattern = getvalue(Env_24EDR_Valid_);
		}
  }
	}
	MSG_EngVehicleSpThrottle.Dlc = getvalue ( EnvEngVehicleSpThrottleDlc_);
	 
	if(getvalue(EnvEngVehicleSpThrottleTo_))
	{
		output(MSG_EngVehicleSpThrottle);
	}
	else
	{
		// Write("EngVehicleSpThrottle Message is not sent ");
	}
	 
	settimer(T_MSG_EngVehicleSpThrottle,  getvalue(EnvEngVehicleSpThrottleTime_));
	 

}
on timer T_MSG_RBCM_Information2 
{
	MSG_RBCM_Information2.rdL_OCS_Stat_D_Actl = getvalue ( EnvrdL_OCS_Stat_D_Actl_);
	MSG_RBCM_Information2.rdR_OCS_Stat_D_Actl = getvalue ( EnvrdR_OCS_Stat_D_Actl_);
	MSG_RBCM_Information2.BackupBatteryMid_U_Actl = getvalue ( EnvBackupBatteryMid_U_Actl_);
	MSG_RBCM_Information2.DrLock_Message_R_Rsp = getvalue ( EnvDrLock_Message_R_Rsp_);
	MSG_RBCM_Information2.RR_OCS_Stat_D_Actl = getvalue ( EnvRR_OCS_Stat_D_Actl_);
	MSG_RBCM_Information2.RC_OCS_Stat_D_Actl = getvalue ( EnvRC_OCS_Stat_D_Actl_);
	MSG_RBCM_Information2.RL_OCS_Stat_D_Actl = getvalue ( EnvRL_OCS_Stat_D_Actl_);
	MSG_RBCM_Information2.DrStatRl_B_Actl = getvalue ( EnvDrStatRl_B_Actl_);
	MSG_RBCM_Information2.DrStatR_D_Qf = getvalue ( EnvDrStatR_D_Qf_);
	MSG_RBCM_Information2.TrnkLg_Motor_Stat = getvalue ( EnvTrnkLg_Motor_Stat_);
	MSG_RBCM_Information2.Fuel_Lid_Open_Status = getvalue ( EnvFuel_Lid_Open_Status_);
	MSG_RBCM_Information2.StopLampCon_Status = getvalue ( EnvStopLampCon_Status_);
	MSG_RBCM_Information2.SeatBeltStat_D_Actl = getvalue ( EnvSeatBeltStat_D_Actl_);
	MSG_RBCM_Information2.DrStatTrnkLg_B_Actl = getvalue ( EnvDrStatTrnkLg_B_Actl_);
	MSG_RBCM_Information2.ParkBrkActv_D_Actl2 = getvalue ( EnvParkBrkActv_D_Actl2_);
	MSG_RBCM_Information2.AutoHoldSw_B_Actl = getvalue ( EnvAutoHoldSw_B_Actl_);

	/*  Output  */
	
	MSG_RBCM_Information2.Dlc = getvalue ( EnvRBCM_Information2Dlc_);
	 
	if(getvalue(EnvRBCM_Information2To_))
	{
		output(MSG_RBCM_Information2);
	}
	else
	{
	//	Write("RBCM_Information2 Message is not sent ");
	}
	 
	settimer(T_MSG_RBCM_Information2,  getvalue(EnvRBCM_Information2Time_));
	 

}
//on timer T_MSG_RCMSerialNumber 
//{
//	MSG_RCMSerialNumber.RCMSerialNoByte8 = getvalue ( EnvRCMSerialNoByte8_);
//	MSG_RCMSerialNumber.RCMSerialNoByte7 = getvalue ( EnvRCMSerialNoByte7_);
//	MSG_RCMSerialNumber.RCMSerialNoByte6 = getvalue ( EnvRCMSerialNoByte6_);
//	MSG_RCMSerialNumber.RCMSerialNoByte5 = getvalue ( EnvRCMSerialNoByte5_);
//	MSG_RCMSerialNumber.RCMSerialNoByte4 = getvalue ( EnvRCMSerialNoByte4_);
//	MSG_RCMSerialNumber.RCMSerialNoByte3 = getvalue ( EnvRCMSerialNoByte3_);
//	MSG_RCMSerialNumber.RCMSerialNoByte2 = getvalue ( EnvRCMSerialNoByte2_);
//	MSG_RCMSerialNumber.RCMSerialNoByte1 = getvalue ( EnvRCMSerialNoByte1_);
//
//	/*  Output  */
//	
//	MSG_RCMSerialNumber.Dlc = getvalue ( EnvRCMSerialNumberDlc_);
//	 
//	if(getvalue(EnvRCMSerialNumberTo_))
//	{
//		output(MSG_RCMSerialNumber);
//	}
//	else
//	{
//		Write("RCMSerialNumber Message is not sent ");
//	}
//	 
//	settimer(T_MSG_RCMSerialNumber,  getvalue(EnvRCMSerialNumberTime_));
//	 
//
//}
on timer T_MSG_TPMS_Control 
{
	MSG_TPMS_Control.RR_TPrs_Correct = getvalue ( EnvRR_TPrs_Correct_);
	MSG_TPMS_Control.RL_TPrs_Correct = getvalue ( EnvRL_TPrs_Correct_);
	MSG_TPMS_Control.FR_TPrs_Correct = getvalue ( EnvFR_TPrs_Correct_);
	MSG_TPMS_Control.FL_TPrs_Correct = getvalue ( EnvFL_TPrs_Correct_);
	MSG_TPMS_Control.MntOilLvl_AtFlg = getvalue ( EnvMntOilLvl_AtFlg_);
	MSG_TPMS_Control.TPrs_Disp_Minute = getvalue ( EnvTPrs_Disp_Minute_);
	MSG_TPMS_Control.TPrs_Disp_Hour = getvalue ( EnvTPrs_Disp_Hour_);
	MSG_TPMS_Control.TPrs_Disp_Date = getvalue ( EnvTPrs_Disp_Date_);
	MSG_TPMS_Control.TPrs_Disp_Month = getvalue ( EnvTPrs_Disp_Month_);
	MSG_TPMS_Control.TPrs_Disp_Year = getvalue ( EnvTPrs_Disp_Year_);
	MSG_TPMS_Control.TPrs_MntSet_Date = getvalue ( EnvTPrs_MntSet_Date_);
	MSG_TPMS_Control.TPrs_MntSet_Month = getvalue ( EnvTPrs_MntSet_Month_);
	MSG_TPMS_Control.TPrs_MntSet_Year = getvalue ( EnvTPrs_MntSet_Year_);
	MSG_TPMS_Control.RR_TPrs_DispKG = getvalue ( EnvRR_TPrs_DispKG_);
	MSG_TPMS_Control.RL_TPrs_DispKG = getvalue ( EnvRL_TPrs_DispKG_);
	MSG_TPMS_Control.FR_TPrs_DispKG = getvalue ( EnvFR_TPrs_DispKG_);
	MSG_TPMS_Control.FL_TPrs_DispKG = getvalue ( EnvFL_TPrs_DispKG_);
	MSG_TPMS_Control.TPrs_RemRegDist = getvalue ( EnvTPrs_RemRegDist_);
	MSG_TPMS_Control.RR_TPrs_DispPS = getvalue ( EnvRR_TPrs_DispPS_);
	MSG_TPMS_Control.RL_TPrs_DispPS = getvalue ( EnvRL_TPrs_DispPS_);
	MSG_TPMS_Control.FR_TPrs_DispPS = getvalue ( EnvFR_TPrs_DispPS_);
	MSG_TPMS_Control.FL_TPrs_DispPS = getvalue ( EnvFL_TPrs_DispPS_);
	MSG_TPMS_Control.Sds_TotSD_Avl_D_Actl = getvalue ( EnvSds_TotSD_Avl_D_Actl_);
	MSG_TPMS_Control.MntSet_Dist = getvalue ( EnvMntSet_Dist_);
	MSG_TPMS_Control.RR_TPrs_DispBR = getvalue ( EnvRR_TPrs_DispBR_);
	MSG_TPMS_Control.RL_TPrs_DispBR = getvalue ( EnvRL_TPrs_DispBR_);
	MSG_TPMS_Control.FR_TPrs_DispBR = getvalue ( EnvFR_TPrs_DispBR_);
	MSG_TPMS_Control.FL_TPrs_DispBR = getvalue ( EnvFL_TPrs_DispBR_);
	MSG_TPMS_Control.MntTyre_AtFlg = getvalue ( EnvMntTyre_AtFlg_);
	MSG_TPMS_Control.RR_TPrs_DispKP = getvalue ( EnvRR_TPrs_DispKP_);
	MSG_TPMS_Control.RL_TPrs_DispKP = getvalue ( EnvRL_TPrs_DispKP_);
	MSG_TPMS_Control.FR_TPrs_DispKP = getvalue ( EnvFR_TPrs_DispKP_);
	MSG_TPMS_Control.FL_TPrs_DispKP = getvalue ( EnvFL_TPrs_DispKP_);
	MSG_TPMS_Control.ID_TPMS3_No_cnt = getvalue ( EnvID_TPMS3_No_cnt_);
	MSG_TPMS_Control.RR_TyrePressWarn = getvalue ( EnvRR_TyrePressWarn_);
	MSG_TPMS_Control.RL_TyrePressWarn = getvalue ( EnvRL_TyrePressWarn_);
	MSG_TPMS_Control.FR_TyrePressWarn = getvalue ( EnvFR_TyrePressWarn_);
	MSG_TPMS_Control.FL_TyrePressWarn = getvalue ( EnvFL_TyrePressWarn_);
	MSG_TPMS_Control.TPMS_SystemFlt = getvalue ( EnvTPMS_SystemFlt_);
	MSG_TPMS_Control.TPMS_Status = getvalue ( EnvTPMS_Status_);
	MSG_TPMS_Control.RunflatWarnLamp_B_Rq = getvalue ( EnvRunflatWarnLamp_B_Rq_);
	MSG_TPMS_Control.TPMSCtlLamp_D_Rq = getvalue ( EnvTPMSCtlLamp_D_Rq_);
	MSG_TPMS_Control.Data_Number = getvalue ( EnvData_Number_);

	/*  Output  */
	if(data_selection == 0x10)
	{
	if(use_case == 0) // use case 1: Invalid - Unobtain 
	{
		if (Unobtain_pattern != 0)
		{
			if (Invalid_pattern > 0)
			{
				Invalid_pattern--;
				putvalue(EnvTPMS_ControlTo_,1);
				MSG_TPMS_Control.TPMSCtlLamp_D_Rq = 2;
				MSG_TPMS_Control.TPMS_Status = 1;
			}else
			{
				putvalue(EnvTPMS_ControlTo_,0);
        Unobtain_pattern--;
			}
		}else
			{
        putvalue(EnvTPMS_ControlTo_,1);
				Invalid_pattern = getvalue(Env_24EDR_Invalid_)-1;
				Unobtain_pattern = getvalue(Env_24EDR_Unobtain_);
			}
	}else if (use_case == 1) //use case 2 : invalid - valid
	{
		if(Valid_pattern > 0)
		{
			if(Invalid_pattern > 0)
			{
				Invalid_pattern--;
				MSG_TPMS_Control.TPMSCtlLamp_D_Rq = 2;
				MSG_TPMS_Control.TPMS_Status = 1;				
			}else
			{
				Valid_pattern --;
			}
		}else
		{
				MSG_TPMS_Control.TPMSCtlLamp_D_Rq = 2;
				MSG_TPMS_Control.TPMS_Status = 1;
			Invalid_pattern = getvalue(Env_24EDR_Invalid_)-1;
			Valid_pattern = getvalue(Env_24EDR_Valid_);
		}
		
	}else if (use_case == 2) //use case 2: unobtain - valid
  {
    if(Valid_pattern > 0)
		{
			if(Unobtain_pattern != 0)
			{
				Unobtain_pattern--;
				putvalue(EnvTPMS_ControlTo_,0);
			}else
			{
				Valid_pattern --;
        putvalue(EnvTPMS_ControlTo_,1);
			}
		}else
		{
			putvalue(EnvTPMS_ControlTo_,0);
			Unobtain_pattern = getvalue(Env_24EDR_Unobtain_)-1;
			Valid_pattern = getvalue(Env_24EDR_Valid_);
		}
  }
	}	
	MSG_TPMS_Control.Dlc = getvalue ( EnvTPMS_ControlDlc_);
	 
	if(getvalue(EnvTPMS_ControlTo_))
	{
		output(MSG_TPMS_Control);
	}
	else
	{
	//	Write("TPMS_Control Message is not sent ");
	}
	 
	settimer(T_MSG_TPMS_Control,  getvalue(EnvTPMS_ControlTime_));
	 

}
//on timer T_MSG_CBCM_IllumStatus 
//{
//	MSG_CBCM_IllumStatus.BpedDrvAppl_D_Actl = getvalue ( EnvBpedDrvAppl_D_Actl_);
//	MSG_CBCM_IllumStatus.IndirectIllumination_D_Rq = getvalue ( EnvIndirectIllumination_D_Rq_);
//	MSG_CBCM_IllumStatus.WelcomIllumination_D_Rq = getvalue ( EnvWelcomIllumination_D_Rq_);
//	MSG_CBCM_IllumStatus.FootLamp_D_Rq = getvalue ( EnvFootLamp_D_Rq_);
//	MSG_CBCM_IllumStatus.DoorCourtesyLamp_D_Rq = getvalue ( EnvDoorCourtesyLamp_D_Rq_);
//	MSG_CBCM_IllumStatus.CargoLamp_D_Rq = getvalue ( EnvCargoLamp_D_Rq_);
//	MSG_CBCM_IllumStatus.CBCM_Control_No_Cnt = getvalue ( EnvCBCM_Control_No_Cnt_);
//	MSG_CBCM_IllumStatus.DimmerCancel = getvalue ( EnvDimmerCancel_);
//	MSG_CBCM_IllumStatus.EngOff_T_Actl = getvalue ( EnvEngOff_T_Actl_);
//	MSG_CBCM_IllumStatus.Drive_Mode_FlashReq = getvalue ( EnvDrive_Mode_FlashReq_);
//	MSG_CBCM_IllumStatus.Drive_Mode_Enabled = getvalue ( EnvDrive_Mode_Enabled_);
//	MSG_CBCM_IllumStatus.CarMde_D_Actl = getvalue ( EnvCarMde_D_Actl_);
//	MSG_CBCM_IllumStatus.PanelBrightLevel_Pc_Actl = getvalue ( EnvPanelBrightLevel_Pc_Actl_);
//	MSG_CBCM_IllumStatus.Reverselamp_B_Req = getvalue ( EnvReverselamp_B_Req_);
//	MSG_CBCM_IllumStatus.IlumiMde_D_Actl = getvalue ( EnvIlumiMde_D_Actl_);
//	MSG_CBCM_IllumStatus.Illum_PowerControlStatus = getvalue ( EnvIllum_PowerControlStatus_);
//	MSG_CBCM_IllumStatus.AudioMute_B_Actl = getvalue ( EnvAudioMute_B_Actl_);
//	MSG_CBCM_IllumStatus.RoomFuseStat_D_Actl = getvalue ( EnvRoomFuseStat_D_Actl_);
//
//	/*  Output  */
//	
//	MSG_CBCM_IllumStatus.Dlc = getvalue ( EnvCBCM_IllumStatusDlc_);
//	 
//	if(getvalue(EnvCBCM_IllumStatusTo_))
//	{
//		output(MSG_CBCM_IllumStatus);
//	}
//	else
//	{
//		Write("CBCM_IllumStatus Message is not sent ");
//	}
//	 
//	settimer(T_MSG_CBCM_IllumStatus,  getvalue(EnvCBCM_IllumStatusTime_));
//	 
//
//}
//on timer T_MSG_EPAS_CCP_Rx 
//{
//	MSG_EPAS_CCP_Rx.CCPMessageDataEPAS7_Rx = getvalue ( EnvCCPMessageDataEPAS7_Rx_);
//	MSG_EPAS_CCP_Rx.CCPMessageDataEPAS6_Rx = getvalue ( EnvCCPMessageDataEPAS6_Rx_);
//	MSG_EPAS_CCP_Rx.CCPMessageDataEPAS5_Rx = getvalue ( EnvCCPMessageDataEPAS5_Rx_);
//	MSG_EPAS_CCP_Rx.CCPMessageDataEPAS4_Rx = getvalue ( EnvCCPMessageDataEPAS4_Rx_);
//	MSG_EPAS_CCP_Rx.CCPMessageDataEPAS3_Rx = getvalue ( EnvCCPMessageDataEPAS3_Rx_);
//	MSG_EPAS_CCP_Rx.CCPMessageDataEPAS2_Rx = getvalue ( EnvCCPMessageDataEPAS2_Rx_);
//	MSG_EPAS_CCP_Rx.CCPMessageDataEPAS1_Rx = getvalue ( EnvCCPMessageDataEPAS1_Rx_);
//	MSG_EPAS_CCP_Rx.CCPMessageDataEPAS_Rx = getvalue ( EnvCCPMessageDataEPAS_Rx_);
//
//	/*  Output  */
//	
//	MSG_EPAS_CCP_Rx.Dlc = getvalue ( EnvEPAS_CCP_RxDlc_);
//	 
//	if(getvalue(EnvEPAS_CCP_RxTo_))
//	{
//		output(MSG_EPAS_CCP_Rx);
//	}
//	else
//	{
//		Write("EPAS_CCP_Rx Message is not sent ");
//	}
//	 
//	settimer(T_MSG_EPAS_CCP_Rx,  getvalue(EnvEPAS_CCP_RxTime_));
//	 
//
//}
//on timer T_MSG_MACKSEND4 
//{
//	MSG_MACKSEND4.MACKSEND4_2 = getvalue ( EnvMACKSEND4_2_);
//	MSG_MACKSEND4.MACKSEND4_1 = getvalue ( EnvMACKSEND4_1_);
//
//	/*  Output  */
//	
//	MSG_MACKSEND4.Dlc = getvalue ( EnvMACKSEND4Dlc_);
//	 
//	if(getvalue(EnvMACKSEND4To_))
//	{
//		output(MSG_MACKSEND4);
//	}
//	else
//	{
//		Write("MACKSEND4 Message is not sent ");
//	}
//	 
//	settimer(T_MSG_MACKSEND4,  getvalue(EnvMACKSEND4Time_));
//	 
//
//}
on timer T_MSG_DCM_Message 
{
	MSG_DCM_Message.TCU_ComFail_MsgType = getvalue ( EnvTCU_ComFail_MsgType_);
	MSG_DCM_Message.TCU_Service_Flag = getvalue ( EnvTCU_Service_Flag_);
	MSG_DCM_Message.TCU_ComStatus_Notification = getvalue ( EnvTCU_ComStatus_Notification_);
	MSG_DCM_Message.TCU_SW_Update_Req = getvalue ( EnvTCU_SW_Update_Req_);
	MSG_DCM_Message.VDT_BECM_ODR2_ResTCU = getvalue ( EnvVDT_BECM_ODR2_ResTCU_);
	MSG_DCM_Message.Audio_mute_request_result = getvalue ( EnvAudio_mute_request_result_);
	MSG_DCM_Message.Crash_output_relay_result = getvalue ( EnvCrash_output_relay_result_);
	MSG_DCM_Message.Fialure_reason = getvalue ( EnvFialure_reason_);
	MSG_DCM_Message.Voice_Communication_result = getvalue ( EnvVoice_Communication_result_);
	MSG_DCM_Message.Data_Transmission_result = getvalue ( EnvData_Transmission_result_);
	MSG_DCM_Message.Call_Trigger_Type = getvalue ( EnvCall_Trigger_Type_);
	MSG_DCM_Message.Recording_Trigger = getvalue ( EnvRecording_Trigger_);
	MSG_DCM_Message.VDT_Recall_Counter = getvalue ( EnvVDT_Recall_Counter_);
	MSG_DCM_Message.VDT_Recall_Number = getvalue ( EnvVDT_Recall_Number_);
	MSG_DCM_Message.VDT_Recall_Req = getvalue ( EnvVDT_Recall_Req_);
	MSG_DCM_Message.TCU_ComFail_B_Actl = getvalue ( EnvTCU_ComFail_B_Actl_);
	MSG_DCM_Message.VDT_BCM_Std3_ResTCU = getvalue ( EnvVDT_BCM_Std3_ResTCU_);
	MSG_DCM_Message.VDT_VCM_ODR2_ResTCU = getvalue ( EnvVDT_VCM_ODR2_ResTCU_);
	MSG_DCM_Message.VDT_TCM_ODR2_ResTCU = getvalue ( EnvVDT_TCM_ODR2_ResTCU_);
	MSG_DCM_Message.VDT_PCM_ODR2_ResTCU = getvalue ( EnvVDT_PCM_ODR2_ResTCU_);
	MSG_DCM_Message.VDT_BCM_Std2_ResTCU = getvalue ( EnvVDT_BCM_Std2_ResTCU_);
	MSG_DCM_Message.VDT_VCM_ODR1_ResTCU = getvalue ( EnvVDT_VCM_ODR1_ResTCU_);
	MSG_DCM_Message.VDT_PCM_ODR1_ResTCU = getvalue ( EnvVDT_PCM_ODR1_ResTCU_);
	MSG_DCM_Message.VDT_BCM_Std1_ResTCU = getvalue ( EnvVDT_BCM_Std1_ResTCU_);
	MSG_DCM_Message.CallMute_B_Actl = getvalue ( EnvCallMute_B_Actl_);

	/*  Output  */
	
	MSG_DCM_Message.Dlc = getvalue ( EnvDCM_MessageDlc_);
	 
	if(getvalue(EnvDCM_MessageTo_))
	{
		output(MSG_DCM_Message);
	}
	else
	{
		//Write("DCM_Message Message is not sent ");
	}
	 
	settimer(T_MSG_DCM_Message,  getvalue(EnvDCM_MessageTime_));
	 

}
//on timer T_MSG_EPAS_Diag_Tx 
//{
//	MSG_EPAS_Diag_Tx.EPAS_Diag_Sig_Tx = getvalue ( EnvEPAS_Diag_Sig_Tx_);
//
//	/*  Output  */
//	
//	MSG_EPAS_Diag_Tx.Dlc = getvalue ( EnvEPAS_Diag_TxDlc_);
//	 
//	if(getvalue(EnvEPAS_Diag_TxTo_))
//	{
//		output(MSG_EPAS_Diag_Tx);
//	}
//	else
//	{
//		Write("EPAS_Diag_Tx Message is not sent ");
//	}
//	 
//	settimer(T_MSG_EPAS_Diag_Tx,  getvalue(EnvEPAS_Diag_TxTime_));
//	 
//
//}
//on timer T_MSG_ABS_Diag_Tx 
//{
//	MSG_ABS_Diag_Tx.ABS_Diag_Sig_Tx = getvalue ( EnvABS_Diag_Sig_Tx_);
//
//	/*  Output  */
//	
//	MSG_ABS_Diag_Tx.Dlc = getvalue ( EnvABS_Diag_TxDlc_);
//	 
//	if(getvalue(EnvABS_Diag_TxTo_))
//	{
//		output(MSG_ABS_Diag_Tx);
//	}
//	else
//	{
//		Write("ABS_Diag_Tx Message is not sent ");
//	}
//	 
//	settimer(T_MSG_ABS_Diag_Tx,  getvalue(EnvABS_Diag_TxTime_));
//	 
//
//}
//on timer T_MSG_crashoutput_MAC 
//{
//	MSG_crashoutput_MAC.crashoutput_MACTx = getvalue ( Envcrashoutput_MACTx_);
//	MSG_crashoutput_MAC.crashoutput_FVTx = getvalue ( Envcrashoutput_FVTx_);
//	MSG_crashoutput_MAC.ID33E_No_Cs = getvalue ( EnvID33E_No_Cs_);
//	MSG_crashoutput_MAC.ID33E_No_Cnt = getvalue ( EnvID33E_No_Cnt_);
//	MSG_crashoutput_MAC.threshold_over_rollover_static = getvalue ( Envthreshold_over_rollover_static_);
//	MSG_crashoutput_MAC.RcmStat_B_Actl = getvalue ( EnvRcmStat_B_Actl_);
//	MSG_crashoutput_MAC.FuelCutoffReq = getvalue ( EnvFuelCutoffReq_);
//	MSG_crashoutput_MAC.threshold_over_rollover = getvalue ( Envthreshold_over_rollover_);
//	MSG_crashoutput_MAC.threshold_over_rear = getvalue ( Envthreshold_over_rear_);
//	MSG_crashoutput_MAC.threshold_over_side_passenger = getvalue ( Envthreshold_over_side_passenger_);
//	MSG_crashoutput_MAC.threshold_over_side_Driver = getvalue ( Envthreshold_over_side_Driver_);
//	MSG_crashoutput_MAC.threshold_over_front = getvalue ( Envthreshold_over_front_);
//
//	/*  Output  */
//	
//	MSG_crashoutput_MAC.Dlc = getvalue ( Envcrashoutput_MACDlc_);
//	 
//	if(getvalue(Envcrashoutput_MACTo_))
//	{
//		output(MSG_crashoutput_MAC);
//	}
//	else
//	{
//		Write("crashoutput_MAC Message is not sent ");
//	}
//	 
//	settimer(T_MSG_crashoutput_MAC,  getvalue(Envcrashoutput_MACTime_));
//	 
//
//}
//on timer T_MSG_MACKID_MACKUSAGE 
//{
//	MSG_MACKID_MACKUSAGE.MACKUSAGE = getvalue ( EnvMACKUSAGE_);
//	MSG_MACKID_MACKUSAGE.MACKID = getvalue ( EnvMACKID_);
//
//	/*  Output  */
//	
//	MSG_MACKID_MACKUSAGE.Dlc = getvalue ( EnvMACKID_MACKUSAGEDlc_);
//	 
//	if(getvalue(EnvMACKID_MACKUSAGETo_))
//	{
//		output(MSG_MACKID_MACKUSAGE);
//	}
//	else
//	{
//		Write("MACKID_MACKUSAGE Message is not sent ");
//	}
//	 
//	settimer(T_MSG_MACKID_MACKUSAGE,  getvalue(EnvMACKID_MACKUSAGETime_));
//	 
//
//}
//on timer T_MSG_RCM_Long_Acc_MAC 
//{
//	MSG_RCM_Long_Acc_MAC.RCM_Long_Acc_MACTx = getvalue ( EnvRCM_Long_Acc_MACTx_);
//	MSG_RCM_Long_Acc_MAC.RCM_Long_Acc_FVTx = getvalue ( EnvRCM_Long_Acc_FVTx_);
//	MSG_RCM_Long_Acc_MAC.Longitudinal_Acceleration = getvalue ( EnvLongitudinal_Acceleration_);
//	MSG_RCM_Long_Acc_MAC.ID072_E2E_CNTProfile2 = getvalue ( EnvID072_E2E_CNTProfile2_);
//	MSG_RCM_Long_Acc_MAC.Signal_State_Longitudinal_Accele = getvalue ( EnvSignal_State_Longitudinal_Accele_);
//	MSG_RCM_Long_Acc_MAC.ID072_E2E_CRCProfile2 = getvalue ( EnvID072_E2E_CRCProfile2_);
//
//	/*  Output  */
//	
//	MSG_RCM_Long_Acc_MAC.Dlc = getvalue ( EnvRCM_Long_Acc_MACDlc_);
//	 
//	if(getvalue(EnvRCM_Long_Acc_MACTo_))
//	{
//		output(MSG_RCM_Long_Acc_MAC);
//	}
//	else
//	{
//		Write("RCM_Long_Acc_MAC Message is not sent ");
//	}
//	 
//	settimer(T_MSG_RCM_Long_Acc_MAC,  getvalue(EnvRCM_Long_Acc_MACTime_));
//	 
//
//}
//on timer T_MSG_YAW_Rate_Brake_Control_1_2_MAC 
//{
//	MSG_YAW_Rate_Brake_Control_1_2_MAC.YAW_Rate_Brake_Control_1_2_MACTx = getvalue ( EnvYAW_Rate_Brake_Control_1_2_MACTx_);
//	MSG_YAW_Rate_Brake_Control_1_2_MAC.YAW_Rate_Brake_Control_1_2_FVTx = getvalue ( EnvYAW_Rate_Brake_Control_1_2_FVTx_);
//	MSG_YAW_Rate_Brake_Control_1_2_MAC.VehSensSig_2_No_Cs = getvalue ( EnvVehSensSig_2_No_Cs_);
//	MSG_YAW_Rate_Brake_Control_1_2_MAC.VehSensSig_2_No_Cnt = getvalue ( EnvVehSensSig_2_No_Cnt_);
//	MSG_YAW_Rate_Brake_Control_1_2_MAC.SlaCtl_D_Actl = getvalue ( EnvSlaCtl_D_Actl_);
//	MSG_YAW_Rate_Brake_Control_1_2_MAC.BrkMstAActl_D_Qf = getvalue ( EnvBrkMstAActl_D_Qf_);
//	MSG_YAW_Rate_Brake_Control_1_2_MAC.BrkMstPrs_A_Actl = getvalue ( EnvBrkMstPrs_A_Actl_);
//
//	/*  Output  */
//	
//	MSG_YAW_Rate_Brake_Control_1_2_MAC.Dlc = getvalue ( EnvYAW_Rate_Brake_Control_1_2_MACDlc_);
//	 
//	if(getvalue(EnvYAW_Rate_Brake_Control_1_2_MACTo_))
//	{
//		output(MSG_YAW_Rate_Brake_Control_1_2_MAC);
//	}
//	else
//	{
//		Write("YAW_Rate_Brake_Control_1_2_MAC Message is not sent ");
//	}
//	 
//	settimer(T_MSG_YAW_Rate_Brake_Control_1_2_MAC,  getvalue(EnvYAW_Rate_Brake_Control_1_2_MACTime_));
//	 
//
//}
//on timer T_MSG_FSC_AEBReq_Info 
//{
//	MSG_FSC_AEBReq_Info.FSC_AEBReq_Info_No_Cs = getvalue ( EnvFSC_AEBReq_Info_No_Cs_);
//	MSG_FSC_AEBReq_Info.FSC_AEBReq_Info_No_Cnt = getvalue ( EnvFSC_AEBReq_Info_No_Cnt_);
//	MSG_FSC_AEBReq_Info.FSC_AEB_Fail = getvalue ( EnvFSC_AEB_Fail_);
//	MSG_FSC_AEBReq_Info.Req_AEB_VRU_Set_Flag = getvalue ( EnvReq_AEB_VRU_Set_Flag_);
//	MSG_FSC_AEBReq_Info.Req_AEB_VRU_Acceleration = getvalue ( EnvReq_AEB_VRU_Acceleration_);
//	MSG_FSC_AEBReq_Info.Req_AEB_VRU_B_Flag = getvalue ( EnvReq_AEB_VRU_B_Flag_);
//	MSG_FSC_AEBReq_Info.Req_AEB_VRU_B_Deceleration = getvalue ( EnvReq_AEB_VRU_B_Deceleration_);
//	MSG_FSC_AEBReq_Info.AEB_VRU_Prefill_Level = getvalue ( EnvAEB_VRU_Prefill_Level_);
//	MSG_FSC_AEBReq_Info.AEB_VRU_Warning_jerk = getvalue ( EnvAEB_VRU_Warning_jerk_);
//	MSG_FSC_AEBReq_Info.AEB_VRU_state = getvalue ( EnvAEB_VRU_state_);
//	MSG_FSC_AEBReq_Info.ID080_E2E_CNTProfile2 = getvalue ( EnvID080_E2E_CNTProfile2_);
//	MSG_FSC_AEBReq_Info.ID080_E2E_CRCProfile2 = getvalue ( EnvID080_E2E_CRCProfile2_);
//
//	/*  Output  */
//	if(data_selection == 0x16)
//	{
//	if(use_case == 0) // use case 1: Invalid - Unobtain 
//	{
//		if (Unobtain_pattern != 0)
//		{
//			if (Invalid_pattern > 0)
//			{
//				Invalid_pattern--;
//				putvalue(EnvFSC_AEBReq_InfoTo_,1);
//				MSG_FSC_AEBReq_Info.FSC_AEBReq_Info_No_Cs  = 0;
//			}else
//			{
//				putvalue(EnvFSC_AEBReq_InfoTo_,0);
//        Unobtain_pattern--;
//			}
//		}else
//			{
//        putvalue(EnvFSC_AEBReq_InfoTo_,1);
//				Invalid_pattern = getvalue(Env_24EDR_Invalid_)-1;
//				Unobtain_pattern = getvalue(Env_24EDR_Unobtain_);
//			}
//	}else if (use_case == 1) //use case 2 : invalid - valid
//	{
//		if(Valid_pattern > 0)
//		{
//			if(Invalid_pattern > 0)
//			{
//				Invalid_pattern--;
//				MSG_FSC_AEBReq_Info.FSC_AEBReq_Info_No_Cs  = 0;
//			}else
//			{
//				Valid_pattern --;
//			}
//		}else
//		{
//		MSG_FSC_AEBReq_Info.FSC_AEBReq_Info_No_Cs  = 0;
//			Invalid_pattern = getvalue(Env_24EDR_Invalid_)-1;
//			Valid_pattern = getvalue(Env_24EDR_Valid_);
//		}
//		
//	}else if (use_case == 2) //use case 2: unobtain - valid
//  {
//    if(Valid_pattern > 0)
//		{
//			if(Unobtain_pattern != 0)
//			{
//				Unobtain_pattern--;
//				putvalue(EnvFSC_AEBReq_InfoTo_,0);
//			}else
//			{
//				Valid_pattern --;
//        putvalue(EnvFSC_AEBReq_InfoTo_,1);
//			}
//		}else
//		{
//			putvalue(EnvFSC_AEBReq_InfoTo_,0);
//			Unobtain_pattern = getvalue(Env_24EDR_Unobtain_)-1;
//			Valid_pattern = getvalue(Env_24EDR_Valid_);
//		}
//  }
//	}	
//	MSG_FSC_AEBReq_Info.Dlc = getvalue ( EnvFSC_AEBReq_InfoDlc_);
//	 
//	if(getvalue(EnvFSC_AEBReq_InfoTo_))
//	{
//		output(MSG_FSC_AEBReq_Info);
//	}
//	else
//	{
//	}
//	 
//	settimer(T_MSG_FSC_AEBReq_Info,  getvalue(EnvFSC_AEBReq_InfoTime_));
//
//}
//on timer T_MSG_RCM_Yaw_Rate_MAC 
//{
//	MSG_RCM_Yaw_Rate_MAC.RCM_Yaw_Rate_MACTx = getvalue ( EnvRCM_Yaw_Rate_MACTx_);
//	MSG_RCM_Yaw_Rate_MAC.RCM_Yaw_Rate_FVTx = getvalue ( EnvRCM_Yaw_Rate_FVTx_);
//	MSG_RCM_Yaw_Rate_MAC.Yaw_Rate = getvalue ( EnvYaw_Rate_);
//	MSG_RCM_Yaw_Rate_MAC.ID070_E2E_CNTProfile2 = getvalue ( EnvID070_E2E_CNTProfile2_);
//	MSG_RCM_Yaw_Rate_MAC.Signal_State_Yaw_Rate = getvalue ( EnvSignal_State_Yaw_Rate_);
//	MSG_RCM_Yaw_Rate_MAC.ID070_E2E_CRCProfile2 = getvalue ( EnvID070_E2E_CRCProfile2_);
//
//	/*  Output  */
//	
//	MSG_RCM_Yaw_Rate_MAC.Dlc = getvalue ( EnvRCM_Yaw_Rate_MACDlc_);
//	 
//	if(getvalue(EnvRCM_Yaw_Rate_MACTo_))
//	{
//		output(MSG_RCM_Yaw_Rate_MAC);
//	}
//	else
//	{
//		Write("RCM_Yaw_Rate_MAC Message is not sent ");
//	}
//	 
//	settimer(T_MSG_RCM_Yaw_Rate_MAC,  getvalue(EnvRCM_Yaw_Rate_MACTime_));
//	 
//
//}
//on timer T_MSG_ABS_Autosar_NM 
//{
//	MSG_ABS_Autosar_NM.DSC_NM_UserData5 = getvalue ( EnvDSC_NM_UserData5_);
//	MSG_ABS_Autosar_NM.DSC_NM_UserData4 = getvalue ( EnvDSC_NM_UserData4_);
//	MSG_ABS_Autosar_NM.DSC_NM_UserData3 = getvalue ( EnvDSC_NM_UserData3_);
//	MSG_ABS_Autosar_NM.DSC_NM_UserData2 = getvalue ( EnvDSC_NM_UserData2_);
//	MSG_ABS_Autosar_NM.DSC_NM_UserData1 = getvalue ( EnvDSC_NM_UserData1_);
//	MSG_ABS_Autosar_NM.DSC_NM_UserData0 = getvalue ( EnvDSC_NM_UserData0_);
//	MSG_ABS_Autosar_NM.DSC_NM_RptMsgRequest = getvalue ( EnvDSC_NM_RptMsgRequest_);
//	MSG_ABS_Autosar_NM.DSC_NM_SourceNodeID = getvalue ( EnvDSC_NM_SourceNodeID_);
//
//	/*  Output  */
//	
//	MSG_ABS_Autosar_NM.Dlc = getvalue ( EnvABS_Autosar_NMDlc_);
//	 
//	if(getvalue(EnvABS_Autosar_NMTo_))
//	{
//		output(MSG_ABS_Autosar_NM);
//	}
//	else
//	{
//		Write("ABS_Autosar_NM Message is not sent ");
//	}
//	 
//	settimer(T_MSG_ABS_Autosar_NM,  getvalue(EnvABS_Autosar_NMTime_));
//	 
//
//}
on timer T_MSG_Steering_Column_Switch 
{
	MSG_Steering_Column_Switch.HECSwtchA_Cs = getvalue ( EnvHECSwtchA_Cs_);
	MSG_Steering_Column_Switch.HECSwtchA_Cnt = getvalue ( EnvHECSwtchA_Cnt_);
	MSG_Steering_Column_Switch.AEB_HEC_Fail_Flag = getvalue ( EnvAEB_HEC_Fail_Flag_);
	MSG_Steering_Column_Switch.Info_Status_B_Actl = getvalue ( EnvInfo_Status_B_Actl_);
	MSG_Steering_Column_Switch.WiprTestMode_B_Actl = getvalue ( EnvWiprTestMode_B_Actl_);
	MSG_Steering_Column_Switch.SpAlarm_B_Actl = getvalue ( EnvSpAlarm_B_Actl_);
	MSG_Steering_Column_Switch.FrntWiprInt_V_Actl = getvalue ( EnvFrntWiprInt_V_Actl_);
	MSG_Steering_Column_Switch.PanelCont_D_Actl = getvalue ( EnvPanelCont_D_Actl_);
	MSG_Steering_Column_Switch.AvgFuelEco_Rst_HEC = getvalue ( EnvAvgFuelEco_Rst_HEC_);
	MSG_Steering_Column_Switch.Veh_speed = getvalue ( EnvVeh_speed_);
	MSG_Steering_Column_Switch.PaddleShiftDwn_D_Actl = getvalue ( EnvPaddleShiftDwn_D_Actl_);
	MSG_Steering_Column_Switch.PaddleShiftUp_D_Actl = getvalue ( EnvPaddleShiftUp_D_Actl_);
	MSG_Steering_Column_Switch.RearWasherSw_B_Actl = getvalue ( EnvRearWasherSw_B_Actl_);
	MSG_Steering_Column_Switch.FrntWasherSw_B_Actl = getvalue ( EnvFrntWasherSw_B_Actl_);
	MSG_Steering_Column_Switch.RearWiprStats_D_Actl = getvalue ( EnvRearWiprStats_D_Actl_);
	MSG_Steering_Column_Switch.FrntWiprStats_D_Actl = getvalue ( EnvFrntWiprStats_D_Actl_);
	MSG_Steering_Column_Switch.WiprSw_D_Qf = getvalue ( EnvWiprSw_D_Qf_);
	MSG_Steering_Column_Switch.Veh_speed_Fault = getvalue ( EnvVeh_speed_Fault_);
	MSG_Steering_Column_Switch.ALH_HBC_Sw_B_Actl = getvalue ( EnvALH_HBC_Sw_B_Actl_);
	MSG_Steering_Column_Switch.Veh_speed_Unit = getvalue ( EnvVeh_speed_Unit_);
	MSG_Steering_Column_Switch.Mfs_Turn_Stalk_SW_Status = getvalue ( EnvMfs_Turn_Stalk_SW_Status_);
	MSG_Steering_Column_Switch.HeadLghtOffSw_B_Actl = getvalue ( EnvHeadLghtOffSw_B_Actl_);
	MSG_Steering_Column_Switch.PassngSw_B_Actl = getvalue ( EnvPassngSw_B_Actl_);
	MSG_Steering_Column_Switch.RearFogSw_B_Actl = getvalue ( EnvRearFogSw_B_Actl_);
	MSG_Steering_Column_Switch.RSRmid_TmpOffReq = getvalue ( EnvRSRmid_TmpOffReq_);
	MSG_Steering_Column_Switch.HeadLghtHiSw_B_Actl = getvalue ( EnvHeadLghtHiSw_B_Actl_);
	MSG_Steering_Column_Switch.HeadLghtLoSw_B_Actl = getvalue ( EnvHeadLghtLoSw_B_Actl_);
	MSG_Steering_Column_Switch.TnsSw_B_Actl = getvalue ( EnvTnsSw_B_Actl_);
	MSG_Steering_Column_Switch.LghtSw_D_Qf = getvalue ( EnvLghtSw_D_Qf_);

	/*  Output  */
	if(data_selection == 0x13)
	{
	if(use_case == 0) // use case 1: Invalid - Unobtain 
	{
		if (Unobtain_pattern != 0)
		{
			if (Invalid_pattern > 0)
			{
				Invalid_pattern--;
				putvalue(EnvSteering_Column_SwitchTo_,1);
				MSG_Steering_Column_Switch.HECSwtchA_Cs = 0;
			}else
			{
				putvalue(EnvSteering_Column_SwitchTo_,0);
        Unobtain_pattern--;
			}
		}else
			{
        putvalue(EnvSteering_Column_SwitchTo_,1);
				Invalid_pattern = getvalue(Env_24EDR_Invalid_)-1;
				Unobtain_pattern = getvalue(Env_24EDR_Unobtain_);
			}
	}else if (use_case == 1) //use case 2 : invalid - valid
	{
		if(Valid_pattern > 0)
		{
			if(Invalid_pattern > 0)
			{
				Invalid_pattern--;
				MSG_Steering_Column_Switch.HECSwtchA_Cs = 0;
			}else
			{
				Valid_pattern --;
			}
		}else
		{
		MSG_Steering_Column_Switch.HECSwtchA_Cs = 0;
			Invalid_pattern = getvalue(Env_24EDR_Invalid_)-1;
			Valid_pattern = getvalue(Env_24EDR_Valid_);
		}
		
	}else if (use_case == 2) //use case 2: unobtain - valid
  {
    if(Valid_pattern > 0)
		{
			if(Unobtain_pattern != 0)
			{
				Unobtain_pattern--;
				putvalue(EnvSteering_Column_SwitchTo_,0);
			}else
			{
				Valid_pattern --;
        putvalue(EnvSteering_Column_SwitchTo_,1);
			}
		}else
		{
			putvalue(EnvSteering_Column_SwitchTo_,0);
			Unobtain_pattern = getvalue(Env_24EDR_Unobtain_)-1;
			Valid_pattern = getvalue(Env_24EDR_Valid_);
		}
  }
	}	
	MSG_Steering_Column_Switch.Dlc = getvalue ( EnvSteering_Column_SwitchDlc_);
	 
	if(getvalue(EnvSteering_Column_SwitchTo_))
	{
		output(MSG_Steering_Column_Switch);
	}
	else
	{
		// Write("Steering_Column_Switch Message is not sent ");
	}
	 
	settimer(T_MSG_Steering_Column_Switch,  getvalue(EnvSteering_Column_SwitchTime_));
	 

}
//on timer T_MSG_BCM_Information1 
//{
//	MSG_BCM_Information1.BCMINFO1_No_Cs = getvalue ( EnvBCMINFO1_No_Cs_);
//	MSG_BCM_Information1.BCMINFO1_No_Cnt = getvalue ( EnvBCMINFO1_No_Cnt_);
//	MSG_BCM_Information1.SndRSP_Fail_B_Actl = getvalue ( EnvSndRSP_Fail_B_Actl_);
//	MSG_BCM_Information1.SndFSP_Fail_B_Actl = getvalue ( EnvSndFSP_Fail_B_Actl_);
//	MSG_BCM_Information1.Hazard_lamp_State_D_Actl = getvalue ( EnvHazard_lamp_State_D_Actl_);
//	MSG_BCM_Information1.DRL_Tail_Lamp_B_Rq = getvalue ( EnvDRL_Tail_Lamp_B_Rq_);
//	MSG_BCM_Information1.TNS_Buzzer_Cntl_Req = getvalue ( EnvTNS_Buzzer_Cntl_Req_);
//	MSG_BCM_Information1.Turn_Snd_Cmd_Left = getvalue ( EnvTurn_Snd_Cmd_Left_);
//	MSG_BCM_Information1.Turn_Snd_Cmd_Right = getvalue ( EnvTurn_Snd_Cmd_Right_);
//	MSG_BCM_Information1.WiprGuid_B_Rq = getvalue ( EnvWiprGuid_B_Rq_);
//	MSG_BCM_Information1.BurglarHorn_B_Req = getvalue ( EnvBurglarHorn_B_Req_);
//	MSG_BCM_Information1.RSRmid_Indicator_Req = getvalue ( EnvRSRmid_Indicator_Req_);
//	MSG_BCM_Information1.RSRmid_DisplayReq = getvalue ( EnvRSRmid_DisplayReq_);
//	MSG_BCM_Information1.BlwCont_B_Actl = getvalue ( EnvBlwCont_B_Actl_);
//	MSG_BCM_Information1.FrntWipr_D_Actl = getvalue ( EnvFrntWipr_D_Actl_);
//	MSG_BCM_Information1.SteeringHeatCutLvl = getvalue ( EnvSteeringHeatCutLvl_);
//	MSG_BCM_Information1.PtcCutLvl = getvalue ( EnvPtcCutLvl_);
//	MSG_BCM_Information1.BmotCutLvl = getvalue ( EnvBmotCutLvl_);
//	MSG_BCM_Information1.SeatHeatCutLvl = getvalue ( EnvSeatHeatCutLvl_);
//	MSG_BCM_Information1.RdefCutLvl = getvalue ( EnvRdefCutLvl_);
//	MSG_BCM_Information1.SeatVentCutLvl = getvalue ( EnvSeatVentCutLvl_);
//	MSG_BCM_Information1.WshrLvl_D_Actl = getvalue ( EnvWshrLvl_D_Actl_);
//	MSG_BCM_Information1.TNS_IpcDsply_D_Rq = getvalue ( EnvTNS_IpcDsply_D_Rq_);
//	MSG_BCM_Information1.Turn_Ind_Cmd_Left = getvalue ( EnvTurn_Ind_Cmd_Left_);
//	MSG_BCM_Information1.Turn_Ind_Cmd_Right = getvalue ( EnvTurn_Ind_Cmd_Right_);
//	MSG_BCM_Information1.Turnlamp_ESS_B_Req = getvalue ( EnvTurnlamp_ESS_B_Req_);
//	MSG_BCM_Information1.Turnlamp_KoDo_B_Req = getvalue ( EnvTurnlamp_KoDo_B_Req_);
//	MSG_BCM_Information1.LightWarning_D_Rq = getvalue ( EnvLightWarning_D_Rq_);
//	MSG_BCM_Information1.ResHeatCont_B_Actl = getvalue ( EnvResHeatCont_B_Actl_);
//	MSG_BCM_Information1.ResEngCont_B_Actl = getvalue ( EnvResEngCont_B_Actl_);
//	MSG_BCM_Information1.CBDA_Sleep_B_Rq = getvalue ( EnvCBDA_Sleep_B_Rq_);
//	MSG_BCM_Information1.RearWiprLo_B_Rq = getvalue ( EnvRearWiprLo_B_Rq_);
//	MSG_BCM_Information1.AutoWiprIND_B_Rq = getvalue ( EnvAutoWiprIND_B_Rq_);
//	MSG_BCM_Information1.RearFogIpcDsply_B_Rq = getvalue ( EnvRearFogIpcDsply_B_Rq_);
//	MSG_BCM_Information1.HiBeamIpcDsply_B_Rq = getvalue ( EnvHiBeamIpcDsply_B_Rq_);
//
//	/*  Output  */
//	
//	MSG_BCM_Information1.Dlc = getvalue ( EnvBCM_Information1Dlc_);
//	 
//	if(getvalue(EnvBCM_Information1To_))
//	{
//		output(MSG_BCM_Information1);
//	}
//	else
//	{
//		Write("BCM_Information1 Message is not sent ");
//	}
//	 
//	settimer(T_MSG_BCM_Information1,  getvalue(EnvBCM_Information1Time_));
//	 
//
//}
//on timer T_MSG_EPAS_Bus_Status 
//{
//	MSG_EPAS_Bus_Status.DiagSupt_Status_EPAS = getvalue ( EnvDiagSupt_Status_EPAS_);
//	MSG_EPAS_Bus_Status.TrigPriority_EPAS = getvalue ( EnvTrigPriority_EPAS_);
//	MSG_EPAS_Bus_Status.TrigReq_EPAS = getvalue ( EnvTrigReq_EPAS_);
//	MSG_EPAS_Bus_Status.DTC3_Sts_EPAS = getvalue ( EnvDTC3_Sts_EPAS_);
//	MSG_EPAS_Bus_Status.DTC3_Nbr_EPAS = getvalue ( EnvDTC3_Nbr_EPAS_);
//	MSG_EPAS_Bus_Status.DTC2_Sts_EPAS = getvalue ( EnvDTC2_Sts_EPAS_);
//	MSG_EPAS_Bus_Status.DTC2_Nbr_EPAS = getvalue ( EnvDTC2_Nbr_EPAS_);
//	MSG_EPAS_Bus_Status.DTC1_Sts_EPAS = getvalue ( EnvDTC1_Sts_EPAS_);
//	MSG_EPAS_Bus_Status.DTC1_Nbr_EPAS = getvalue ( EnvDTC1_Nbr_EPAS_);
//	MSG_EPAS_Bus_Status.DataNumber_EPAS = getvalue ( EnvDataNumber_EPAS_);
//
//	/*  Output  */
//	
//	MSG_EPAS_Bus_Status.Dlc = getvalue ( EnvEPAS_Bus_StatusDlc_);
//	 
//	if(getvalue(EnvEPAS_Bus_StatusTo_))
//	{
//		output(MSG_EPAS_Bus_Status);
//	}
//	else
//	{
//		Write("EPAS_Bus_Status Message is not sent ");
//	}
//	 
//	settimer(T_MSG_EPAS_Bus_Status,  getvalue(EnvEPAS_Bus_StatusTime_));
//	 
//
//}
//on timer T_MSG_MACKVERI3 
//{
//	MSG_MACKVERI3.MACKVERI3_2 = getvalue ( EnvMACKVERI3_2_);
//	MSG_MACKVERI3.MACKVERI3_1 = getvalue ( EnvMACKVERI3_1_);
//
//	/*  Output  */
//	
//	MSG_MACKVERI3.Dlc = getvalue ( EnvMACKVERI3Dlc_);
//	 
//	if(getvalue(EnvMACKVERI3To_))
//	{
//		output(MSG_MACKVERI3);
//	}
//	else
//	{
//		Write("MACKVERI3 Message is not sent ");
//	}
//	 
//	settimer(T_MSG_MACKVERI3,  getvalue(EnvMACKVERI3Time_));
//	 
//
//}
on timer T_MSG_ADAS_HMI_Information12 
{
	MSG_ADAS_HMI_Information12.CBDA_target_lh = getvalue ( EnvCBDA_target_lh_);
	MSG_ADAS_HMI_Information12.CBDA_target_rh = getvalue ( EnvCBDA_target_rh_);
	MSG_ADAS_HMI_Information12.CBDA_EV_failure = getvalue ( EnvCBDA_EV_failure_);
	MSG_ADAS_HMI_Information12.CBDA_EV_tmp_failure = getvalue ( EnvCBDA_EV_tmp_failure_);
	MSG_ADAS_HMI_Information12.CBDA_EV_fallback = getvalue ( EnvCBDA_EV_fallback_);
	MSG_ADAS_HMI_Information12.CBDA_fallback = getvalue ( EnvCBDA_fallback_);
	MSG_ADAS_HMI_Information12.CBDA_state = getvalue ( EnvCBDA_state_);
	MSG_ADAS_HMI_Information12.LDW_lane_lh = getvalue ( EnvLDW_lane_lh_);
	MSG_ADAS_HMI_Information12.LDW_lane_rh = getvalue ( EnvLDW_lane_rh_);
	MSG_ADAS_HMI_Information12.LDW_EV_failure = getvalue ( EnvLDW_EV_failure_);
	MSG_ADAS_HMI_Information12.LDW_EV_tmp_failure = getvalue ( EnvLDW_EV_tmp_failure_);
	MSG_ADAS_HMI_Information12.LDW_EV_warning_rh = getvalue ( EnvLDW_EV_warning_rh_);
	MSG_ADAS_HMI_Information12.LDW_EV_warning_lh = getvalue ( EnvLDW_EV_warning_lh_);
	MSG_ADAS_HMI_Information12.LDW_fallback = getvalue ( EnvLDW_fallback_);
	MSG_ADAS_HMI_Information12.LDW_state = getvalue ( EnvLDW_state_);
	MSG_ADAS_HMI_Information12.OCP_opp_lh = getvalue ( EnvOCP_opp_lh_);
	MSG_ADAS_HMI_Information12.OCP_opp_rh = getvalue ( EnvOCP_opp_rh_);
	MSG_ADAS_HMI_Information12.OCP_lane_lh = getvalue ( EnvOCP_lane_lh_);
	MSG_ADAS_HMI_Information12.OCP_lane_rh = getvalue ( EnvOCP_lane_rh_);
	MSG_ADAS_HMI_Information12.OCP_EV_failure = getvalue ( EnvOCP_EV_failure_);
	MSG_ADAS_HMI_Information12.OCP_EV_tmp_failure = getvalue ( EnvOCP_EV_tmp_failure_);
	MSG_ADAS_HMI_Information12.OCP_alarm = getvalue ( EnvOCP_alarm_);
	MSG_ADAS_HMI_Information12.OCP_fallback = getvalue ( EnvOCP_fallback_);
	MSG_ADAS_HMI_Information12.OCP_state = getvalue ( EnvOCP_state_);
	MSG_ADAS_HMI_Information12.BSP_alarm = getvalue ( EnvBSP_alarm_);
	MSG_ADAS_HMI_Information12.BSP_target_lh = getvalue ( EnvBSP_target_lh_);
	MSG_ADAS_HMI_Information12.BSP_target_rh = getvalue ( EnvBSP_target_rh_);
	MSG_ADAS_HMI_Information12.BSP_lane_lh = getvalue ( EnvBSP_lane_lh_);
	MSG_ADAS_HMI_Information12.BSP_lane_rh = getvalue ( EnvBSP_lane_rh_);
	MSG_ADAS_HMI_Information12.BSP_EV_failure = getvalue ( EnvBSP_EV_failure_);
	MSG_ADAS_HMI_Information12.BSP_EV_tmp_failure = getvalue ( EnvBSP_EV_tmp_failure_);
	MSG_ADAS_HMI_Information12.BSP_fallback = getvalue ( EnvBSP_fallback_);
	MSG_ADAS_HMI_Information12.BSP_state = getvalue ( EnvBSP_state_);

	/*  Output  */
	if((data_selection == 0x0F)||(data_selection == 0x11))
	{
	if(use_case == 0) // use case 1: Invalid - Unobtain 
	{
		if (Unobtain_pattern != 0)
		{
			if (Invalid_pattern > 0)
			{
				Invalid_pattern--;
				putvalue(EnvADAS_HMI_Information12To_,1);
				if(data_selection == 0x0F){
				MSG_ADAS_HMI_Information12.BSP_state  = 5;
				}else
				{
					MSG_ADAS_HMI_Information12.LDW_state = 5;
				}
			}else
			{
				putvalue(EnvADAS_HMI_Information12To_,0);
        Unobtain_pattern--;
			}
		}else
			{
        if(data_selection == 0x0F){
				MSG_ADAS_HMI_Information12.BSP_state  = 5;
				}else
				{
					MSG_ADAS_HMI_Information12.LDW_state = 5;
				}
        putvalue(EnvADAS_HMI_Information12To_,1);
				Invalid_pattern = getvalue(Env_24EDR_Invalid_)-1;
				Unobtain_pattern = getvalue(Env_24EDR_Unobtain_);
			}
	}else if (use_case == 1) //use case 2 : invalid - valid
	{
    
		if(Valid_pattern > 0)
		{
			if(Invalid_pattern > 0)
			{
				Invalid_pattern--;
				if(data_selection == 0x0F){
				MSG_ADAS_HMI_Information12.BSP_state  = 5;
				}else
				{
					MSG_ADAS_HMI_Information12.LDW_state = 5;
				}				
			}else
			{
				Valid_pattern --;
			}
		}else
		{
				if(data_selection == 0x0F){
        
				MSG_ADAS_HMI_Information12.BSP_state  = 5;
				}else
				{
					MSG_ADAS_HMI_Information12.LDW_state = 5;
				}
			Invalid_pattern = getvalue(Env_24EDR_Invalid_)-1;
			Valid_pattern = getvalue(Env_24EDR_Valid_);
		}
		
	}else if (use_case == 2) //use case 2: unobtain - valid
  {
    if(Valid_pattern > 0)
		{
			if(Unobtain_pattern != 0)
			{
				Unobtain_pattern--;
				putvalue(EnvADAS_HMI_Information12To_,0);
			}else
			{
				Valid_pattern --;
        putvalue(EnvADAS_HMI_Information12To_,1);
			}
		}else
		{
			putvalue(EnvADAS_HMI_Information12To_,0);
			Unobtain_pattern = getvalue(Env_24EDR_Unobtain_)-1;
			Valid_pattern = getvalue(Env_24EDR_Valid_);
		}
  }
	}
	MSG_ADAS_HMI_Information12.Dlc = getvalue ( EnvADAS_HMI_Information12Dlc_);
	 
	if(getvalue(EnvADAS_HMI_Information12To_))
	{
		output(MSG_ADAS_HMI_Information12);
	}
	else
	{
	//	Write("ADAS_HMI_Information12 Message is not sent ");
	}
	 
	settimer(T_MSG_ADAS_HMI_Information12,  getvalue(EnvADAS_HMI_Information12Time_));
	 

}
on timer T_MSG_BrakeSysFeatures 
{
	MSG_BrakeSysFeatures.BrakeSysFeatures_No_Cs = getvalue ( EnvBrakeSysFeatures_No_Cs_);
	MSG_BrakeSysFeatures.BrakeSysFeatures_No_Cnt = getvalue ( EnvBrakeSysFeatures_No_Cnt_);
	MSG_BrakeSysFeatures.Hdc_DisplayRequest_1 = getvalue ( EnvHdc_DisplayRequest_1_);
	MSG_BrakeSysFeatures.EPB_TrqRequire = getvalue ( EnvEPB_TrqRequire_);
	MSG_BrakeSysFeatures.EPB_IGoff_Apply_Inhibit = getvalue ( EnvEPB_IGoff_Apply_Inhibit_);
	MSG_BrakeSysFeatures.RGN_StpLmp_Fail_Flag = getvalue ( EnvRGN_StpLmp_Fail_Flag_);
	MSG_BrakeSysFeatures.LDA_B_Falt = getvalue ( EnvLDA_B_Falt_);
	MSG_BrakeSysFeatures.BrkFluidLvl_D_Actl = getvalue ( EnvBrkFluidLvl_D_Actl_);
	MSG_BrakeSysFeatures.DSC_OnOff_status = getvalue ( EnvDSC_OnOff_status_);
	MSG_BrakeSysFeatures.TCS_ENG_FAILD = getvalue ( EnvTCS_ENG_FAILD_);
	MSG_BrakeSysFeatures.TCS_BRK_FAILD = getvalue ( EnvTCS_BRK_FAILD_);
	MSG_BrakeSysFeatures.Dsc_B_Falt = getvalue ( EnvDsc_B_Falt_);
	MSG_BrakeSysFeatures.EPB_Status = getvalue ( EnvEPB_Status_);
	MSG_BrakeSysFeatures.EPB_SwitchPosition = getvalue ( EnvEPB_SwitchPosition_);
	MSG_BrakeSysFeatures.EPB_EnableExternalApply_TCM = getvalue ( EnvEPB_EnableExternalApply_TCM_);
	MSG_BrakeSysFeatures.EPB_EnableDecelRequest = getvalue ( EnvEPB_EnableDecelRequest_);
	MSG_BrakeSysFeatures.EPB_EnableExternalApply_VCM = getvalue ( EnvEPB_EnableExternalApply_VCM_);
	MSG_BrakeSysFeatures.Hdc_ActLamp_D_Rq = getvalue ( EnvHdc_ActLamp_D_Rq_);
	MSG_BrakeSysFeatures.Hdc_Trgt_Veh_V = getvalue ( EnvHdc_Trgt_Veh_V_);
	MSG_BrakeSysFeatures.OffSwitch_Info = getvalue ( EnvOffSwitch_Info_);
	MSG_BrakeSysFeatures.AutoHoldStdbyLamp_D_Rq = getvalue ( EnvAutoHoldStdbyLamp_D_Rq_);
	MSG_BrakeSysFeatures.EPB_IGoff_Apply_Buzzer = getvalue ( EnvEPB_IGoff_Apply_Buzzer_);
	MSG_BrakeSysFeatures.EBB_DisplayRequestB = getvalue ( EnvEBB_DisplayRequestB_);
	MSG_BrakeSysFeatures.EBB_DisplayRequestA = getvalue ( EnvEBB_DisplayRequestA_);
	MSG_BrakeSysFeatures.EPB_DisplayRequest5 = getvalue ( EnvEPB_DisplayRequest5_);
	MSG_BrakeSysFeatures.EPB_DisplayRequest4 = getvalue ( EnvEPB_DisplayRequest4_);
	MSG_BrakeSysFeatures.EPB_DisplayRequest3 = getvalue ( EnvEPB_DisplayRequest3_);
	MSG_BrakeSysFeatures.EPB_DisplayRequest2 = getvalue ( EnvEPB_DisplayRequest2_);
	MSG_BrakeSysFeatures.EPB_DisplayRequest1 = getvalue ( EnvEPB_DisplayRequest1_);
	MSG_BrakeSysFeatures.HydraulicHoldDis_B_Rq4 = getvalue ( EnvHydraulicHoldDis_B_Rq4_);
	MSG_BrakeSysFeatures.HydraulicHoldDis_B_Rq3 = getvalue ( EnvHydraulicHoldDis_B_Rq3_);
	MSG_BrakeSysFeatures.HydraulicHoldDis_B_Rq2 = getvalue ( EnvHydraulicHoldDis_B_Rq2_);
	MSG_BrakeSysFeatures.HydraulicHoldDis_B_Rq1 = getvalue ( EnvHydraulicHoldDis_B_Rq1_);
	MSG_BrakeSysFeatures.HydraulicHoldActLamp_D_Rq = getvalue ( EnvHydraulicHoldActLamp_D_Rq_);
	MSG_BrakeSysFeatures.DrvSlipCtlGuid_D_Rq = getvalue ( EnvDrvSlipCtlGuid_D_Rq_);
	MSG_BrakeSysFeatures.DrvAntiLckGuid_D_Rq = getvalue ( EnvDrvAntiLckGuid_D_Rq_);
	MSG_BrakeSysFeatures.DrvEBDGuid_D_Rq = getvalue ( EnvDrvEBDGuid_D_Rq_);

	/*  Output  */
	if(data_selection == 0x12)
	{
	if(use_case == 0) // use case 1: Invalid - Unobtain 
	{
		if (Unobtain_pattern != 0)
		{
			if (Invalid_pattern > 0)
			{
				Invalid_pattern--;
				putvalue(EnvBrakeSysFeaturesTo_,1);
				MSG_BrakeSysFeatures.EPB_Status = 5;
			}else
			{
				putvalue(EnvBrakeSysFeaturesTo_,0);
        Unobtain_pattern--;
			}
		}else
			{
				MSG_BrakeSysFeatures.EPB_Status = 5;
        putvalue(EnvADAS_HMI_Information12To_,1);
				Invalid_pattern = getvalue(Env_24EDR_Invalid_)-1;
				Unobtain_pattern = getvalue(Env_24EDR_Unobtain_);
			}
	}else if (use_case == 1) //use case 2 : invalid - valid
	{
    
		if(Valid_pattern > 0)
		{
			if(Invalid_pattern > 0)
			{
				Invalid_pattern--;
				MSG_BrakeSysFeatures.EPB_Status = 5;				
			}else
			{
				Valid_pattern --;
			}
		}else
		{
			MSG_BrakeSysFeatures.EPB_Status = 5;
			Invalid_pattern = getvalue(Env_24EDR_Invalid_)-1;
			Valid_pattern = getvalue(Env_24EDR_Valid_);
		}
		
	}else if (use_case == 2) //use case 2: unobtain - valid
  {
    if(Valid_pattern > 0)
		{
			if(Unobtain_pattern != 0)
			{
				Unobtain_pattern--;
				putvalue(EnvBrakeSysFeaturesTo_,0);
			}else
			{
				Valid_pattern --;
        putvalue(EnvBrakeSysFeaturesTo_,1);
			}
		}else
		{
			putvalue(EnvBrakeSysFeaturesTo_,0);
			Unobtain_pattern = getvalue(Env_24EDR_Unobtain_)-1;
			Valid_pattern = getvalue(Env_24EDR_Valid_);
		}
  }
	}
	MSG_BrakeSysFeatures.Dlc = getvalue ( EnvBrakeSysFeaturesDlc_);
	 
	if(getvalue(EnvBrakeSysFeaturesTo_))
	{
		output(MSG_BrakeSysFeatures);
	}
	else
	{
	//	Write("BrakeSysFeatures Message is not sent ");
	}
	 
	settimer(T_MSG_BrakeSysFeatures,  getvalue(EnvBrakeSysFeaturesTime_));
	 

}

//on timer T_MSG_Cruise_Multi_Switch_2_MAC 
//{
//	MSG_Cruise_Multi_Switch_2_MAC.Cruise_Multi_Switch_2_MACTx = getvalue ( EnvCruise_Multi_Switch_2_MACTx_);
//	MSG_Cruise_Multi_Switch_2_MAC.Cruise_Multi_Switch_2_FVTx = getvalue ( EnvCruise_Multi_Switch_2_FVTx_);
//	MSG_Cruise_Multi_Switch_2_MAC.HECSwtchB_2_Cs = getvalue ( EnvHECSwtchB_2_Cs_);
//	MSG_Cruise_Multi_Switch_2_MAC.HECSwtchB_2_Cnt = getvalue ( EnvHECSwtchB_2_Cnt_);
//	MSG_Cruise_Multi_Switch_2_MAC.FuelLidOpen_Rq_SW_B_Actl = getvalue ( EnvFuelLidOpen_Rq_SW_B_Actl_);
//	MSG_Cruise_Multi_Switch_2_MAC.TmpLoAlrmB_Actl = getvalue ( EnvTmpLoAlrmB_Actl_);
//	MSG_Cruise_Multi_Switch_2_MAC.HEC_HUD_Disp_MRCC_Status = getvalue ( EnvHEC_HUD_Disp_MRCC_Status_);
//	MSG_Cruise_Multi_Switch_2_MAC.HEC_HUD_Disp_MRCC_Status2 = getvalue ( EnvHEC_HUD_Disp_MRCC_Status2_);
//	MSG_Cruise_Multi_Switch_2_MAC.SP_DATE_No = getvalue ( EnvSP_DATE_No_);
//	MSG_Cruise_Multi_Switch_2_MAC.PsunOfSw_B_Actl = getvalue ( EnvPsunOfSw_B_Actl_);
//	MSG_Cruise_Multi_Switch_2_MAC.DposDrv2_B_Actl = getvalue ( EnvDposDrv2_B_Actl_);
//	MSG_Cruise_Multi_Switch_2_MAC.DposDrv1_B_Actl = getvalue ( EnvDposDrv1_B_Actl_);
//	MSG_Cruise_Multi_Switch_2_MAC.DposSet_B_Actl = getvalue ( EnvDposSet_B_Actl_);
//	MSG_Cruise_Multi_Switch_2_MAC.TLO_PLG_Sw_B_Actl = getvalue ( EnvTLO_PLG_Sw_B_Actl_);
//	MSG_Cruise_Multi_Switch_2_MAC.IStpRexSw_B_Actl = getvalue ( EnvIStpRexSw_B_Actl_);
//	MSG_Cruise_Multi_Switch_2_MAC.DSCOfSw_B_Actl = getvalue ( EnvDSCOfSw_B_Actl_);
//	MSG_Cruise_Multi_Switch_2_MAC.PSM_OfSw_B_Actl = getvalue ( EnvPSM_OfSw_B_Actl_);
//	MSG_Cruise_Multi_Switch_2_MAC.TVMOfSw_B_Actl = getvalue ( EnvTVMOfSw_B_Actl_);
//	MSG_Cruise_Multi_Switch_2_MAC.ADASOfSw_B_Actl = getvalue ( EnvADASOfSw_B_Actl_);
//	MSG_Cruise_Multi_Switch_2_MAC.MultiSw_D_Qf = getvalue ( EnvMultiSw_D_Qf_);
//
//	/*  Output  */
//	
//	MSG_Cruise_Multi_Switch_2_MAC.Dlc = getvalue ( EnvCruise_Multi_Switch_2_MACDlc_);
//	 
//	if(getvalue(EnvCruise_Multi_Switch_2_MACTo_))
//	{
//		output(MSG_Cruise_Multi_Switch_2_MAC);
//	}
//	else
//	{
//		Write("Cruise_Multi_Switch_2_MAC Message is not sent ");
//	}
//	 
//	settimer(T_MSG_Cruise_Multi_Switch_2_MAC,  getvalue(EnvCruise_Multi_Switch_2_MACTime_));
//	 
//
//}
//on timer T_MSG_SISS_Rqst 
//{
//	MSG_SISS_Rqst.Clutch_Stroke = getvalue ( EnvClutch_Stroke_);
//	MSG_SISS_Rqst.EngAout_N_RqTacho = getvalue ( EnvEngAout_N_RqTacho_);
//	MSG_SISS_Rqst.PTiStpRdy_B_Actl = getvalue ( EnvPTiStpRdy_B_Actl_);
//	MSG_SISS_Rqst.iStpDenyBrk_B_Actl = getvalue ( EnviStpDenyBrk_B_Actl_);
//	MSG_SISS_Rqst.iStpDenyPwStr_B_Actl = getvalue ( EnviStpDenyPwStr_B_Actl_);
//	MSG_SISS_Rqst.iStpKeySta_B_Actl = getvalue ( EnviStpKeySta_B_Actl_);
//	MSG_SISS_Rqst.iStpDenyAC_B_Actl = getvalue ( EnviStpDenyAC_B_Actl_);
//	MSG_SISS_Rqst.iStpDenyNrange_B_Actl = getvalue ( EnviStpDenyNrange_B_Actl_);
//	MSG_SISS_Rqst.iStpDenyDPF_B_Actl = getvalue ( EnviStpDenyDPF_B_Actl_);
//	MSG_SISS_Rqst.ELM_IRCutReq = getvalue ( EnvELM_IRCutReq_);
//	MSG_SISS_Rqst.BatteryWeakenFlag = getvalue ( EnvBatteryWeakenFlag_);
//	MSG_SISS_Rqst.iStpDoorOpen_B_Actl = getvalue ( EnviStpDoorOpen_B_Actl_);
//	MSG_SISS_Rqst.SISS_EngineState = getvalue ( EnvSISS_EngineState_);
//	MSG_SISS_Rqst.SISS_IRCutReq = getvalue ( EnvSISS_IRCutReq_);
//	MSG_SISS_Rqst.SKE_Control = getvalue ( EnvSKE_Control_);
//	MSG_SISS_Rqst.SISS_Mode_for_SKE = getvalue ( EnvSISS_Mode_for_SKE_);
//	MSG_SISS_Rqst.iStpReady_Rq = getvalue ( EnviStpReady_Rq_);
//	MSG_SISS_Rqst.iStpDenyBatt_B_Actl = getvalue ( EnviStpDenyBatt_B_Actl_);
//	MSG_SISS_Rqst.SlaCtl_B_Rq = getvalue ( EnvSlaCtl_B_Rq_);
//	MSG_SISS_Rqst.SISS_WarningLamp_R = getvalue ( EnvSISS_WarningLamp_R_);
//	MSG_SISS_Rqst.SISS_WarningLamp_G = getvalue ( EnvSISS_WarningLamp_G_);
//	MSG_SISS_Rqst.SISS_AlarmBuzzer = getvalue ( EnvSISS_AlarmBuzzer_);
//	MSG_SISS_Rqst.SISSStatus = getvalue ( EnvSISSStatus_);
//	MSG_SISS_Rqst.SrlyUpper_Connect_Rq = getvalue ( EnvSrlyUpper_Connect_Rq_);
//
//	/*  Output  */
//	
//	MSG_SISS_Rqst.Dlc = getvalue ( EnvSISS_RqstDlc_);
//	 
//	if(getvalue(EnvSISS_RqstTo_))
//	{
//		output(MSG_SISS_Rqst);
//	}
//	else
//	{
//		Write("SISS_Rqst Message is not sent ");
//	}
//	 
//	settimer(T_MSG_SISS_Rqst,  getvalue(EnvSISS_RqstTime_));
//	 
//
//}
//on timer T_MSG_VDT_RCM_EDR 
//{
//	MSG_VDT_RCM_EDR.VDT_RCM_EDR8 = getvalue ( EnvVDT_RCM_EDR8_);
//	MSG_VDT_RCM_EDR.VDT_RCM_EDR7 = getvalue ( EnvVDT_RCM_EDR7_);
//	MSG_VDT_RCM_EDR.VDT_RCM_EDR6 = getvalue ( EnvVDT_RCM_EDR6_);
//	MSG_VDT_RCM_EDR.VDT_RCM_EDR5 = getvalue ( EnvVDT_RCM_EDR5_);
//	MSG_VDT_RCM_EDR.VDT_RCM_EDR4 = getvalue ( EnvVDT_RCM_EDR4_);
//	MSG_VDT_RCM_EDR.VDT_RCM_EDR3 = getvalue ( EnvVDT_RCM_EDR3_);
//	MSG_VDT_RCM_EDR.VDT_RCM_EDR2 = getvalue ( EnvVDT_RCM_EDR2_);
//	MSG_VDT_RCM_EDR.VDT_RCM_EDR1 = getvalue ( EnvVDT_RCM_EDR1_);
//
//	/*  Output  */
//	
//	MSG_VDT_RCM_EDR.Dlc = getvalue ( EnvVDT_RCM_EDRDlc_);
//	 
//	if(getvalue(EnvVDT_RCM_EDRTo_))
//	{
//		output(MSG_VDT_RCM_EDR);
//	}
//	else
//	{
//		Write("VDT_RCM_EDR Message is not sent ");
//	}
//	 
//	settimer(T_MSG_VDT_RCM_EDR,  getvalue(EnvVDT_RCM_EDRTime_));
//	 
//
//}
//on timer T_MSG_MACKSEND5 
//{
//	MSG_MACKSEND5.MACKSEND5_2 = getvalue ( EnvMACKSEND5_2_);
//	MSG_MACKSEND5.MACKSEND5_1 = getvalue ( EnvMACKSEND5_1_);
//
//	/*  Output  */
//	
//	MSG_MACKSEND5.Dlc = getvalue ( EnvMACKSEND5Dlc_);
//	 
//	if(getvalue(EnvMACKSEND5To_))
//	{
//		output(MSG_MACKSEND5);
//	}
//	else
//	{
//		Write("MACKSEND5 Message is not sent ");
//	}
//	 
//	settimer(T_MSG_MACKSEND5,  getvalue(EnvMACKSEND5Time_));
//	 
//
//}
on timer T_MSG_ADAS_HMI_Information5 
{
	MSG_ADAS_HMI_Information5.REDKEY_EV_on = getvalue ( EnvREDKEY_EV_on_);
	MSG_ADAS_HMI_Information5.REDKEY_state = getvalue ( EnvREDKEY_state_);
//	MSG_ADAS_HMI_Information5.CTS_seatbelt_warning = getvalue ( EnvCTS_seatbelt_warning_);
	MSG_ADAS_HMI_Information5.ISA_EV_failure = getvalue ( EnvISA_EV_failure_);
	MSG_ADAS_HMI_Information5.ISA_EV_fallback = getvalue ( EnvISA_EV_fallback_);
	MSG_ADAS_HMI_Information5.ISA_EV_kickdown = getvalue ( EnvISA_EV_kickdown_);
	MSG_ADAS_HMI_Information5.ISA_EV_reject = getvalue ( EnvISA_EV_reject_);
	MSG_ADAS_HMI_Information5.ISA_EV_spd_autoset = getvalue ( EnvISA_EV_spd_autoset_);
	MSG_ADAS_HMI_Information5.ISA_overspeed = getvalue ( EnvISA_overspeed_);
	MSG_ADAS_HMI_Information5.ISA_sign = getvalue ( EnvISA_sign_);
	MSG_ADAS_HMI_Information5.ISA_state = getvalue ( EnvISA_state_);
	MSG_ADAS_HMI_Information5.ISA_fallback = getvalue ( EnvISA_fallback_);
	MSG_ADAS_HMI_Information5.ASC_EV_failure = getvalue ( EnvASC_EV_failure_);
	MSG_ADAS_HMI_Information5.ASC_EV_fallback = getvalue ( EnvASC_EV_fallback_);
	MSG_ADAS_HMI_Information5.ASC_EV_suspended = getvalue ( EnvASC_EV_suspended_);
	MSG_ADAS_HMI_Information5.ASC_EV_reject = getvalue ( EnvASC_EV_reject_);
	MSG_ADAS_HMI_Information5.ASC_EV_accept = getvalue ( EnvASC_EV_accept_);
	MSG_ADAS_HMI_Information5.ASC_state = getvalue ( EnvASC_state_);

	/*  Output  */
	if(data_selection == 0x05)
	{
	if(use_case == 0) // use case 1: Invalid - Unobtain 
	{
		if (Unobtain_pattern != 0)
		{
			if (Invalid_pattern > 0)
			{
				Invalid_pattern--;
				putvalue(EnvADAS_HMI_Information5To_,1);
				MSG_ADAS_HMI_Information5.ASC_state = 5;
			}else
			{
				putvalue(EnvADAS_HMI_Information5To_,0);
        Unobtain_pattern--;
			}
		}else
			{
        putvalue(EnvADAS_HMI_Information5To_,1);
				Invalid_pattern = getvalue(Env_24EDR_Invalid_)-1;
				Unobtain_pattern = getvalue(Env_24EDR_Unobtain_);
			}
	}else if (use_case == 1) //use case 2 : invalid - valid
	{
		if(Valid_pattern > 0)
		{
			if(Invalid_pattern > 0)
			{
				Invalid_pattern--;
				MSG_ADAS_HMI_Information5.ASC_state = 5;
			}else
			{
				Valid_pattern --;
			}
		}else
		{
      MSG_ADAS_HMI_Information5.ASC_state = 5;
			Invalid_pattern = getvalue(Env_24EDR_Invalid_)-1;
			Valid_pattern = getvalue(Env_24EDR_Valid_);
		}
		
	}else if (use_case == 2) //use case 2: unobtain - valid
  {
    if(Valid_pattern > 0)
		{
			if(Unobtain_pattern != 0)
			{
				Unobtain_pattern--;
				putvalue(EnvADAS_HMI_Information5To_,0);
			}else
			{
				Valid_pattern --;
        putvalue(EnvADAS_HMI_Information5To_,1);
			}
		}else
		{
			putvalue(EnvADAS_HMI_Information5To_,0);
			Unobtain_pattern = getvalue(Env_24EDR_Unobtain_)-1;
			Valid_pattern = getvalue(Env_24EDR_Valid_);
		}
  }
	}	
	MSG_ADAS_HMI_Information5.Dlc = getvalue ( EnvADAS_HMI_Information5Dlc_);
	 
	if(getvalue(EnvADAS_HMI_Information5To_))
	{
		output(MSG_ADAS_HMI_Information5);
	}
	else
	{
		//Write("ADAS_HMI_Information5 Message is not sent ");
	}
	 
	settimer(T_MSG_ADAS_HMI_Information5,  getvalue(EnvADAS_HMI_Information5Time_));
	 

}
//on timer T_MSG_RCM_ISO_SCRAP_Rx 
//{
//	MSG_RCM_ISO_SCRAP_Rx.RCM_SCRAP_Diag_Sig_Rx = getvalue ( EnvRCM_SCRAP_Diag_Sig_Rx_);
//
//	/*  Output  */
//	
//	MSG_RCM_ISO_SCRAP_Rx.Dlc = getvalue ( EnvRCM_ISO_SCRAP_RxDlc_);
//	 
//	if(getvalue(EnvRCM_ISO_SCRAP_RxTo_))
//	{
//		output(MSG_RCM_ISO_SCRAP_Rx);
//	}
//	else
//	{
//		Write("RCM_ISO_SCRAP_Rx Message is not sent ");
//	}
//	 
//	settimer(T_MSG_RCM_ISO_SCRAP_Rx,  getvalue(EnvRCM_ISO_SCRAP_RxTime_));
//	 
//
//}
//on timer T_MSG_ADAS_Longitudinal_Req_Brk_MAC 
//{
//	MSG_ADAS_Longitudinal_Req_Brk_MAC.ADAS_Longitudinal_Req_Brk_MACTx = getvalue ( EnvADAS_Longitudinal_Req_Brk_MACTx_);
//	MSG_ADAS_Longitudinal_Req_Brk_MAC.ADAS_Longitudinal_Req_Brk_FVTx = getvalue ( EnvADAS_Longitudinal_Req_Brk_FVTx_);
//	MSG_ADAS_Longitudinal_Req_Brk_MAC.EPB_ExternalApply_D_Rq_VCM = getvalue ( EnvEPB_ExternalApply_D_Rq_VCM_);
//	MSG_ADAS_Longitudinal_Req_Brk_MAC.ADAS_DSC_Request_ON_Flag = getvalue ( EnvADAS_DSC_Request_ON_Flag_);
//	MSG_ADAS_Longitudinal_Req_Brk_MAC.ADAS_Hold_Release_Request_Flag = getvalue ( EnvADAS_Hold_Release_Request_Flag_);
//	MSG_ADAS_Longitudinal_Req_Brk_MAC.ADAS_Hold_Request_Flag = getvalue ( EnvADAS_Hold_Request_Flag_);
//	MSG_ADAS_Longitudinal_Req_Brk_MAC.ADAS_Stop_Request_Flag = getvalue ( EnvADAS_Stop_Request_Flag_);
//	MSG_ADAS_Longitudinal_Req_Brk_MAC.ID214_E2E_CNTProfile2 = getvalue ( EnvID214_E2E_CNTProfile2_);
//	MSG_ADAS_Longitudinal_Req_Brk_MAC.ADAS_Types_brk = getvalue ( EnvADAS_Types_brk_);
//	MSG_ADAS_Longitudinal_Req_Brk_MAC.ID214_E2E_CRCProfile2 = getvalue ( EnvID214_E2E_CRCProfile2_);
//
//	/*  Output  */
//	
//	MSG_ADAS_Longitudinal_Req_Brk_MAC.Dlc = getvalue ( EnvADAS_Longitudinal_Req_Brk_MACDlc_);
//	 
//	if(getvalue(EnvADAS_Longitudinal_Req_Brk_MACTo_))
//	{
//		output(MSG_ADAS_Longitudinal_Req_Brk_MAC);
//	}
//	else
//	{
//		Write("ADAS_Longitudinal_Req_Brk_MAC Message is not sent ");
//	}
//	 
//	settimer(T_MSG_ADAS_Longitudinal_Req_Brk_MAC,  getvalue(EnvADAS_Longitudinal_Req_Brk_MACTime_));
//	 
//
//}
//on timer T_MSG_SmartKeylessRequest 
//{
//	MSG_SmartKeylessRequest.System_Check = getvalue ( EnvSystem_Check_);
//	MSG_SmartKeylessRequest.ABS_Tx_Request = getvalue ( EnvABS_Tx_Request_);
//	MSG_SmartKeylessRequest.Key_Not_Found = getvalue ( EnvKey_Not_Found_);
//	MSG_SmartKeylessRequest.Key_Battery_Low = getvalue ( EnvKey_Battery_Low_);
//	MSG_SmartKeylessRequest.Power_Not_Off = getvalue ( EnvPower_Not_Off_);
//	MSG_SmartKeylessRequest.Shift_position_Display = getvalue ( EnvShift_position_Display_);
//	MSG_SmartKeylessRequest.Eng_start_Display = getvalue ( EnvEng_start_Display_);
//	MSG_SmartKeylessRequest.Shift_lever_Display = getvalue ( EnvShift_lever_Display_);
//	MSG_SmartKeylessRequest.ESCL_Display = getvalue ( EnvESCL_Display_);
//	MSG_SmartKeylessRequest.Press_pedal_Display = getvalue ( EnvPress_pedal_Display_);
//	MSG_SmartKeylessRequest.Lamp_KEY_RED_Control = getvalue ( EnvLamp_KEY_RED_Control_);
//	MSG_SmartKeylessRequest.Lamp_KEY_GREEN_Control = getvalue ( EnvLamp_KEY_GREEN_Control_);
//
//	/*  Output  */
//	
//	MSG_SmartKeylessRequest.Dlc = getvalue ( EnvSmartKeylessRequestDlc_);
//	 
//	if(getvalue(EnvSmartKeylessRequestTo_))
//	{
//		output(MSG_SmartKeylessRequest);
//	}
//	else
//	{
//		Write("SmartKeylessRequest Message is not sent ");
//	}
//	 
//	settimer(T_MSG_SmartKeylessRequest,  getvalue(EnvSmartKeylessRequestTime_));
//	 
//
//}
//on timer T_MSG_EPAS_Diag_Rx 
//{
//	MSG_EPAS_Diag_Rx.EPAS_Diag_Sig_Rx = getvalue ( EnvEPAS_Diag_Sig_Rx_);
//
//	/*  Output  */
//	
//	MSG_EPAS_Diag_Rx.Dlc = getvalue ( EnvEPAS_Diag_RxDlc_);
//	 
//	if(getvalue(EnvEPAS_Diag_RxTo_))
//	{
//		output(MSG_EPAS_Diag_Rx);
//	}
//	else
//	{
//		Write("EPAS_Diag_Rx Message is not sent ");
//	}
//	 
//	settimer(T_MSG_EPAS_Diag_Rx,  getvalue(EnvEPAS_Diag_RxTime_));
//	 
//
//}
//on timer T_MSG_Steering_Wheel_Angle 
//{
//	MSG_Steering_Wheel_Angle.SteWhl_ChangeRateSign = getvalue ( EnvSteWhl_ChangeRateSign_);
//	MSG_Steering_Wheel_Angle.SteWhl_ChangeRate = getvalue ( EnvSteWhl_ChangeRate_);
//	MSG_Steering_Wheel_Angle.SteWhl_CalibStatus = getvalue ( EnvSteWhl_CalibStatus_);
//	MSG_Steering_Wheel_Angle.SteWhl_FailureStatus = getvalue ( EnvSteWhl_FailureStatus_);
//	MSG_Steering_Wheel_Angle.SteWhlAn_No_Cnt = getvalue ( EnvSteWhlAn_No_Cnt_);
//	MSG_Steering_Wheel_Angle.SteWhlAn_No_Cs = getvalue ( EnvSteWhlAn_No_Cs_);
//	MSG_Steering_Wheel_Angle.SteWhlRelCalib_An_Sns = getvalue ( EnvSteWhlRelCalib_An_Sns_);
//	MSG_Steering_Wheel_Angle.SteWhl_CalibRes = getvalue ( EnvSteWhl_CalibRes_);
//
//	/*  Output  */
//	
//	MSG_Steering_Wheel_Angle.Dlc = getvalue ( EnvSteering_Wheel_AngleDlc_);
//	 
//	if(getvalue(EnvSteering_Wheel_AngleTo_))
//	{
//		output(MSG_Steering_Wheel_Angle);
//	}
//	else
//	{
//		Write("Steering_Wheel_Angle Message is not sent ");
//	}
//	 
//	settimer(T_MSG_Steering_Wheel_Angle,  getvalue(EnvSteering_Wheel_AngleTime_));
//	 
//
//}
on timer T_MSG_VCM_Customize_Status_01 
{
	MSG_VCM_Customize_Status_01.CstmzStat_CTS_HighWay = getvalue ( EnvCstmzStat_CTS_HighWay_);
	MSG_VCM_Customize_Status_01.CstmzStat_FCTA_ONOFF = getvalue ( EnvCstmzStat_FCTA_ONOFF_);
	MSG_VCM_Customize_Status_01.CstmzStat_FCTA_Sens = getvalue ( EnvCstmzStat_FCTA_Sens_);
	MSG_VCM_Customize_Status_01.CstmzStat_TAP_ONOFF = getvalue ( EnvCstmzStat_TAP_ONOFF_);
	MSG_VCM_Customize_Status_01.CstmzStat_ELK_ONOFF = getvalue ( EnvCstmzStat_ELK_ONOFF_);
	MSG_VCM_Customize_Status_01.CstmzStat_RAEB_ONOFF = getvalue ( EnvCstmzStat_RAEB_ONOFF_);
	MSG_VCM_Customize_Status_01.CstmzStat_FAEB_Sens = getvalue ( EnvCstmzStat_FAEB_Sens_);
	MSG_VCM_Customize_Status_01.CstmzStat_FAEB_ONOFF = getvalue ( EnvCstmzStat_FAEB_ONOFF_);
	MSG_VCM_Customize_Status_01.CstmzStat_CTB_ONOFF = getvalue ( EnvCstmzStat_CTB_ONOFF_);
	MSG_VCM_Customize_Status_01.CstmzStat_LDP_ONOFF = getvalue ( EnvCstmzStat_LDP_ONOFF_);
	MSG_VCM_Customize_Status_01.CstmzStat_DAS_ONOFF = getvalue ( EnvCstmzStat_DAS_ONOFF_);
	MSG_VCM_Customize_Status_01.CstmzStat_LDP_RDP_Warn = getvalue ( EnvCstmzStat_LDP_RDP_Warn_);
	MSG_VCM_Customize_Status_01.CstmzStat_BSM_Sens = getvalue ( EnvCstmzStat_BSM_Sens_);
	MSG_VCM_Customize_Status_01.CstmzStat_BSM_ONOFF = getvalue ( EnvCstmzStat_BSM_ONOFF_);
	MSG_VCM_Customize_Status_01.CstmzStat_LDW_ONOFF = getvalue ( EnvCstmzStat_LDW_ONOFF_);
	MSG_VCM_Customize_Status_01.CstmzStat_RCTB_ONOFF = getvalue ( EnvCstmzStat_RCTB_ONOFF_);
	MSG_VCM_Customize_Status_01.CstmzStat_FCTB_Disp_ONOFF = getvalue ( EnvCstmzStat_FCTB_Disp_ONOFF_);
	MSG_VCM_Customize_Status_01.CstmzStat_FCTB_ONOFF = getvalue ( EnvCstmzStat_FCTB_ONOFF_);
	MSG_VCM_Customize_Status_01.CstmzStat_SpLmt_Warn_Thres = getvalue ( EnvCstmzStat_SpLmt_Warn_Thres_);
	MSG_VCM_Customize_Status_01.CstmzStat_SpLmt_Warn = getvalue ( EnvCstmzStat_SpLmt_Warn_);
	MSG_VCM_Customize_Status_01.CstmzStat_TSR_Warn_Thres = getvalue ( EnvCstmzStat_TSR_Warn_Thres_);
	MSG_VCM_Customize_Status_01.CstmzStat_TSR_Warn = getvalue ( EnvCstmzStat_TSR_Warn_);
	MSG_VCM_Customize_Status_01.CstmzStat_MRCC_Bz_ONOFF = getvalue ( EnvCstmzStat_MRCC_Bz_ONOFF_);
	MSG_VCM_Customize_Status_01.CstmzStat_TSR_Mode = getvalue ( EnvCstmzStat_TSR_Mode_);
	MSG_VCM_Customize_Status_01.CstmzStat_MRCC_ASC_Mode = getvalue ( EnvCstmzStat_MRCC_ASC_Mode_);
	MSG_VCM_Customize_Status_01.CstmzStat_TJA_Mode = getvalue ( EnvCstmzStat_TJA_Mode_);
	MSG_VCM_Customize_Status_01.Target_ID_VStat01 = getvalue ( EnvTarget_ID_VStat01_);

	/*  Output  */
	
	MSG_VCM_Customize_Status_01.Dlc = getvalue ( EnvVCM_Customize_Status_01Dlc_);
	 
	if(getvalue(EnvVCM_Customize_Status_01To_))
	{
		output(MSG_VCM_Customize_Status_01);
	}
	else
	{
		//Write("VCM_Customize_Status_01 Message is not sent ");
	}
	 
	settimer(T_MSG_VCM_Customize_Status_01,  getvalue(EnvVCM_Customize_Status_01Time_));
	 

}
//on timer T_MSG_RCMStatusMessage_MAC 
//{
//	MSG_RCMStatusMessage_MAC.RCMStatusMessage_MACTx = getvalue ( EnvRCMStatusMessage_MACTx_);
//	MSG_RCMStatusMessage_MAC.RCMStatusMessage_FVTx = getvalue ( EnvRCMStatusMessage_FVTx_);
//	MSG_RCMStatusMessage_MAC.ID340_No_Cs = getvalue ( EnvID340_No_Cs_);
//	MSG_RCMStatusMessage_MAC.ID340_No_Cnt = getvalue ( EnvID340_No_Cnt_);
//	MSG_RCMStatusMessage_MAC.RCM_EDRtype = getvalue ( EnvRCM_EDRtype_);
//	MSG_RCMStatusMessage_MAC.ConnectedEDRTrigger = getvalue ( EnvConnectedEDRTrigger_);
//	MSG_RCMStatusMessage_MAC.DHS_RILReq = getvalue ( EnvDHS_RILReq_);
//	MSG_RCMStatusMessage_MAC.FirstRowBucklePsngr = getvalue ( EnvFirstRowBucklePsngr_);
//	MSG_RCMStatusMessage_MAC.OCS_Status = getvalue ( EnvOCS_Status_);
//	MSG_RCMStatusMessage_MAC.PAD_Ind_Req = getvalue ( EnvPAD_Ind_Req_);
//	MSG_RCMStatusMessage_MAC.RILReq = getvalue ( EnvRILReq_);
//
//	/*  Output  */
//	
//	MSG_RCMStatusMessage_MAC.Dlc = getvalue ( EnvRCMStatusMessage_MACDlc_);
//	 
//	if(getvalue(EnvRCMStatusMessage_MACTo_))
//	{
//		output(MSG_RCMStatusMessage_MAC);
//	}
//	else
//	{
//		Write("RCMStatusMessage_MAC Message is not sent ");
//	}
//	 
//	settimer(T_MSG_RCMStatusMessage_MAC,  getvalue(EnvRCMStatusMessage_MACTime_));
//	 
//
//}
//on timer T_MSG_RCM_ISO_SCRAP_Tx 
//{
//	MSG_RCM_ISO_SCRAP_Tx.RCM_SCRAP_Diag_Sig_Tx = getvalue ( EnvRCM_SCRAP_Diag_Sig_Tx_);
//
//	/*  Output  */
//	
//	MSG_RCM_ISO_SCRAP_Tx.Dlc = getvalue ( EnvRCM_ISO_SCRAP_TxDlc_);
//	 
//	if(getvalue(EnvRCM_ISO_SCRAP_TxTo_))
//	{
//		output(MSG_RCM_ISO_SCRAP_Tx);
//	}
//	else
//	{
//		Write("RCM_ISO_SCRAP_Tx Message is not sent ");
//	}
//	 
//	settimer(T_MSG_RCM_ISO_SCRAP_Tx,  getvalue(EnvRCM_ISO_SCRAP_TxTime_));
//	 
//
//}
//on timer T_MSG_MACKVERI1 
//{
//	MSG_MACKVERI1.MACKVERI1_2 = getvalue ( EnvMACKVERI1_2_);
//	MSG_MACKVERI1.MACKVERI1_1 = getvalue ( EnvMACKVERI1_1_);
//
//	/*  Output  */
//	
//	MSG_MACKVERI1.Dlc = getvalue ( EnvMACKVERI1Dlc_);
//	 
//	if(getvalue(EnvMACKVERI1To_))
//	{
//		output(MSG_MACKVERI1);
//	}
//	else
//	{
//		Write("MACKVERI1 Message is not sent ");
//	}
//	 
//	settimer(T_MSG_MACKVERI1,  getvalue(EnvMACKVERI1Time_));
//	 
//
//}
//on timer T_MSG_YAW_Rate_Brake_Control 
//{
//	MSG_YAW_Rate_Brake_Control.YAW_Rate_Brake_Control_No_Cs = getvalue ( EnvYAW_Rate_Brake_Control_No_Cs_);
//	MSG_YAW_Rate_Brake_Control.YAW_Rate_Brake_Control_No_Cnt = getvalue ( EnvYAW_Rate_Brake_Control_No_Cnt_);
//	MSG_YAW_Rate_Brake_Control.Hdc_state = getvalue ( EnvHdc_state_);
//	MSG_YAW_Rate_Brake_Control.Drive_Mode_Towing_Req_DSC = getvalue ( EnvDrive_Mode_Towing_Req_DSC_);
//	MSG_YAW_Rate_Brake_Control.Drive_Mode_OffRoad_Req_DSC = getvalue ( EnvDrive_Mode_OffRoad_Req_DSC_);
//	MSG_YAW_Rate_Brake_Control.Drive_Mode_Normal_Req_DSC = getvalue ( EnvDrive_Mode_Normal_Req_DSC_);
//	MSG_YAW_Rate_Brake_Control.VacRelativePres_QF = getvalue ( EnvVacRelativePres_QF_);
//	MSG_YAW_Rate_Brake_Control.VacRelativePres = getvalue ( EnvVacRelativePres_);
//	MSG_YAW_Rate_Brake_Control.DYC_StatusFlag = getvalue ( EnvDYC_StatusFlag_);
//	MSG_YAW_Rate_Brake_Control.HlaCtl_D_Actl = getvalue ( EnvHlaCtl_D_Actl_);
//	MSG_YAW_Rate_Brake_Control.VehYawComp_W_Actl_1 = getvalue ( EnvVehYawComp_W_Actl_1_);
//
//	/*  Output  */
//	
//	MSG_YAW_Rate_Brake_Control.Dlc = getvalue ( EnvYAW_Rate_Brake_ControlDlc_);
//	 
//	if(getvalue(EnvYAW_Rate_Brake_ControlTo_))
//	{
//		output(MSG_YAW_Rate_Brake_Control);
//	}
//	else
//	{
//		Write("YAW_Rate_Brake_Control Message is not sent ");
//	}
//	 
//	settimer(T_MSG_YAW_Rate_Brake_Control,  getvalue(EnvYAW_Rate_Brake_ControlTime_));
//	 
//
//}
//on timer T_MSG_MACKSEND1 
//{
//	MSG_MACKSEND1.MACKSEND1_2 = getvalue ( EnvMACKSEND1_2_);
//	MSG_MACKSEND1.MACKSEND1_1 = getvalue ( EnvMACKSEND1_1_);
//
//	/*  Output  */
//	
//	MSG_MACKSEND1.Dlc = getvalue ( EnvMACKSEND1Dlc_);
//	 
//	if(getvalue(EnvMACKSEND1To_))
//	{
//		output(MSG_MACKSEND1);
//	}
//	else
//	{
//		Write("MACKSEND1 Message is not sent ");
//	}
//	 
//	settimer(T_MSG_MACKSEND1,  getvalue(EnvMACKSEND1Time_));
//	 
//
//}
on timer T_MSG_ADAS_HMI_Information1 
{
	MSG_ADAS_HMI_Information1.ID447_No_Cs = getvalue ( EnvID447_No_Cs_);
	MSG_ADAS_HMI_Information1.ID447_No_Cnt = getvalue ( EnvID447_No_Cnt_);
	MSG_ADAS_HMI_Information1.CTB_target_lh = getvalue ( EnvCTB_target_lh_);
	MSG_ADAS_HMI_Information1.CTB_target_rh = getvalue ( EnvCTB_target_rh_);
	MSG_ADAS_HMI_Information1.CTB_EV_failure = getvalue ( EnvCTB_EV_failure_);
	MSG_ADAS_HMI_Information1.CTB_EV_tmp_failure = getvalue ( EnvCTB_EV_tmp_failure_);
	MSG_ADAS_HMI_Information1.CTB_EV_fallback = getvalue ( EnvCTB_EV_fallback_);
	MSG_ADAS_HMI_Information1.CTB_EV_notification = getvalue ( EnvCTB_EV_notification_);
	MSG_ADAS_HMI_Information1.CTB_EV_warning = getvalue ( EnvCTB_EV_warning_);
	MSG_ADAS_HMI_Information1.CTB_EV_off = getvalue ( EnvCTB_EV_off_);
	MSG_ADAS_HMI_Information1.CTB_fallback = getvalue ( EnvCTB_fallback_);
	MSG_ADAS_HMI_Information1.CTB_state = getvalue ( EnvCTB_state_);
	MSG_ADAS_HMI_Information1.FCTA_target_lh = getvalue ( EnvFCTA_target_lh_);
	MSG_ADAS_HMI_Information1.FCTA_target_rh = getvalue ( EnvFCTA_target_rh_);
	MSG_ADAS_HMI_Information1.FCTA_EV_failure = getvalue ( EnvFCTA_EV_failure_);
	MSG_ADAS_HMI_Information1.FCTA_EV_tmp_failure = getvalue ( EnvFCTA_EV_tmp_failure_);
	MSG_ADAS_HMI_Information1.FCTA_EV_fallback = getvalue ( EnvFCTA_EV_fallback_);
	MSG_ADAS_HMI_Information1.FCTA_EV_warning2_rh = getvalue ( EnvFCTA_EV_warning2_rh_);
	MSG_ADAS_HMI_Information1.FCTA_EV_warning2_lh = getvalue ( EnvFCTA_EV_warning2_lh_);
	MSG_ADAS_HMI_Information1.FCTA_fallback = getvalue ( EnvFCTA_fallback_);
	MSG_ADAS_HMI_Information1.FCTA_state = getvalue ( EnvFCTA_state_);
	MSG_ADAS_HMI_Information1.PTC_EV_off = getvalue ( EnvPTC_EV_off_);
	MSG_ADAS_HMI_Information1.PTC_EV_notification = getvalue ( EnvPTC_EV_notification_);
	MSG_ADAS_HMI_Information1.PTC_fallback = getvalue ( EnvPTC_fallback_);
	MSG_ADAS_HMI_Information1.PTC_state = getvalue ( EnvPTC_state_);
//	MSG_ADAS_HMI_Information1.SBS_IND_state = getvalue ( EnvSBS_IND_state_);
	MSG_ADAS_HMI_Information1.AEB_EV_notification = getvalue ( EnvAEB_EV_notification_);
	MSG_ADAS_HMI_Information1.AEB_EV_off = getvalue ( EnvAEB_EV_off_);
	MSG_ADAS_HMI_Information1.AEB_fallback = getvalue ( EnvAEB_fallback_);
	MSG_ADAS_HMI_Information1.AEB_state = getvalue ( EnvAEB_state_);

	/*  Output  */
	
	MSG_ADAS_HMI_Information1.Dlc = getvalue ( EnvADAS_HMI_Information1Dlc_);
	 
	if(getvalue(EnvADAS_HMI_Information1To_))
	{
		output(MSG_ADAS_HMI_Information1);
	}
	else
	{
		// Write("ADAS_HMI_Information1 Message is not sent ");
	}
	 
	settimer(T_MSG_ADAS_HMI_Information1,  getvalue(EnvADAS_HMI_Information1Time_));
	 

}
on timer T_MSG_Cruise_Multi_Switch_1_MAC 
{
//	byte payloadLength = 4;
//	qword truncatedAuthenticator;
//	dword truncatedAuthenticatorBitLength = 28;
//	qword freshness;
//	dword truncatedFreshnessBitLength = 4;
//	dword freshnessValueBitLength = 48;
//	long result;
	MSG_Cruise_Multi_Switch_1_MAC.Cruise_Multi_Switch_1_MACTx = getvalue ( EnvCruise_Multi_Switch_1_MACTx_);
	MSG_Cruise_Multi_Switch_1_MAC.Cruise_Multi_Switch_1_FVTx = getvalue ( EnvCruise_Multi_Switch_1_FVTx_);
//	MSG_Cruise_Multi_Switch_1_MAC.Cruise_Multi_Switch_1_MACTx = 0;
//	MSG_Cruise_Multi_Switch_1_MAC.Cruise_Multi_Switch_1_FVTx = 0;
	MSG_Cruise_Multi_Switch_1_MAC.HECSwtchB_1_Cs = getvalue ( EnvHECSwtchB_1_Cs_);
	MSG_Cruise_Multi_Switch_1_MAC.HECSwtchB_1_Cnt = getvalue ( EnvHECSwtchB_1_Cnt_);
	MSG_Cruise_Multi_Switch_1_MAC.DHS_RIL_STAT = getvalue ( EnvDHS_RIL_STAT_);
	MSG_Cruise_Multi_Switch_1_MAC.RIL_STAT = getvalue ( EnvRIL_STAT_);
	MSG_Cruise_Multi_Switch_1_MAC.MntSet_Oil_HEC_Req = getvalue ( EnvMntSet_Oil_HEC_Req_);
	MSG_Cruise_Multi_Switch_1_MAC.TJA_Swtch_B_Actl = getvalue ( EnvTJA_Swtch_B_Actl_);
	MSG_Cruise_Multi_Switch_1_MAC.LIM_Swtch_B_Actl = getvalue ( EnvLIM_Swtch_B_Actl_);
	MSG_Cruise_Multi_Switch_1_MAC.MRCC_Swtch_B_Actl = getvalue ( EnvMRCC_Swtch_B_Actl_);
	MSG_Cruise_Multi_Switch_1_MAC.ASC_Swtch_B_Actl = getvalue ( EnvASC_Swtch_B_Actl_);
	MSG_Cruise_Multi_Switch_1_MAC.DistanceMinus_B_Actl = getvalue ( EnvDistanceMinus_B_Actl_);
	MSG_Cruise_Multi_Switch_1_MAC.DistancePlus_B_Actl = getvalue ( EnvDistancePlus_B_Actl_);
	MSG_Cruise_Multi_Switch_1_MAC.OffSwtch_B_Actl = getvalue ( EnvOffSwtch_B_Actl_);
	MSG_Cruise_Multi_Switch_1_MAC.ResumeSwtch_B_Actl = getvalue ( EnvResumeSwtch_B_Actl_);
	MSG_Cruise_Multi_Switch_1_MAC.SetMinusSwtch_B_Actl = getvalue ( EnvSetMinusSwtch_B_Actl_);
	MSG_Cruise_Multi_Switch_1_MAC.SetPlusSwtch_B_Actl = getvalue ( EnvSetPlusSwtch_B_Actl_);
	MSG_Cruise_Multi_Switch_1_MAC.CancelSwtch_B_Actl = getvalue ( EnvCancelSwtch_B_Actl_);
	MSG_Cruise_Multi_Switch_1_MAC.CruiseSwtch_Qf = getvalue ( EnvCruiseSwtch_Qf_);
  
  
  @EnvHECSwtchB_1_Cnt_ += 1;
  if (@EnvHECSwtchB_1_Cnt_ > 15)
  {
    @EnvHECSwtchB_1_Cnt_ = 0;
  }
  MSG_Cruise_Multi_Switch_1_MAC.HECSwtchB_1_Cnt = getvalue ( EnvHECSwtchB_1_Cnt_);
 if(@Env_HECSwtchB_1_Cnt_Error ==1){MSG_Cruise_Multi_Switch_1_MAC.HECSwtchB_1_Cnt = 0;}
  @EnvHECSwtchB_1_Cs_ = 0;
  @EnvHECSwtchB_1_Cs_ += MSG_Cruise_Multi_Switch_1_MAC.byte(0);
  @EnvHECSwtchB_1_Cs_ += MSG_Cruise_Multi_Switch_1_MAC.byte(1);
  @EnvHECSwtchB_1_Cs_ += MSG_Cruise_Multi_Switch_1_MAC.byte(2);
  @EnvHECSwtchB_1_Cs_ += MSG_Cruise_Multi_Switch_1_MAC.dlc;
  @EnvHECSwtchB_1_Cs_ += MSG_Cruise_Multi_Switch_1_MAC.id;
  
  MSG_Cruise_Multi_Switch_1_MAC.HECSwtchB_1_Cs = getvalue ( EnvHECSwtchB_1_Cs_);
  if(@Env_HECSwtchB_1_Cs_Error == 1){MSG_Cruise_Multi_Switch_1_MAC.HECSwtchB_1_Cs = 0;}
	/*  Output  */
	
	MSG_Cruise_Multi_Switch_1_MAC.Dlc = getvalue ( EnvCruise_Multi_Switch_1_MACDlc_);
	 
	if(getvalue(EnvCruise_Multi_Switch_1_MACTo_))
	{
//    if((tripCnt_CruiseMultiSwitch1 != g_TripCnt) | (resetCnt_CruiseMultiSwitch1 != g_ResetCnt)) {
//      tripCnt_CruiseMultiSwitch1 = g_TripCnt;
//      resetCnt_CruiseMultiSwitch1 = g_ResetCnt;
//      if(resetCnt_CruiseMultiSwitch1 < 0xFFFFF) {
//        msgCnt_CruiseMultiSwitch1 = 1;
//      }
//      else {
//        msgCnt_CruiseMultiSwitch1 = 0xFF;
//      }
//    }
//    else{
//      if(msgCnt_CruiseMultiSwitch1 < 0xFF) {
//        msgCnt_CruiseMultiSwitch1 += 1;
//      }
//      else {
//        msgCnt_CruiseMultiSwitch1 = 0xFF;
//      }
//    }
//    resetFlag_CruiseMultiSwitch1 = resetCnt_CruiseMultiSwitch1 & 0x03;
//    freshness = ((tripCnt_CruiseMultiSwitch1 << 32) | (resetCnt_CruiseMultiSwitch1 << 12)
//    | (msgCnt_CruiseMultiSwitch1 << 4) | (resetFlag_CruiseMultiSwitch1 << 2));
//    payload_CruiseMultiSwitch1[0] =  MSG_Cruise_Multi_Switch_1_MAC.byte(0);
//    payload_CruiseMultiSwitch1[1] =  MSG_Cruise_Multi_Switch_1_MAC.byte(1);
//    payload_CruiseMultiSwitch1[2] =  MSG_Cruise_Multi_Switch_1_MAC.byte(2);
//    payload_CruiseMultiSwitch1[3] =  MSG_Cruise_Multi_Switch_1_MAC.byte(3);
//  	result = LocalSecurityCalculateAuthenticator(MSG_Cruise_Multi_Switch_1_MAC.id, payload_CruiseMultiSwitch1, payloadLength, truncatedAuthenticator, truncatedAuthenticatorBitLength, freshness, truncatedFreshnessBitLength, freshnessValueBitLength);
//    
//    putValue(EnvCruise_Multi_Switch_1_FVTx_, freshness);
//    putValue(EnvCruise_Multi_Switch_1_MACTx_, truncatedAuthenticator);
//    MSG_Cruise_Multi_Switch_1_MAC.Cruise_Multi_Switch_1_MACTx = getvalue ( EnvCruise_Multi_Switch_1_MACTx_);
//  	MSG_Cruise_Multi_Switch_1_MAC.Cruise_Multi_Switch_1_FVTx = getvalue ( EnvCruise_Multi_Switch_1_FVTx_);
//    
//    if(@EnvFCruise_Multi_Switch_1_MAC){
//      MSG_Cruise_Multi_Switch_1_MAC.Cruise_Multi_Switch_1_MACTx = getvalue ( EnvCruise_Multi_Switch_1_MACTx_) / 2;
//    }
    
		output(MSG_Cruise_Multi_Switch_1_MAC);
	}
	else
	{
		//Write("Cruise_Multi_Switch_1_MAC Message is not sent ");
	}
	 
	settimer(T_MSG_Cruise_Multi_Switch_1_MAC,  100);
	 

}
on timer T_MSG_BCM_Information1_MAC 
{
//	byte payloadLength = 4;
//  qword truncatedAuthenticator;
//  dword truncatedAuthenticatorBitLength = 28;
//  qword freshness;
//  dword truncatedFreshnessBitLength = 4;
//  dword freshnessValueBitLength = 48;
//  long result;
	MSG_BCM_Information1_MAC.BCM_Information1_MACTx = getvalue ( EnvBCM_Information1_MACTx_);
	MSG_BCM_Information1_MAC.BCM_Information1_FVTx = getvalue ( EnvBCM_Information1_FVTx_);
//	MSG_BCM_Information1_MAC.BCM_Information1_MACTx = 0;
//	MSG_BCM_Information1_MAC.BCM_Information1_FVTx = 0;
	MSG_BCM_Information1_MAC.BCMINFO1_MAC_No_Cs = getvalue ( EnvBCMINFO1_MAC_No_Cs_);
	MSG_BCM_Information1_MAC.BCMINFO1_MAC_No_Cnt = getvalue ( EnvBCMINFO1_MAC_No_Cnt_);
	MSG_BCM_Information1_MAC.PADI_Stat = getvalue ( EnvPADI_Stat_);
  @EnvBCMINFO1_MAC_No_Cnt_ = @EnvBCMINFO1_MAC_No_Cnt_ + 1;
  if (@EnvBCMINFO1_MAC_No_Cnt_ > 15)
  {
    @EnvBCMINFO1_MAC_No_Cnt_ = 0;
  }
  MSG_BCM_Information1_MAC.BCMINFO1_MAC_No_Cnt = getvalue ( EnvBCMINFO1_MAC_No_Cnt_);
  if(@Env_BCMInfor1_MAC_Cnt_Error==1){MSG_BCM_Information1_MAC.BCMINFO1_MAC_No_Cnt = 0;}
  
  @EnvBCMINFO1_MAC_No_Cs_ = 0;
  @EnvBCMINFO1_MAC_No_Cs_ += MSG_BCM_Information1_MAC.byte(0);
  @EnvBCMINFO1_MAC_No_Cs_ += MSG_BCM_Information1_MAC.byte(2);
  @EnvBCMINFO1_MAC_No_Cs_ += MSG_BCM_Information1_MAC.byte(3);
  @EnvBCMINFO1_MAC_No_Cs_ += MSG_BCM_Information1_MAC.dlc;
  @EnvBCMINFO1_MAC_No_Cs_ += MSG_BCM_Information1_MAC.id;
  
  MSG_BCM_Information1_MAC.BCMINFO1_MAC_No_Cs = getvalue ( EnvBCMINFO1_MAC_No_Cs_);
  if(@Env_BCMInfor1_MAC_Cs_Error==1){MSG_BCM_Information1_MAC.BCMINFO1_MAC_No_Cs = 0;}

	/*  Output  */
	
	MSG_BCM_Information1_MAC.Dlc = getvalue ( EnvBCM_Information1_MACDlc_);
	 
	if(getvalue(EnvBCM_Information1_MACTo_))
	{
//    if((tripCnt_BCMInformation1 != g_TripCnt) | (resetCnt_BCMInformation1 != g_ResetCnt)) {
//      tripCnt_BCMInformation1 = g_TripCnt;
//      resetCnt_BCMInformation1 = g_ResetCnt;
//      if(resetCnt_BCMInformation1 < 0xFFFFF) {
//        msgCnt_BCMInformation1 = 1;
//      }
//      else {
//        msgCnt_BCMInformation1 = 0xFF;
//      }
//    }
//    else{
//      if(msgCnt_BCMInformation1 < 0xFF) {
//        msgCnt_BCMInformation1 += 1;
//      }
//      else {
//        msgCnt_BCMInformation1 = 0xFF;
//      }
//    }
//    resetFlag_BCMInformation1 = resetCnt_BCMInformation1 & 0x03;
//    freshness = ((tripCnt_BCMInformation1 << 32) | (resetCnt_BCMInformation1 << 12)
//    | (msgCnt_BCMInformation1 << 4) | (resetFlag_BCMInformation1 << 2));
//    payload_BCMInformation1[0] =  MSG_BCM_Information1_MAC.byte(0);
//    payload_BCMInformation1[1] =  MSG_BCM_Information1_MAC.byte(1);
//    payload_BCMInformation1[2] =  MSG_BCM_Information1_MAC.byte(2);
//    payload_BCMInformation1[3] =  MSG_BCM_Information1_MAC.byte(3);
//  	result = LocalSecurityCalculateAuthenticator(MSG_BCM_Information1_MAC.id, payload_BCMInformation1, payloadLength, truncatedAuthenticator, truncatedAuthenticatorBitLength, freshness, truncatedFreshnessBitLength, freshnessValueBitLength);
//    
//    putValue(EnvBCM_Information1_FVTx_, freshness);
//    putValue(EnvBCM_Information1_MACTx_, truncatedAuthenticator);
//    MSG_BCM_Information1_MAC.BCM_Information1_MACTx = getvalue ( EnvBCM_Information1_MACTx_);
//  	MSG_BCM_Information1_MAC.BCM_Information1_FVTx = getvalue ( EnvBCM_Information1_FVTx_);
//    
//    if(@EnvFBCM_Information1_MAC){
//      MSG_BCM_Information1_MAC.BCM_Information1_MACTx = getvalue ( EnvBCM_Information1_MACTx_) / 2;
//    }
		output(MSG_BCM_Information1_MAC);
	}
	else
	{
		//Write("BCM_Information1_MAC Message is not sent ");
	}
	 
	settimer(T_MSG_BCM_Information1_MAC,  100);
	 

}
//on timer T_MSG_EPAS_CCP_Tx 
//{
//	MSG_EPAS_CCP_Tx.CCPMessageDataEPAS7_Tx = getvalue ( EnvCCPMessageDataEPAS7_Tx_);
//	MSG_EPAS_CCP_Tx.CCPMessageDataEPAS6_Tx = getvalue ( EnvCCPMessageDataEPAS6_Tx_);
//	MSG_EPAS_CCP_Tx.CCPMessageDataEPAS5_Tx = getvalue ( EnvCCPMessageDataEPAS5_Tx_);
//	MSG_EPAS_CCP_Tx.CCPMessageDataEPAS4_Tx = getvalue ( EnvCCPMessageDataEPAS4_Tx_);
//	MSG_EPAS_CCP_Tx.CCPMessageDataEPAS3_Tx = getvalue ( EnvCCPMessageDataEPAS3_Tx_);
//	MSG_EPAS_CCP_Tx.CCPMessageDataEPAS2_Tx = getvalue ( EnvCCPMessageDataEPAS2_Tx_);
//	MSG_EPAS_CCP_Tx.CCPMessageDataEPAS1_Tx = getvalue ( EnvCCPMessageDataEPAS1_Tx_);
//	MSG_EPAS_CCP_Tx.CCPMessageDataEPAS_Tx = getvalue ( EnvCCPMessageDataEPAS_Tx_);
//
//	/*  Output  */
//	
//	MSG_EPAS_CCP_Tx.Dlc = getvalue ( EnvEPAS_CCP_TxDlc_);
//	 
//	if(getvalue(EnvEPAS_CCP_TxTo_))
//	{
//		output(MSG_EPAS_CCP_Tx);
//	}
//	else
//	{
//		Write("EPAS_CCP_Tx Message is not sent ");
//	}
//	 
//	settimer(T_MSG_EPAS_CCP_Tx,  getvalue(EnvEPAS_CCP_TxTime_));
//	 
//
//}
//on timer T_MSG_MACKSEND7 
//{
//	MSG_MACKSEND7.MACKSEND7_2 = getvalue ( EnvMACKSEND7_2_);
//	MSG_MACKSEND7.MACKSEND7_1 = getvalue ( EnvMACKSEND7_1_);
//
//	/*  Output  */
//	
//	MSG_MACKSEND7.Dlc = getvalue ( EnvMACKSEND7Dlc_);
//	 
//	if(getvalue(EnvMACKSEND7To_))
//	{
//		output(MSG_MACKSEND7);
//	}
//	else
//	{
//		Write("MACKSEND7 Message is not sent ");
//	}
//	 
//	settimer(T_MSG_MACKSEND7,  getvalue(EnvMACKSEND7Time_));
//	 
//
//}
//on timer T_MSG_Push_Start_Status 
//{
//	MSG_Push_Start_Status.PowerCon_No_Cs = getvalue ( EnvPowerCon_No_Cs_);
//	MSG_Push_Start_Status.Clutch_Cut_Switch_Status = getvalue ( EnvClutch_Cut_Switch_Status_);
//	MSG_Push_Start_Status.SKE_IR_Request = getvalue ( EnvSKE_IR_Request_);
//	MSG_Push_Start_Status.SKE_SISS_Status = getvalue ( EnvSKE_SISS_Status_);
//	MSG_Push_Start_Status.SKE_SISS_Mode = getvalue ( EnvSKE_SISS_Mode_);
//	MSG_Push_Start_Status.CrankStat_B_Actl = getvalue ( EnvCrankStat_B_Actl_);
//	MSG_Push_Start_Status.AutoP_Request = getvalue ( EnvAutoP_Request_);
//	MSG_Push_Start_Status.IG_OFF_Delay_State = getvalue ( EnvIG_OFF_Delay_State_);
//	MSG_Push_Start_Status.IG_mode = getvalue ( EnvIG_mode_);
//	MSG_Push_Start_Status.PowerControlStatus = getvalue ( EnvPowerControlStatus_);
//
//	/*  Output  */
//	
//	MSG_Push_Start_Status.Dlc = getvalue ( EnvPush_Start_StatusDlc_);
//	 
//	if(getvalue(EnvPush_Start_StatusTo_))
//	{
//		output(MSG_Push_Start_Status);
//	}
//	else
//	{
//		Write("Push_Start_Status Message is not sent ");
//	}
//	 
//	settimer(T_MSG_Push_Start_Status,  getvalue(EnvPush_Start_StatusTime_));
//	 
//
//}
on timer T_MSG_CGW_Sync 
{
  /* message ID for CGW_Sync */
  dword dataID = 0x20;
  /* Data buffer (Input of CMAC generate) and data length ( NULL Cause to CGW_Sync do not need this ) */
  byte payload[1];          
  qword PayloadLength = 0;
  /* Authenticator generate by CMAC */
  qword authenticator;
  dword authenticatorBitLength = 28;
  /* Freshness Input (data + length) (TripCounter and ResetCounter) */
  qword freshness;
  dword freshnessLength = 40;
  /* Freshness length of Output (Don't need for this message) */
  dword freshnessTxBitLength = 36;
  /* Other variables */
  dword result;
  qword local_TripCounter;
  qword local_ResetCounter;
  
//	MSG_CGW_Sync.CGW_Sync_MACTx = getvalue ( EnvCGW_Sync_MACTx_);
//	MSG_CGW_Sync.CGW_Sync_ResetCnt = getvalue ( EnvCGW_Sync_ResetCnt_);
//	MSG_CGW_Sync.CGW_Sync_TripCnt = getvalue ( EnvCGW_Sync_TripCnt_);

	/*  Output  */
	
	MSG_CGW_Sync.Dlc = getvalue ( EnvCGW_SyncDlc_);
	 
	if(getvalue(EnvCGW_SyncTo_))
	{
    IncreaseSyncFV();
    local_TripCounter = getvalue(EnvCGW_Sync_TripCnt_);
    local_ResetCounter = getvalue(EnvCGW_Sync_ResetCnt_);
    
    freshness = (local_TripCounter << 24) | ((local_ResetCounter & 0xFFFFF)<<4); // 20+16 + 4(padding)
    result = LocalSecurityCalculateAuthenticator(dataID, payload, PayloadLength, authenticator, authenticatorBitLength, freshness, freshnessTxBitLength, freshnessLength);
    putValue(EnvCGW_Sync_MACTx_, authenticator);
    
    
  	MSG_CGW_Sync.CGW_Sync_MACTx = getvalue ( EnvCGW_Sync_MACTx_);
  	MSG_CGW_Sync.CGW_Sync_ResetCnt = getvalue ( EnvCGW_Sync_ResetCnt_);
  	MSG_CGW_Sync.CGW_Sync_TripCnt = getvalue ( EnvCGW_Sync_TripCnt_);
    if(@EnvFCGW_Sync){
      MSG_CGW_Sync.CGW_Sync_MACTx = getvalue ( EnvCGW_Sync_MACTx_)/2;
    }
		output(MSG_CGW_Sync);
    //g_TripCnt = getvalue ( EnvCGW_Sync_TripCnt_);
    //g_ResetCnt = getvalue ( EnvCGW_Sync_ResetCnt_);
}
	else
	{
		// Write("CGW_Sync Message is not sent ");
	}
	 
	settimer(T_MSG_CGW_Sync,  getvalue(EnvCGW_SyncTime_));
	 

}
on message CGW_Sync
{
  /* message ID for CGW_Sync */
  dword dataID = 0x20;
  /* Data buffer (Input of CMAC generate) and data length ( NULL Cause to CGW_Sync do not need this ) */
  byte payload[1];          
  dword payloadLength = 0;
  dword truncatedAuthenticatorLength = 28;
  /* Authenticator generate by CMAC */
  qword authenticator;
  dword authenticatorBitLength = 28;
  /* Freshness Input (data + length) (TripCounter and ResetCounter) */
  qword retainSyncFV;
  qword receivedSyncFV;
  qword construcSyncFV;
  dword freshnessLength = 40;
  /* Freshness length of Output (Don't need for this message) */
  dword RxFreshnessBitLength = 36;
  /* Other variables */
  dword result;
  dword validationResult;
  qword retain_TripCounter;
  qword retain_ResetCounter;
  qword new_TripCounter;
  qword new_ResetCounter;
  
  retain_TripCounter  = g_TripCnt;
  retain_ResetCounter = g_ResetCnt;
  new_TripCounter = (qword)this.CGW_Sync_TripCnt;
  new_ResetCounter = (qword)this.CGW_Sync_ResetCnt;
  
  receivedSyncFV = (new_TripCounter   << 20) | (new_ResetCounter   & 0x000FFFFF);
  retainSyncFV   = (retain_TripCounter << 20) | (retain_ResetCounter & 0x000FFFFF);
  
  if (receivedSyncFV > retainSyncFV)
  {
    construcSyncFV = (receivedSyncFV << 4);
    result = LocalSecurityVerifyAuthenticationInformation(dataID, payload, payloadLength, this.CGW_Sync_MACTx, truncatedAuthenticatorLength,
                                                            receivedSyncFV, RxFreshnessBitLength, construcSyncFV, freshnessLength, validationResult);
    if (1 == validationResult) 
    {
      g_TripCnt = this.CGW_Sync_TripCnt;
      g_ResetCnt = this.CGW_Sync_ResetCnt;
      //write("Success (FV Increase): TripCnt %llu, ResetCnt %llu", g_TripCnt, g_ResetCnt);
    }
    else {
      write("Fail MAC (FV Increase): TripCnt %llu, ResetCnt %llu", g_TripCnt, g_ResetCnt);
    }
  }
  else
  {
    if ( ((tripCntInitValue + clearAcceptanceWindow) >= this.CGW_Sync_TripCnt) &&
          ((tripCntMaxValue - clearAcceptanceWindow) <= retain_TripCounter) )
    {
      construcSyncFV = (receivedSyncFV << 4);
      result = LocalSecurityVerifyAuthenticationInformation(dataID, payload, payloadLength, this.CGW_Sync_MACTx, truncatedAuthenticatorLength,
                                                            receivedSyncFV, RxFreshnessBitLength, construcSyncFV, freshnessLength, validationResult);
      if (1 == validationResult) 
      {
        g_TripCnt = this.CGW_Sync_TripCnt;
        g_ResetCnt = this.CGW_Sync_ResetCnt;
        write("Success (TRIP MAX): TripCnt %llu, ResetCnt %llu", g_TripCnt, g_ResetCnt);
      }
      else {
        write("Fail MAC (TRIP MAX): TripCnt %llu, ResetCnt %llu", g_TripCnt, g_ResetCnt);
      }
    }
    else {
      write("Fail (TRIP MAX): Receive %llu, Retain %llu (New trip %llu, new reset %llu)", receivedSyncFV, retainSyncFV, new_TripCounter, new_ResetCounter);
    }
  }
}
on message RCM_Yaw_Rate_MAC
{
  byte payloadLength = 4;
  qword truncatedAuthenticator;
  dword truncatedAuthenticatorBitLength = 28;
  qword freshness;
  qword freshness_noupdate;
  dword truncatedFreshnessBitLength = 4;
  dword freshnessValueBitLength = 48;
  long result;
  dword validationResult;
  dword validationResult_noupdate;
  qword oldMsgCnt;
  qword noUpdateMsgCnt;
  
  noUpdateMsgCnt = msgCnt_YawRate;
  if(noUpdateMsgCnt < 0xFF) {
    noUpdateMsgCnt += 1;
  }
  else {
    noUpdateMsgCnt = 0xFF;
  }
  resetFlag_YawRate = noUpdateMsgCnt & 0x03;
  freshness_noupdate = ((tripCnt_YawRate << 32) | (resetCnt_YawRate << 12)
  | (noUpdateMsgCnt << 4) | (resetFlag_YawRate << 2));
  
  
  oldMsgCnt = msgCnt_YawRate;
  if((tripCnt_YawRate != g_TripCnt) || (resetCnt_YawRate != g_ResetCnt)) {
    tripCnt_YawRate = g_TripCnt;
    resetCnt_YawRate = g_ResetCnt;
    if(resetCnt_YawRate < 0x000FFFFF) {
      msgCnt_YawRate = 1;
    }
    else {
      msgCnt_YawRate = 0xFF;
    }
  }
  else{
    if(msgCnt_YawRate < 0xFF) {
      msgCnt_YawRate += 1;
    }
    else {
      msgCnt_YawRate = 0xFF;
    }
  }
  
  resetFlag_YawRate = resetCnt_YawRate & 0x03;
  freshness = ((tripCnt_YawRate << 32) | (resetCnt_YawRate << 12)
  | (msgCnt_YawRate << 4) | (resetFlag_YawRate << 2));
  payload_YawRate[0] =  this.byte(0);
  payload_YawRate[1] =  this.byte(1);
  payload_YawRate[2] =  this.byte(2);
  payload_YawRate[3] =  this.byte(3);
  
  if (@EnvVerify_RCM_Yaw_Rate_MAC == 1)
  {
    result = LocalSecurityVerifyAuthenticationInformation(this.id, payload_YawRate, payloadLength, this.RCM_Yaw_Rate_MACTx, truncatedAuthenticatorBitLength, this.RCM_Yaw_Rate_FVTx, truncatedFreshnessBitLength, freshness_noupdate, freshnessValueBitLength, validationResult_noupdate);
    result = LocalSecurityVerifyAuthenticationInformation(this.id, payload_YawRate, payloadLength, this.RCM_Yaw_Rate_MACTx, truncatedAuthenticatorBitLength, this.RCM_Yaw_Rate_FVTx, truncatedFreshnessBitLength, freshness, freshnessValueBitLength, validationResult);
    @EnvMsg_RCM_Yaw_Rate_MAC += 1;
    if ((1 != validationResult) && (1 != validationResult_noupdate)) {
      @EnvError_RCM_Yaw_Rate_MAC += 1;
      write("FAIL Tx (%d): Msg counter %llu, Msg counter no update %llu",@EnvError_RCM_Yaw_Rate_MAC, msgCnt_YawRate, noUpdateMsgCnt);
      msgCnt_YawRate = oldMsgCnt;
    }
  }
}
on envVar Env_CAN_ACK_Off 
{
	long channel =1;
  long silent =0;
  canSetChannelOutput(channel,silent);
  Write("silent set to %d",silent);
}
on envVar Env_CAN_ACK_On
{
	long channel =1;
  long silent =1;
  canSetChannelOutput(channel,silent);
  Write("silent set to %d",silent);
}
on envVar EnvT_MSG_ENG1S60 
{
  if (@this == 1) {
  	MSG_ENG1S60.CDTHVANS = 1;
  	/*  Output  */
  	MSG_ENG1S60.Dlc = getvalue ( EnvENG1S60Dlc_);
  	output(MSG_ENG1S60);
  }
}
on envVar EnvT_MSG_ENG1S60_Trans0
{
  if (@this == 1) {
  	MSG_ENG1S60.CDTHVANS = 0;
  	/*  Output  */
  	MSG_ENG1S60.Dlc = getvalue ( EnvENG1S60Dlc_);
  	output(MSG_ENG1S60);
  }
}
on envVar EnvVerify_RCM_Yaw_Rate_MAC
{
  if (@this == 1) {
    @EnvMsg_RCM_Yaw_Rate_MAC = 0;
    @EnvError_RCM_Yaw_Rate_MAC = 0;
  }
}
on message RCM_Late_Acc_MAC
{
  byte payloadLength = 4;
  qword truncatedAuthenticator;
  dword truncatedAuthenticatorBitLength = 28;
  qword freshness;
  dword truncatedFreshnessBitLength = 4;
  dword freshnessValueBitLength = 48;
  long result;
  dword validationResult;
  qword oldMsgCnt;
  
  oldMsgCnt = msgCnt_LateAcc;
  if((tripCnt_LateAcc != g_TripCnt) || (resetCnt_LateAcc != g_ResetCnt)) {
    tripCnt_LateAcc = g_TripCnt;
    resetCnt_LateAcc = g_ResetCnt;
    if(resetCnt_LateAcc < 0x000FFFFF) {
      msgCnt_LateAcc = 1;
    }
    else {
      msgCnt_LateAcc = 0xFF;
    }
  }
  else{
    if(msgCnt_LateAcc < 0xFF) {
      msgCnt_LateAcc += 1;
    }
    else {
      msgCnt_LateAcc = 0xFF;
    }
  }
  
  resetFlag_LateAcc = resetCnt_LateAcc & 0x03;
  freshness = ((tripCnt_LateAcc << 32) | (resetCnt_LateAcc << 12)
  | (msgCnt_LateAcc << 4) | (resetFlag_LateAcc << 2));
  payload_LateAcc[0] =  this.byte(0);
  payload_LateAcc[1] =  this.byte(1);
  payload_LateAcc[2] =  this.byte(2);
  payload_LateAcc[3] =  this.byte(3);
  result = LocalSecurityVerifyAuthenticationInformation(this.id, payload_LateAcc, payloadLength, this.RCM_Late_Acc_MACTx, truncatedAuthenticatorBitLength, this.RCM_Late_Acc_FVTx, truncatedFreshnessBitLength, freshness, freshnessValueBitLength, validationResult);
  if (@EnvVerify_RCM_Late_Acc_MAC == 1)
  {
    @EnvMsg_RCM_Late_Acc_MAC += 1;
    if (1 != validationResult) {
      @EnvError_RCM_Late_Acc_MAC += 1;
      msgCnt_LateAcc = oldMsgCnt;
      Write("Verify FAIL %d, tripCnt %d, resetCnt %d, msgCnt %d",@EnvError_RCM_Late_Acc_MAC, tripCnt_LateAcc, resetCnt_LateAcc, msgCnt_LateAcc);
      Write("Verify FAIL %d, GlobalTrip %d, GlobalReset %d", @EnvError_RCM_Late_Acc_MAC, g_TripCnt, g_ResetCnt);
    }
  }
}
on envVar EnvVerify_RCM_Late_Acc_MAC
{
  if (@this == 1) {
    @EnvMsg_RCM_Late_Acc_MAC = 0;
    @EnvError_RCM_Late_Acc_MAC = 0;
  }
}
on message RCM_Long_Acc_MAC
{
  byte payloadLength = 4;
  qword truncatedAuthenticator;
  dword truncatedAuthenticatorBitLength = 28;
  qword freshness;
  dword truncatedFreshnessBitLength = 4;
  dword freshnessValueBitLength = 48;
  long result;
  dword validationResult;
  qword oldMsgCnt;
  
  oldMsgCnt = msgCnt_LongAcc;
  if((tripCnt_LongAcc != g_TripCnt) || (resetCnt_LongAcc != g_ResetCnt)) {
    tripCnt_LongAcc = g_TripCnt;
    resetCnt_LongAcc = g_ResetCnt;
    if(resetCnt_LongAcc < 0x000FFFFF) {
      msgCnt_LongAcc = 1;
    }
    else {
      msgCnt_LongAcc = 0xFF;
    }
  }
  else{
    if(msgCnt_LongAcc < 0xFF) {
      msgCnt_LongAcc += 1;
    }
    else {
      msgCnt_LongAcc = 0xFF;
    }
  }
  
  resetFlag_LongAcc = resetCnt_LongAcc & 0x03;
  freshness = ((tripCnt_LongAcc << 32) | (resetCnt_LongAcc << 12)
  | (msgCnt_LongAcc << 4) | (resetFlag_LongAcc << 2));
  payload_LongAcc[0] =  this.byte(0);
  payload_LongAcc[1] =  this.byte(1);
  payload_LongAcc[2] =  this.byte(2);
  payload_LongAcc[3] =  this.byte(3);
  result = LocalSecurityVerifyAuthenticationInformation(this.id, payload_LongAcc, payloadLength, this.RCM_Long_Acc_MACTx, truncatedAuthenticatorBitLength, this.RCM_Long_Acc_FVTx, truncatedFreshnessBitLength, freshness, freshnessValueBitLength, validationResult);
  if (@EnvVerify_RCM_Long_Acc_MAC == 1)
  {
    @EnvMsg_RCM_Long_Acc_MAC += 1;
    if (1 != validationResult) {
      @EnvError_RCM_Long_Acc_MAC += 1;
      msgCnt_LongAcc = oldMsgCnt;
      Write("Verify FAIL %d, tripCnt %d, resetCnt %d, msgCnt %d",@EnvError_RCM_Long_Acc_MAC, tripCnt_LongAcc, resetCnt_LongAcc, msgCnt_LongAcc);
      Write("Verify FAIL %d, GlobalTrip %d, GlobalReset %d", @EnvError_RCM_Long_Acc_MAC, g_TripCnt, g_ResetCnt);
    }
  }
}
on envVar EnvVerify_RCM_Long_Acc_MAC
{
  if (@this == 1) {
    @EnvMsg_RCM_Long_Acc_MAC = 0;
    @EnvError_RCM_Long_Acc_MAC = 0;
  }
}
on message RCMStatusMessage_MAC
{
  byte payloadLength = 4;
  qword truncatedAuthenticator;
  dword truncatedAuthenticatorBitLength = 28;
  qword freshness;
  dword truncatedFreshnessBitLength = 4;
  dword freshnessValueBitLength = 48;
  long result;
  dword validationResult;
  qword oldMsgCnt;
  
  oldMsgCnt = msgCnt_RCMStatusMessage1;
  if((tripCnt_RCMStatusMessage1 != g_TripCnt) || (resetCnt_RCMStatusMessage1 != g_ResetCnt)) {
    tripCnt_RCMStatusMessage1 = g_TripCnt;
    resetCnt_RCMStatusMessage1 = g_ResetCnt;
    if(resetCnt_RCMStatusMessage1 < 0x000FFFFF) {
      msgCnt_RCMStatusMessage1 = 1;
    }
    else {
      msgCnt_RCMStatusMessage1 = 0xFF;
    }
  }
  else{
    if(msgCnt_RCMStatusMessage1 < 0xFF) {
      msgCnt_RCMStatusMessage1 += 1;
    }
    else {
      msgCnt_RCMStatusMessage1 = 0xFF;
    }
  }
  
  resetFlag_RCMStatusMessage1 = resetCnt_RCMStatusMessage1 & 0x03;
  freshness = ((tripCnt_RCMStatusMessage1 << 32) | (resetCnt_RCMStatusMessage1 << 12)
  | (msgCnt_RCMStatusMessage1 << 4) | (resetFlag_RCMStatusMessage1 << 2));
  payload_RCMStatusMessage1[0] =  this.byte(0);
  payload_RCMStatusMessage1[1] =  this.byte(1);
  payload_RCMStatusMessage1[2] =  this.byte(2);
  payload_RCMStatusMessage1[3] =  this.byte(3);
  result = LocalSecurityVerifyAuthenticationInformation(this.id, payload_RCMStatusMessage1, payloadLength, this.RCMStatusMessage_MACTx, truncatedAuthenticatorBitLength, this.RCMStatusMessage_FVTx, truncatedFreshnessBitLength, freshness, freshnessValueBitLength, validationResult);
  if (@EnvVerify_RCMStatusMessage_MAC == 1)
  {
    @EnvMsg_RCMStatusMessage_MAC += 1;
    if (1 != validationResult) {
      @EnvError_RCMStatusMessage_MAC += 1;
      msgCnt_RCMStatusMessage1 = oldMsgCnt;
      Write("Verify FAIL %d, tripCnt %d, resetCnt %d, msgCnt %d",@EnvError_RCMStatusMessage_MAC, tripCnt_RCMStatusMessage1, resetCnt_RCMStatusMessage1, msgCnt_RCMStatusMessage1);
      Write("Verify FAIL %d, GlobalTrip %d, GlobalReset %d", @EnvError_RCMStatusMessage_MAC, g_TripCnt, g_ResetCnt);
    }
  }
}
on envVar EnvVerify_RCMStatusMessage_MAC
{
  if (@this == 1) {
    @EnvMsg_RCMStatusMessage_MAC = 0;
    @EnvError_RCMStatusMessage_MAC = 0;
  }
}
 on message RCMStatusMessage_2_MAC
 {
   byte payloadLength = 4;
   qword truncatedAuthenticator;
   dword truncatedAuthenticatorBitLength = 28;
   qword freshness;
   dword truncatedFreshnessBitLength = 4;
   dword freshnessValueBitLength = 48;
   long result;
   dword validationResult;
   qword oldMsgCnt;
  
   oldMsgCnt = msgCnt_RCMStatusMessage2;
   if((tripCnt_RCMStatusMessage2 != g_TripCnt) || (resetCnt_RCMStatusMessage2 != g_ResetCnt)) {
     tripCnt_RCMStatusMessage2 = g_TripCnt;
     resetCnt_RCMStatusMessage2 = g_ResetCnt;
     if(resetCnt_RCMStatusMessage2 < 0xFFFFF) {
       msgCnt_RCMStatusMessage2 = 1;
     }
     else {
       msgCnt_RCMStatusMessage2 = 0xFF;
     }
   }
   else{
     if(msgCnt_RCMStatusMessage2 < 0xFF) {
       msgCnt_RCMStatusMessage2 += 1;
     }
     else {
       msgCnt_RCMStatusMessage2 = 0xFF;
     }
   }
  
   resetFlag_RCMStatusMessage2 = resetCnt_RCMStatusMessage2 & 0x03;
   freshness = ((tripCnt_RCMStatusMessage2 << 32) | (resetCnt_RCMStatusMessage2 << 12)
   | (msgCnt_RCMStatusMessage2 << 4) | (resetFlag_RCMStatusMessage2 << 2));
   payload_RCMStatusMessage2[0] =  this.byte(0);
   payload_RCMStatusMessage2[1] =  this.byte(1);
   payload_RCMStatusMessage2[2] =  this.byte(2);
   payload_RCMStatusMessage2[3] =  this.byte(3);
   result = LocalSecurityVerifyAuthenticationInformation(this.id, payload_RCMStatusMessage2, payloadLength, this.RCMStatusMessage_2_MACTx, truncatedAuthenticatorBitLength, this.RCMStatusMessage_2_FVTx, truncatedFreshnessBitLength, freshness, freshnessValueBitLength, validationResult);
   if (@EnvVerify_RCMStatusMessage_2_MAC == 1)
   {
     @EnvMsg_RCMStatusMessage_2_MAC += 1;
     if (1 != validationResult) {
       @EnvError_RCMStatusMessage_2_MAC += 1;
       msgCnt_RCMStatusMessage2 = oldMsgCnt;
       Write("Verify FAIL %d, tripCnt %d, resetCnt %d, msgCnt %d",@EnvError_RCMStatusMessage_2_MAC, tripCnt_RCMStatusMessage2, resetCnt_RCMStatusMessage2, msgCnt_RCMStatusMessage2);
       Write("Verify FAIL %d, GlobalTrip %d, GlobalReset %d", @EnvError_RCMStatusMessage_2_MAC, g_TripCnt, g_ResetCnt);
     }
   }
 }
on envVar EnvVerify_RCMStatusMessage_2_MAC
{
  if (@this == 1) {
    @EnvMsg_RCMStatusMessage_2_MAC = 0;
    @EnvError_RCMStatusMessage_2_MAC = 0;
  }
}
on message crashoutput_MAC
{
  byte payloadLength = 4;
  qword truncatedAuthenticator;
  dword truncatedAuthenticatorBitLength = 28;
  qword freshness;
  qword freshness_noupdate;
  dword truncatedFreshnessBitLength = 4;
  dword freshnessValueBitLength = 48;
  long result;
  dword validationResult;
  qword oldMsgCnt;
  
  oldMsgCnt = msgCnt_crashoutput;
  if((tripCnt_crashoutput != g_TripCnt) || (resetCnt_crashoutput != g_ResetCnt)) {
    tripCnt_crashoutput = g_TripCnt;
    resetCnt_crashoutput = g_ResetCnt;
    if(resetCnt_crashoutput < 0xFFFFF) {
      msgCnt_crashoutput = 1;
    }
    else {
      msgCnt_crashoutput = 0xFF;
    }
  }
  else{
    if(msgCnt_crashoutput < 0xFF) {
      msgCnt_crashoutput += 1;
    }
    else {
      msgCnt_crashoutput = 0xFF;
    }
  }
  
  resetFlag_crashoutput = resetCnt_crashoutput & 0x03;
  freshness = ((tripCnt_crashoutput << 32) | (resetCnt_crashoutput << 12)
  | (msgCnt_crashoutput << 4) | (resetFlag_crashoutput << 2));
  payload_crashoutput[0] =  this.byte(0);
  payload_crashoutput[1] =  this.byte(1);
  payload_crashoutput[2] =  this.byte(2);
  payload_crashoutput[3] =  this.byte(3);
  result = LocalSecurityVerifyAuthenticationInformation(this.id, payload_crashoutput, payloadLength, this.crashoutput_MACTx, truncatedAuthenticatorBitLength, this.crashoutput_FVTx, truncatedFreshnessBitLength, freshness, freshnessValueBitLength, validationResult);
  if (@EnvVerify_crashoutput_MAC == 1)
  {
    @EnvMsg_crashoutput_MAC += 1;
    if (1 != validationResult) {
      @EnvError_crashoutput_MAC += 1;
      msgCnt_crashoutput = oldMsgCnt;
      Write("Verify FAIL %d, tripCnt %d, resetCnt %d, msgCnt %d",@EnvError_crashoutput_MAC, tripCnt_crashoutput, resetCnt_crashoutput, msgCnt_crashoutput);
      Write("Verify FAIL %d, GlobalTrip %d, GlobalReset %d", @EnvError_crashoutput_MAC, g_TripCnt, g_ResetCnt);
    }
  }
}
on envVar EnvVerify_crashoutput_MAC
{
  if (@this == 1) {
    @EnvMsg_crashoutput_MAC = 0;
    @EnvError_crashoutput_MAC = 0;
  }
}

on message crashoutput_brk_MAC
{
  byte payloadLength = 4;
  qword truncatedAuthenticator;
  dword truncatedAuthenticatorBitLength = 28;
  qword freshness;
  qword freshness_noupdate;
  dword truncatedFreshnessBitLength = 4;
  dword freshnessValueBitLength = 48;
  long result;
  dword validationResult;
  qword oldMsgCnt;
  
  oldMsgCnt = msgCnt_crashoutputbrk;
  if((tripCnt_crashoutputbrk != g_TripCnt) || (resetCnt_crashoutputbrk != g_ResetCnt)) {
    tripCnt_crashoutputbrk = g_TripCnt;
    resetCnt_crashoutputbrk = g_ResetCnt;
    if(resetCnt_crashoutputbrk < 0xFFFFF) {
      msgCnt_crashoutputbrk = 1;
    }
    else {
      msgCnt_crashoutputbrk = 0xFF;
    }
  }
  else{
    if(msgCnt_crashoutputbrk < 0xFF) {
      msgCnt_crashoutputbrk += 1;
    }
    else {
      msgCnt_crashoutputbrk = 0xFF;
    }
  }
  
  resetFlag_crashoutputbrk = resetCnt_crashoutputbrk & 0x03;
  freshness = ((tripCnt_crashoutputbrk << 32) | (resetCnt_crashoutputbrk << 12)
  | (msgCnt_crashoutputbrk << 4) | (resetFlag_crashoutputbrk << 2));
  payload_crashoutputbrk[0] =  this.byte(0);
  payload_crashoutputbrk[1] =  this.byte(1);
  payload_crashoutputbrk[2] =  this.byte(2);
  payload_crashoutputbrk[3] =  this.byte(3);
  result = LocalSecurityVerifyAuthenticationInformation(this.id, payload_crashoutputbrk, payloadLength, this.crashoutput_brk_MACTx, truncatedAuthenticatorBitLength, this.crashoutput_brk_FVTx, truncatedFreshnessBitLength, freshness, freshnessValueBitLength, validationResult);
  if (@EnvVerify_crashoutput_brk_MAC == 1)
  {
    @EnvMsg_crashoutput_brk_MAC += 1;
    if (1 != validationResult) {
      @EnvError_crashoutput_brk_MAC += 1;
      msgCnt_crashoutputbrk = oldMsgCnt;
      Write("Verify FAIL %d, tripCnt %d, resetCnt %d, msgCnt %d",@EnvError_crashoutput_brk_MAC, tripCnt_crashoutputbrk, resetCnt_crashoutputbrk, msgCnt_crashoutputbrk);
      Write("Verify FAIL %d, GlobalTrip %d, GlobalReset %d", @EnvError_crashoutput_brk_MAC, g_TripCnt, g_ResetCnt);
    }
  }
}
on envVar EnvVerify_crashoutput_brk_MAC
{
  if (@this == 1) {
    @EnvMsg_crashoutput_brk_MAC = 0;
    @EnvError_crashoutput_brk_MAC = 0;
  }
}
on envVar Env_Reset_Trigger
{
  
  if (@this == 1)
  {
   g_TripCnt = 0;
   g_ResetCnt = 0;
   write("Update (Reset): TripCnt %llu, ResetCnt %llu", g_TripCnt, g_ResetCnt);
  
    msgCnt_CruiseMultiSwitch1 = 0;
   resetFlag_CruiseMultiSwitch1 = 0;
   tripCnt_CruiseMultiSwitch1 = 0;
   resetCnt_CruiseMultiSwitch1 = 0;
   
   
  
   msgCnt_HvacControlInformation2 = 0;
   resetFlag_HvacControlInformation2 = 0;
   tripCnt_HvacControlInformation2 = 0;
   resetCnt_HvacControlInformation2 = 0;
   
   
  
   msgCnt_WheelData2 = 0;
   resetFlag_WheelData2 = 0;
   tripCnt_WheelData2 = 0;
   resetCnt_WheelData2 = 0;
   
   
  
   msgCnt_BCMInformation1 = 0;
   resetFlag_BCMInformation1 = 0;
   tripCnt_BCMInformation1 = 0;
   resetCnt_BCMInformation1 = 0;
   
   
  
   msgCnt_RCMStatusMessage2 = 0;
   resetFlag_RCMStatusMessage2 = 0;
   tripCnt_RCMStatusMessage2 = 0;
   resetCnt_RCMStatusMessage2 = 0;
   
   
  
   msgCnt_YawRate = 0;
   resetFlag_YawRate = 0;
   tripCnt_YawRate = 0;
   resetCnt_YawRate = 0;
   
   
  
   msgCnt_LateAcc = 0;
   resetFlag_LateAcc = 0;
   tripCnt_LateAcc = 0;
   resetCnt_LateAcc = 0;
   
   
  
   msgCnt_LongAcc = 0;
   resetFlag_LongAcc = 0;
   tripCnt_LongAcc = 0;
   resetCnt_LongAcc = 0;
   
   
  
   msgCnt_RCMStatusMessage1 = 0;
   resetFlag_RCMStatusMessage1 = 0;
   tripCnt_RCMStatusMessage1 = 0;
   resetCnt_RCMStatusMessage1 = 0;
   
   
  
   msgCnt_crashoutput = 0;
   resetFlag_crashoutput = 0;
   tripCnt_crashoutput = 0;
   resetCnt_crashoutput = 0;
    
   msgCnt_crashoutputbrk = 0;
   resetFlag_crashoutputbrk = 0;
   tripCnt_crashoutputbrk = 0;
   resetCnt_crashoutputbrk = 0;
   
  }
}
//on timer T_MSG_EPAS_Info_MAC 
//{
//	MSG_EPAS_Info_MAC.EPAS_Info_MACTx = getvalue ( EnvEPAS_Info_MACTx_);
//	MSG_EPAS_Info_MAC.EPAS_Info_FVTx = getvalue ( EnvEPAS_Info_FVTx_);
//	MSG_EPAS_Info_MAC.SteeringAngleChangeRate = getvalue ( EnvSteeringAngleChangeRate_);
//	MSG_EPAS_Info_MAC.SteAngChRate_No_Cnt = getvalue ( EnvSteAngChRate_No_Cnt_);
//	MSG_EPAS_Info_MAC.Epas_ContStatus = getvalue ( EnvEpas_ContStatus_);
//	MSG_EPAS_Info_MAC.SteeringColumnTorque = getvalue ( EnvSteeringColumnTorque_);
//
//	/*  Output  */
//	
//	MSG_EPAS_Info_MAC.Dlc = getvalue ( EnvEPAS_Info_MACDlc_);
//	 
//	if(getvalue(EnvEPAS_Info_MACTo_))
//	{
//		output(MSG_EPAS_Info_MAC);
//	}
//	else
//	{
//		Write("EPAS_Info_MAC Message is not sent ");
//	}
//	 
//	settimer(T_MSG_EPAS_Info_MAC,  getvalue(EnvEPAS_Info_MACTime_));
//	 
//
//}
//on timer T_MSG_ADAS_AP_Collision_Data1 
//{
//	MSG_ADAS_AP_Collision_Data1.ADAS_Fu_TTC = getvalue ( EnvADAS_Fu_TTC_);
//	MSG_ADAS_AP_Collision_Data1.ADAS_Fu_Relative_Vel_X = getvalue ( EnvADAS_Fu_Relative_Vel_X_);
//	MSG_ADAS_AP_Collision_Data1.ADAS_Fu_Object_ID = getvalue ( EnvADAS_Fu_Object_ID_);
//	MSG_ADAS_AP_Collision_Data1.ADAS_AP_Crash_Statas = getvalue ( EnvADAS_AP_Crash_Statas_);
//
//	/*  Output  */
//	
//	MSG_ADAS_AP_Collision_Data1.Dlc = getvalue ( EnvADAS_AP_Collision_Data1Dlc_);
//	 
//	if(getvalue(EnvADAS_AP_Collision_Data1To_))
//	{
//		output(MSG_ADAS_AP_Collision_Data1);
//	}
//	else
//	{
//		Write("ADAS_AP_Collision_Data1 Message is not sent ");
//	}
//	 
//	settimer(T_MSG_ADAS_AP_Collision_Data1,  getvalue(EnvADAS_AP_Collision_Data1Time_));
//	 
//
//}
//on timer T_MSG_ADAS_SteeringCtrlReq_Data 
//{
//	MSG_ADAS_SteeringCtrlReq_Data.ADAS_TqFactr_Req = getvalue ( EnvADAS_TqFactr_Req_);
//	MSG_ADAS_SteeringCtrlReq_Data.ADAS_Types_Str = getvalue ( EnvADAS_Types_Str_);
//	MSG_ADAS_SteeringCtrlReq_Data.ADAS_SteCtlTrgt_AnV_Req = getvalue ( EnvADAS_SteCtlTrgt_AnV_Req_);
//	MSG_ADAS_SteeringCtrlReq_Data.ADAS_SteCtlTrgt_An_Req = getvalue ( EnvADAS_SteCtlTrgt_An_Req_);
//	MSG_ADAS_SteeringCtrlReq_Data.ADAS_SteCtlEnbl_D_Actl = getvalue ( EnvADAS_SteCtlEnbl_D_Actl_);
//	MSG_ADAS_SteeringCtrlReq_Data.ADAS_SteCtlReq_No_Cnt = getvalue ( EnvADAS_SteCtlReq_No_Cnt_);
//	MSG_ADAS_SteeringCtrlReq_Data.ADAS_SteCtlFail_D_Actl = getvalue ( EnvADAS_SteCtlFail_D_Actl_);
//	MSG_ADAS_SteeringCtrlReq_Data.ADAS_SteCtlCancl_D_Actl = getvalue ( EnvADAS_SteCtlCancl_D_Actl_);
//	MSG_ADAS_SteeringCtrlReq_Data.ADAS_SteLdwCtl_D_Req = getvalue ( EnvADAS_SteLdwCtl_D_Req_);
//	MSG_ADAS_SteeringCtrlReq_Data.ADAS_SteCtlReq_No_CRC = getvalue ( EnvADAS_SteCtlReq_No_CRC_);
//
//	/*  Output  */
//	
//	MSG_ADAS_SteeringCtrlReq_Data.Dlc = getvalue ( EnvADAS_SteeringCtrlReq_DataDlc_);
//	 
//	if(getvalue(EnvADAS_SteeringCtrlReq_DataTo_))
//	{
//		output(MSG_ADAS_SteeringCtrlReq_Data);
//	}
//	else
//	{
//		Write("ADAS_SteeringCtrlReq_Data Message is not sent ");
//	}
//	 
//	settimer(T_MSG_ADAS_SteeringCtrlReq_Data,  getvalue(EnvADAS_SteeringCtrlReq_DataTime_));
//	 
//
//}
//on timer T_MSG_RCMStatusMessage_2_MAC 
//{
//	MSG_RCMStatusMessage_2_MAC.RCMStatusMessage_2_MACTx = getvalue ( EnvRCMStatusMessage_2_MACTx_);
//	MSG_RCMStatusMessage_2_MAC.RCMStatusMessage_2_FVTx = getvalue ( EnvRCMStatusMessage_2_FVTx_);
//	MSG_RCMStatusMessage_2_MAC.threshold_over_fst = getvalue ( Envthreshold_over_fst_);
//
//	/*  Output  */
//	
//	MSG_RCMStatusMessage_2_MAC.Dlc = getvalue ( EnvRCMStatusMessage_2_MACDlc_);
//	 
//	if(getvalue(EnvRCMStatusMessage_2_MACTo_))
//	{
//		output(MSG_RCMStatusMessage_2_MAC);
//	}
//	else
//	{
//		Write("RCMStatusMessage_2_MAC Message is not sent ");
//	}
//	 
//	settimer(T_MSG_RCMStatusMessage_2_MAC,  getvalue(EnvRCMStatusMessage_2_MACTime_));
//	 
//
//}
//on timer T_MSG_YAW_Rate_Brake_Control_1_1_MAC 
//{
//	MSG_YAW_Rate_Brake_Control_1_1_MAC.YAW_Rate_Brake_Control_1_1_MACTx = getvalue ( EnvYAW_Rate_Brake_Control_1_1_MACTx_);
//	MSG_YAW_Rate_Brake_Control_1_1_MAC.YAW_Rate_Brake_Control_1_1_FVTx = getvalue ( EnvYAW_Rate_Brake_Control_1_1_FVTx_);
//	MSG_YAW_Rate_Brake_Control_1_1_MAC.VehSensSig_1_No_Cs = getvalue ( EnvVehSensSig_1_No_Cs_);
//	MSG_YAW_Rate_Brake_Control_1_1_MAC.VehSensSig_1_No_Cnt = getvalue ( EnvVehSensSig_1_No_Cnt_);
//	MSG_YAW_Rate_Brake_Control_1_1_MAC.StopLamp_D_RqArb = getvalue ( EnvStopLamp_D_RqArb_);
//	MSG_YAW_Rate_Brake_Control_1_1_MAC.VehLong_A_Actl = getvalue ( EnvVehLong_A_Actl_);
//	MSG_YAW_Rate_Brake_Control_1_1_MAC.VehLongAActl_D_Qf = getvalue ( EnvVehLongAActl_D_Qf_);
//
//	/*  Output  */
//	
//	MSG_YAW_Rate_Brake_Control_1_1_MAC.Dlc = getvalue ( EnvYAW_Rate_Brake_Control_1_1_MACDlc_);
//	 
//	if(getvalue(EnvYAW_Rate_Brake_Control_1_1_MACTo_))
//	{
//		output(MSG_YAW_Rate_Brake_Control_1_1_MAC);
//	}
//	else
//	{
//		Write("YAW_Rate_Brake_Control_1_1_MAC Message is not sent ");
//	}
//	 
//	settimer(T_MSG_YAW_Rate_Brake_Control_1_1_MAC,  getvalue(EnvYAW_Rate_Brake_Control_1_1_MACTime_));
//	 
//
//}
on timer T_MSG_WheelData_2_MAC 
{
//  byte payloadLength = 4;
//  qword truncatedAuthenticator;
//  dword truncatedAuthenticatorBitLength = 28;
//  qword freshness;
//  dword truncatedFreshnessBitLength = 4;
//  dword freshnessValueBitLength = 48;
//  long result;
	MSG_WheelData_2_MAC.WheelData_2_MACTx = getvalue ( EnvWheelData_2_MACTx_);
	MSG_WheelData_2_MAC.WheelData_2_FVTx = getvalue ( EnvWheelData_2_FVTx_);
	MSG_WheelData_2_MAC.VehVActlBrk_No_Cs = getvalue ( EnvVehVActlBrk_No_Cs_);
	MSG_WheelData_2_MAC.VehVActlBrk_No_Cnt = getvalue ( EnvVehVActlBrk_No_Cnt_);
	MSG_WheelData_2_MAC.Vehicle_Stationary = getvalue ( EnvVehicle_Stationary_);
	MSG_WheelData_2_MAC.VehVActlBrk_D_Qf = getvalue ( EnvVehVActlBrk_D_Qf_);
	
  //Simulate value for testcase Tsync.
  data_simulate = getvalue(Env_24EDR_sampleDataT0);
  if(data_simulate == 0x00){
    @EnvVeh_V_ActlBrk_ += 100;
  	if (@EnvVeh_V_ActlBrk_ > 20000){
  		@EnvVeh_V_ActlBrk_ = 0;
  	}
  }
  MSG_WheelData_2_MAC.Veh_V_ActlBrk = getvalue ( EnvVeh_V_ActlBrk_);
	
	/* add cnt and cs*/
	@EnvVehVActlBrk_No_Cnt_ += 1;
	if (@EnvVehVActlBrk_No_Cnt_ > 15){
		@EnvVehVActlBrk_No_Cnt_ = 0;
	}
	MSG_WheelData_2_MAC.VehVActlBrk_No_Cnt = getValue (EnvVehVActlBrk_No_Cnt_);
	
	@EnvVehVActlBrk_No_Cs_  = 0;
	@EnvVehVActlBrk_No_Cs_ += MSG_WheelData_2_MAC.byte(0);
	@EnvVehVActlBrk_No_Cs_ += MSG_WheelData_2_MAC.byte(1);
	@EnvVehVActlBrk_No_Cs_ += MSG_WheelData_2_MAC.byte(2);
	@EnvVehVActlBrk_No_Cs_ += MSG_WheelData_2_MAC.dlc;
	@EnvVehVActlBrk_No_Cs_ += MSG_WheelData_2_MAC.id;
	
	MSG_WheelData_2_MAC.VehVActlBrk_No_Cs = getValue (EnvVehVActlBrk_No_Cs_);
	
	
	/*  Output  */
	if(@Env_Qbit_Error == 1)
	{
    putvalue ( EnvVehVActlBrk_D_Qf_, 0 );
		MSG_WheelData_2_MAC.VehVActlBrk_D_Qf = getvalue ( EnvVehVActlBrk_D_Qf_);
  }else {
    putValue(EnvVehVActlBrk_D_Qf_,3);
    MSG_WheelData_2_MAC.VehVActlBrk_D_Qf = getvalue ( EnvVehVActlBrk_D_Qf_);
	}
/*start point*/	
	if(data_selection == 0)
	{
	if(use_case == 0) // use case 1: Invalid - Unobtain 
	{
		if (Unobtain_pattern != 0)
		{
			if (Invalid_pattern > 0)
			{
				Invalid_pattern--;
				putvalue(EnvWheelData_2_MACTo_,1);
				MSG_WheelData_2_MAC.VehVActlBrk_D_Qf = 0;
			}else
			{
				putvalue(EnvWheelData_2_MACTo_,0);
        Unobtain_pattern--;
			}
		}else
			{	
        putvalue(EnvWheelData_2_MACTo_,1);
				Invalid_pattern = getvalue(Env_24EDR_Invalid_)-1;
				Unobtain_pattern = getvalue(Env_24EDR_Unobtain_);
			}
	}else if (use_case == 1) //use case 2 : invalid - valid
	{
		if(Valid_pattern > 0)
		{
			if(Invalid_pattern > 0)
			{
				Invalid_pattern--;
				MSG_WheelData_2_MAC.VehVActlBrk_D_Qf = 0;
			}else
			{
				Valid_pattern --;
			}
		}else
		{
      MSG_WheelData_2_MAC.VehVActlBrk_D_Qf = 0;
			Invalid_pattern = getvalue(Env_24EDR_Invalid_)-1;
			Valid_pattern = getvalue(Env_24EDR_Valid_);
		}
		
	}else if (use_case == 2) //use case 2: unobtain - valid
  {
    if(Valid_pattern > 0)
		{
			if(Unobtain_pattern != 0)
			{
				Unobtain_pattern--;
				putvalue(EnvWheelData_2_MACTo_,0);
			}else
			{
				Valid_pattern --;
        putvalue(EnvWheelData_2_MACTo_,1);
			}
		}else
		{
      putvalue(EnvWheelData_2_MACTo_,0);
			Unobtain_pattern = getvalue(Env_24EDR_Unobtain_)-1;
			Valid_pattern = getvalue(Env_24EDR_Valid_);
		}
  }
	}
	MSG_WheelData_2_MAC.Dlc = getvalue ( EnvWheelData_2_MACDlc_);
	 
	if(getvalue(EnvWheelData_2_MACTo_))
	{
//    if((tripCnt_WheelData2 != g_TripCnt) | (resetCnt_WheelData2 != g_ResetCnt)) {
//      tripCnt_WheelData2 = g_TripCnt;
//      resetCnt_WheelData2 = g_ResetCnt;
//      if(resetCnt_WheelData2 < 0xFFFFF) {
//        msgCnt_WheelData2 = 1;
//      }
//      else {
//        msgCnt_WheelData2 = 0xFF;
//      }
//    }
//    else{
//      if(msgCnt_WheelData2 < 0xFF) {
//        msgCnt_WheelData2 += 1;
//      }
//      else {
//        msgCnt_WheelData2 = 0xFF;
//      }
//    }
//    resetFlag_WheelData2 = resetCnt_WheelData2 & 0x03;
//    freshness = ((tripCnt_WheelData2 << 32) | (resetCnt_WheelData2 << 12)
//    | (msgCnt_WheelData2 << 4) | (resetFlag_WheelData2 << 2));
//    payload_WheelData2[0] =  MSG_WheelData_2_MAC.byte(0);
//    payload_WheelData2[1] =  MSG_WheelData_2_MAC.byte(1);
//    payload_WheelData2[2] =  MSG_WheelData_2_MAC.byte(2);
//    payload_WheelData2[3] =  MSG_WheelData_2_MAC.byte(3);
//  	result = LocalSecurityCalculateAuthenticator(MSG_WheelData_2_MAC.id, payload_WheelData2, payloadLength, truncatedAuthenticator, truncatedAuthenticatorBitLength, freshness, truncatedFreshnessBitLength, freshnessValueBitLength);
//    
//    putValue(EnvWheelData_2_FVTx_, freshness);
//    putValue(EnvWheelData_2_MACTx_, truncatedAuthenticator);
//    MSG_WheelData_2_MAC.WheelData_2_MACTx = getvalue ( EnvWheelData_2_MACTx_);
//  	MSG_WheelData_2_MAC.WheelData_2_FVTx = getvalue ( EnvWheelData_2_FVTx_);
//    if (@EnvFWheelData_2_MAC) {
//      MSG_WheelData_2_MAC.WheelData_2_MACTx = getvalue ( EnvWheelData_2_MACTx_) + 1;
//    }
		output(MSG_WheelData_2_MAC);
	}
	else
	{
		Write("WheelData_2_MAC Message is not sent ");
	}
	 
	settimer(T_MSG_WheelData_2_MAC,  getvalue(EnvWheelData_2_MACTime_));	
	 

}
//on timer T_MSG_Hvac_Control_Information2 
//{
//	MSG_Hvac_Control_Information2.SteerHeatIndic_D_Req = getvalue ( EnvSteerHeatIndic_D_Req_);
//	MSG_Hvac_Control_Information2.SeatVentIndicRr_D_Req = getvalue ( EnvSeatVentIndicRr_D_Req_);
//	MSG_Hvac_Control_Information2.SeatVentIndicRl_D_Req = getvalue ( EnvSeatVentIndicRl_D_Req_);
//	MSG_Hvac_Control_Information2.SeatHeatIndicRr_D_Req = getvalue ( EnvSeatHeatIndicRr_D_Req_);
//	MSG_Hvac_Control_Information2.SteerHeat_Elm_Enable = getvalue ( EnvSteerHeat_Elm_Enable_);
//	MSG_Hvac_Control_Information2.SeatHeat_Elm_Enable = getvalue ( EnvSeatHeat_Elm_Enable_);
//	MSG_Hvac_Control_Information2.Charge_Mode_Enabled_SW = getvalue ( EnvCharge_Mode_Enabled_SW_);
//	MSG_Hvac_Control_Information2.Drive_Mode_Enabled_Switch = getvalue ( EnvDrive_Mode_Enabled_Switch_);
//	MSG_Hvac_Control_Information2.atcControlStatus = getvalue ( EnvatcControlStatus_);
//	MSG_Hvac_Control_Information2.SeatVentIndicFr_D_Req = getvalue ( EnvSeatVentIndicFr_D_Req_);
//	MSG_Hvac_Control_Information2.SeatVentIndicFl_D_Req = getvalue ( EnvSeatVentIndicFl_D_Req_);
//	MSG_Hvac_Control_Information2.SeatHeatIndicFr_D_Req = getvalue ( EnvSeatHeatIndicFr_D_Req_);
//	MSG_Hvac_Control_Information2.SeatHeatIndicFl_D_Req = getvalue ( EnvSeatHeatIndicFl_D_Req_);
//	MSG_Hvac_Control_Information2.atcACmodeDisp = getvalue ( EnvatcACmodeDisp_);
//	MSG_Hvac_Control_Information2.atcAImodeDisp = getvalue ( EnvatcAImodeDisp_);
//	MSG_Hvac_Control_Information2.atcADmodeDisp = getvalue ( EnvatcADmodeDisp_);
//	MSG_Hvac_Control_Information2.atcBlwLvlDisp = getvalue ( EnvatcBlwLvlDisp_);
//	MSG_Hvac_Control_Information2.HvacEngStopCtrl_D_Actl = getvalue ( EnvHvacEngStopCtrl_D_Actl_);
//	MSG_Hvac_Control_Information2.SeatHeatIndicRl_D_Req = getvalue ( EnvSeatHeatIndicRl_D_Req_);
//	MSG_Hvac_Control_Information2.BlowerSpeed = getvalue ( EnvBlowerSpeed_);
//	MSG_Hvac_Control_Information2.HvacEngStopInputFail_D_Rq = getvalue ( EnvHvacEngStopInputFail_D_Rq_);
//	MSG_Hvac_Control_Information2.HvacAirCond_B_Rq = getvalue ( EnvHvacAirCond_B_Rq_);
//	MSG_Hvac_Control_Information2.HvacEngStopDis_B_Rq_exceptTEva = getvalue ( EnvHvacEngStopDis_B_Rq_exceptTEva_);
//	MSG_Hvac_Control_Information2.HvacEngStopDis_B_Rq = getvalue ( EnvHvacEngStopDis_B_Rq_);
//
//	/*  Output  */
//	
//	MSG_Hvac_Control_Information2.Dlc = getvalue ( EnvHvac_Control_Information2Dlc_);
//	 
//	if(getvalue(EnvHvac_Control_Information2To_))
//	{
//		output(MSG_Hvac_Control_Information2);
//	}
//	else
//	{
//		Write("Hvac_Control_Information2 Message is not sent ");
//	}
//	 
//	settimer(T_MSG_Hvac_Control_Information2,  getvalue(EnvHvac_Control_Information2Time_));
//	 
//
//}
//on timer T_MSG_WheelSpeed 
//{
//	MSG_WheelSpeed.RRwheelSpeed = getvalue ( EnvRRwheelSpeed_);
//	MSG_WheelSpeed.RLwheelSpeed = getvalue ( EnvRLwheelSpeed_);
//	MSG_WheelSpeed.FRwheelSpeed = getvalue ( EnvFRwheelSpeed_);
//	MSG_WheelSpeed.FLwheelSpeed = getvalue ( EnvFLwheelSpeed_);
//
//	/*  Output  */
//	
//	MSG_WheelSpeed.Dlc = getvalue ( EnvWheelSpeedDlc_);
//	 
//	if(getvalue(EnvWheelSpeedTo_))
//	{
//		output(MSG_WheelSpeed);
//	}
//	else
//	{
//		Write("WheelSpeed Message is not sent ");
//	}
//	 
//	settimer(T_MSG_WheelSpeed,  getvalue(EnvWheelSpeedTime_));
//	 
//
//}

//yuy1hc: add additional on event
//on envvar EnvVDT_Trigger_Control2To_ 
//{
//  if (@this == 1) {
//  	MSG_VDT_Trigger_Control2.VDT_Cancel_Resp_Counter2 = getvalue ( EnvVDT_Cancel_Resp_Counter2_);
//  	MSG_VDT_Trigger_Control2.VDT_Resp_Counter2 = getvalue ( EnvVDT_Resp_Counter2_);
//  	MSG_VDT_Trigger_Control2.VDT_INV_ODR2_ReqTCU = getvalue ( EnvVDT_INV_ODR2_ReqTCU_);
//  	MSG_VDT_Trigger_Control2.VDT_INV_ODR2_Rq = getvalue ( EnvVDT_INV_ODR2_Rq_);
//  	MSG_VDT_Trigger_Control2.VDT_ECM_ODR1_ReqTCU = getvalue ( EnvVDT_ECM_ODR1_ReqTCU_);
//  	MSG_VDT_Trigger_Control2.VDT_ECM_ODR1_Rq = getvalue ( EnvVDT_ECM_ODR1_Rq_);
//  	MSG_VDT_Trigger_Control2.VDT_RCM_ODR1_ReqTCU = getvalue ( EnvVDT_RCM_ODR1_ReqTCU_);
//  	MSG_VDT_Trigger_Control2.VDT_RCM_ODR1_Rq = getvalue ( EnvVDT_RCM_ODR1_Rq_);
//  	MSG_VDT_Trigger_Control2.TCU_SW_Update_Resp = getvalue ( EnvTCU_SW_Update_Resp_);
//  	MSG_VDT_Trigger_Control2.VDT_Cancel_PreAC_Resp = getvalue ( EnvVDT_Cancel_PreAC_Resp_);
//  	MSG_VDT_Trigger_Control2.VDT_PreAC_Resp = getvalue ( EnvVDT_PreAC_Resp_);
//  	MSG_VDT_Trigger_Control2.VDT_Cancel_Charge_Resp = getvalue ( EnvVDT_Cancel_Charge_Resp_);
//  	MSG_VDT_Trigger_Control2.VDT_Charge_Resp = getvalue ( EnvVDT_Charge_Resp_);
//
//  	/*  Output  */
//  	
//  	MSG_VDT_Trigger_Control2.Dlc = 8;
//  	 
//  	output(MSG_VDT_Trigger_Control2);
//      @this = 0;
//  }
//
//}
on envVar Env_SEC_AES_Seed
{
  dword keyLength = 32;
  byte V_SeedByte_b[16];
//  int i;
  
  getValue(Env_SEC_AES_Seed, V_SeedByte_b);
  
  LocalSecurityEncryptAES128CBC(AES_Key, 16, V_SeedByte_b, 16, AES_InitVector, 16, VAR_SA_KeyData, keyLength);
  
  putValue(Env_SEC_AES_Key, VAR_SA_KeyData, 16);
}

on signal_update RILReq {
  if (@Env_WL_Mismatch_Error == 0) {
    if (getSignal(RILReq) != 3) {
      putvalue(EnvRIL_STAT_, getSignal(RILReq));
    }
    else {
      putvalue(EnvRIL_STAT_, 1);
    }
  }
}

on signal_update PAD_Ind_Req {
  if (@Env_PADI_Mismatch_Error == 0) {
    if (getSignal(PAD_Ind_Req) != 4) {
      putvalue(EnvPADI_Stat_, getSignal(PAD_Ind_Req));
    }
    else {
      putvalue(EnvPADI_Stat_, 3);
    }
  }
}

on envVar EnvVehVActlBrk_D_Qf_
{
if (@EnvBurnTimer_ == 1){
 settimer(T_MSG_WheelData_2_MAC,  1); 
 }
}

on envVar EnvRIL_STAT_
{
 if (@EnvBurnTimer_ == 1){
 settimer(T_MSG_Cruise_Multi_Switch_1_MAC, 1);
 }
}

on envvar Env_CGW_Sync_SendOnce
{
  if(@this == 1) {
    /* message ID for CGW_Sync */
    dword dataID = 0x20;
    /* Data buffer (Input of CMAC generate) and data length ( NULL Cause to CGW_Sync do not need this ) */
    byte payload[1];          
    qword PayloadLength = 0;
    /* Authenticator generate by CMAC */
    qword authenticator;
    dword authenticatorBitLength = 28;
    /* Freshness Input (data + length) (TripCounter and ResetCounter) */
    qword freshness;
    dword freshnessLength = 40;
    /* Freshness length of Output (Don't need for this message) */
    dword freshnessTxBitLength = 36;
    /* Other variables */
    dword result;
    qword local_TripCounter;
    qword local_ResetCounter;
    
    local_TripCounter = getvalue(EnvCGW_Sync_TripCnt_);
    local_ResetCounter = getvalue(EnvCGW_Sync_ResetCnt_);
    
    freshness = (local_TripCounter << 24) | ((local_ResetCounter & 0xFFFFF)<<4); // 20+16 + 4(padding)
    result = LocalSecurityCalculateAuthenticator(dataID, payload, PayloadLength, authenticator, authenticatorBitLength, freshness, freshnessTxBitLength, freshnessLength);
    putValue(EnvCGW_Sync_MACTx_, authenticator);
    
    
  	MSG_CGW_Sync.CGW_Sync_MACTx = getvalue ( EnvCGW_Sync_MACTx_);
  	MSG_CGW_Sync.CGW_Sync_ResetCnt = getvalue ( EnvCGW_Sync_ResetCnt_);
  	MSG_CGW_Sync.CGW_Sync_TripCnt = getvalue ( EnvCGW_Sync_TripCnt_);
    
    if (@Env_CGW_Sync_FailMAC) {
      MSG_CGW_Sync.CGW_Sync_MACTx = getvalue ( EnvCGW_Sync_MACTx_) / 2;
    }

  	/*  Output  */
    MSG_CGW_Sync.Dlc = getvalue ( EnvCGW_SyncDlc_);
  	output(MSG_CGW_Sync);

  }
}
on envVar Env_24EDR_CtrlBut_
{  
  if(cnt > 253)
  {
    cnt = 0;
  }
  if(@Env_24EDR_CtrlBut_ == 1){
    
    }
   if(@Env_24EDR_CtrlBut_ == 0){
    cnt++;
    }
  putvalue(Env_24EDR_LEDState,cnt%2);
}
on envvar Env_24EDR_LEDState
{
  if(@Env_24EDR_LEDState == 1)
  {

    Valid_pattern = getvalue(Env_24EDR_Valid_);
    Invalid_pattern = getvalue(Env_24EDR_Invalid_);
    Unobtain_pattern = getvalue(Env_24EDR_Unobtain_);
	if((Valid_pattern == 0)&(Invalid_pattern > 0)&(Unobtain_pattern != 0))
	{
    Write("use case 1: unobtain - invalid");
		use_case = 0; // use case 1: unobtain - invalid
	}
	else if ((Valid_pattern > 0)&(Invalid_pattern > 0)&(Unobtain_pattern == 0))
	{
    Write("use case 2: valid - invalid");
		use_case = 1; // use case 2: valid - invalid
    
	}
	else if ((Valid_pattern > 0)&(Invalid_pattern == 0)&(Unobtain_pattern != 0))
	{
    Write("use case 3: valid - unobtain");
		use_case = 2; // use case 3: valid - unobtain
	}else
	{
		use_case = 255; // out of use case 
		Write("None of combination use case sastified");
	}
    /* Data selection value base on Data table of Env_Var */
    data_selection = getvalue(Env_24EDR_DataSimul_);
  }
  else
  {
    Valid_pattern = 0;
    Invalid_pattern = 0;
    Unobtain_pattern = 0;
    data_selection = 255;
   }
}

//yuy1hc added incase set all Undefault data in EDR, update based on J30K suffix I.
on envvar EnvEDR_SetUndefault_All
{
  if (@this==1){
    /*Below code generate by Excel Sheet*/
	putvalue ( EnvVeh_V_ActlBrk_, 0x20);
	putvalue ( EnvApedPos_Pc_ActlArb_, 0x20);
	putvalue ( EnvBrkOnOffSwtch_D_Actl_2_, 0x2);
	putvalue ( EnvEngAout_N_Actl_, 0x20);
//	putvalue ( EnvMotRev_N_Actl_, 0x20);
	putvalue ( EnvSteWhlComp_An_Est_, 0x20);
	putvalue ( EnvMfs_Turn_Stalk_SW_Status_, 0x1);
//	putvalue ( EnvBrkStkRatio_, 0xFF);
	putvalue ( EnvShiftPos_D_Trg_, 0xB);
//	putvalue ( EnvASC_State_, 0x3);
//	putvalue ( EnvACC_State_, 0x3);
	putvalue ( EnvAbs_B_Falt_, 0x1);
	putvalue ( EnvRequest_AEB_B_Deceleration_, 0xFF);
	putvalue ( EnvStabCtlBrkActv_B_Actl_, 0x1);
	putvalue ( EnvTracCtlBrkActv_B_Actl_, 0x0);
	putvalue ( EnvTPMSCtlLamp_D_Rq_, 0x1);
	putvalue ( EnvEPB_Status_, 0x1);
	putvalue ( EnvBrkLamp_B_Rq_, 0x1);
	putvalue ( EnvCurnt_Year_ByGPS_, 0x17);
	putvalue ( EnvCurnt_Month_ByGPS_, 0x4);
	putvalue ( EnvCurnt_Date_ByGPS_, 0x15);
	putvalue ( EnvCurnt_Hour_ByGPS_, 0xC);
	putvalue ( EnvCurnt_Minutes_ByGPS_, 0xF);
	putvalue ( EnvCurnt_Second_ByGPS_, 0xF);
	putvalue ( EnvLDW_state_, 0x2);
	putvalue ( EnvLDP_state_, 0x4);
	putvalue ( EnvBSP_state_, 0x4);
	putvalue ( EnvLKA_state_, 0x1);
	putvalue ( EnvSeatBeltStat_D_Actl_, 0xF);
	putvalue ( EnvApedPosPcActl_D_Qf_, 0x3);
	putvalue ( EnvLghtSw_D_Qf_, 0x3);
	putvalue ( EnvAbsActv_B_Actl_, 0x0);
	putvalue ( EnvAEB_Fail_Flag_Brk_, 0x1);
	putvalue ( EnvDsc_B_Falt_, 0x0);
	putvalue ( EnvTracCtlPtActv_B_Actl_, 0x0);
	putvalue ( EnvTPMS_Status_, 0x0);
	putvalue ( EnvEPB_DisplayRequest3_, 0x0);
	putvalue ( EnvLDW_lane_lh_, 0x3);
	putvalue ( EnvRDP_state_, 0x4);
	putvalue ( EnvOCP_state_, 0x4);
	putvalue ( EnvHazardSw_D_Actl_, 0x0);
//	putvalue ( EnvReq_AEB_VRU_B_Deceleration_, 0xFF);
	putvalue ( EnvDSC_OnOff_status_, 0x0);
	putvalue ( EnvTCS_BRK_FAILD_, 0x0);
	putvalue ( EnvEPB_DisplayRequest4_, 0x0);
	putvalue ( EnvLDW_lane_rh_, 0x3);
	putvalue ( EnvAEB_VRU_state_, 0x1);
	putvalue ( EnvTCS_ENG_FAILD_, 0x0);
	putvalue ( EnvEPB_DisplayRequest5_, 0x0);
	putvalue ( EnvCstmzStat_FAEB_ONOFF_, 0x1);
	putvalue ( EnvDSC_OnOff_status_, 0x1);
	putvalue ( EnvAEB_state_, 0x1);

    /*****END*****/
    @this = 0;
  }
}
