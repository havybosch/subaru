/*@!Encoding:1252*/
variables
{
	Message ADAS_AP_Collision_Data2		MSG_ADAS_AP_Collision_Data2;
	Message SAS_G_Info2		MSG_SAS_G_Info2;
	Message RCM_Diag_Rx		MSG_RCM_Diag_Rx;
	Message IP_Switch_Information		MSG_IP_Switch_Information;
	Message AEB_Longitudinal_Req_Brk_MAC		MSG_AEB_Longitudinal_Req_Brk_MAC;
	Message YAW_Rate_Brake_Control_2_2_MAC		MSG_YAW_Rate_Brake_Control_2_2_MAC;
	Message EPAS_SAS_Info_2_MAC		MSG_EPAS_SAS_Info_2_MAC;
	Message MACKSEND6		MSG_MACKSEND6;
	Message LocateTime_Info		MSG_LocateTime_Info;
	Message RCM_Bus_Status		MSG_RCM_Bus_Status;
	Message DesiredTorqBrk_MAC		MSG_DesiredTorqBrk_MAC;
	Message EngControlData		MSG_EngControlData;
	Message CBCM_DriveSelection_Info		MSG_CBCM_DriveSelection_Info;
	Message RCM_Late_Acc_MAC		MSG_RCM_Late_Acc_MAC;
	Message MACKVERI2		MSG_MACKVERI2;
	Message RCM_Diag_Tx		MSG_RCM_Diag_Tx;
	Message VDT_Trigger_Control2		MSG_VDT_Trigger_Control2;
	Message Door_D_Message		MSG_Door_D_Message;
	Message SAS_G_Info1		MSG_SAS_G_Info1;
	Message ECM_Status		MSG_ECM_Status;
	Message ADAS_HMI_Information2		MSG_ADAS_HMI_Information2;
	Message Hvac_Control_Information2_MAC		MSG_Hvac_Control_Information2_MAC;
	Message Longitudinal_Lateral_deltaV		MSG_Longitudinal_Lateral_deltaV;
	Message YAW_Rate_Brake_Control_2_1_MAC		MSG_YAW_Rate_Brake_Control_2_1_MAC;
	Message MACKSEND3		MSG_MACKSEND3;
	Message EPAS_SAS_Info_1_MAC		MSG_EPAS_SAS_Info_1_MAC;
	Message ADAS_SteeringCtrl_Data		MSG_ADAS_SteeringCtrl_Data;
	Message MACKVERI4		MSG_MACKVERI4;
	Message ABS_Diag_Rx		MSG_ABS_Diag_Rx;
	Message WheelData2		MSG_WheelData2;
	Message crashoutput_brk_MAC		MSG_crashoutput_brk_MAC;
	Message DirectYawMomentControlRequest		MSG_DirectYawMomentControlRequest;
	Message AEB_Longitudinal_Request_Pt_MAC		MSG_AEB_Longitudinal_Request_Pt_MAC;
	Message BrakeSysFeatures_MAC		MSG_BrakeSysFeatures_MAC;
	Message CBCM_Autosar_NM		MSG_CBCM_Autosar_NM;
	Message WheelData_1_MAC		MSG_WheelData_1_MAC;
	Message GCC_Config_Mgmt		MSG_GCC_Config_Mgmt;
	Message MACKSEND8		MSG_MACKSEND8;
	Message Functional_Diag_Request		MSG_Functional_Diag_Request;
	Message Engine_Conf		MSG_Engine_Conf;
	Message TransGearData		MSG_TransGearData;
	Message MACKSEND2		MSG_MACKSEND2;
	Message ADAS_HMI_Information4		MSG_ADAS_HMI_Information4;
	Message EngVehicleSpThrottle		MSG_EngVehicleSpThrottle;
	Message RBCM_Information2		MSG_RBCM_Information2;
	Message RCMSerialNumber		MSG_RCMSerialNumber;
	Message TPMS_Control		MSG_TPMS_Control;
	Message CBCM_IllumStatus		MSG_CBCM_IllumStatus;
	Message EPAS_CCP_Rx		MSG_EPAS_CCP_Rx;
	Message MACKSEND4		MSG_MACKSEND4;
	Message DCM_Message		MSG_DCM_Message;
	Message EPAS_Diag_Tx		MSG_EPAS_Diag_Tx;
	Message ABS_Diag_Tx		MSG_ABS_Diag_Tx;
	Message crashoutput_MAC		MSG_crashoutput_MAC;
	Message MACKID_MACKUSAGE		MSG_MACKID_MACKUSAGE;
	Message RCM_Long_Acc_MAC		MSG_RCM_Long_Acc_MAC;
	Message YAW_Rate_Brake_Control_1_2_MAC		MSG_YAW_Rate_Brake_Control_1_2_MAC;
	Message FSC_AEBReq_Info		MSG_FSC_AEBReq_Info;
	Message RCM_Yaw_Rate_MAC		MSG_RCM_Yaw_Rate_MAC;
	Message Steering_Column_Switch		MSG_Steering_Column_Switch;
	Message ABS_Autosar_NM		MSG_ABS_Autosar_NM;
	Message BCM_Information1		MSG_BCM_Information1;
	Message EPAS_Bus_Status		MSG_EPAS_Bus_Status;
	Message BrakeSysFeatures		MSG_BrakeSysFeatures;
	Message MACKVERI3		MSG_MACKVERI3;
	Message ADAS_HMI_Information12		MSG_ADAS_HMI_Information12;
	Message Cruise_Multi_Switch_2_MAC		MSG_Cruise_Multi_Switch_2_MAC;
	Message SISS_Rqst		MSG_SISS_Rqst;
	Message VDT_RCM_EDR		MSG_VDT_RCM_EDR;
	Message MACKSEND5		MSG_MACKSEND5;
	Message ADAS_HMI_Information5		MSG_ADAS_HMI_Information5;
	Message RCM_ISO_SCRAP_Rx		MSG_RCM_ISO_SCRAP_Rx;
	Message ADAS_Longitudinal_Req_Brk_MAC		MSG_ADAS_Longitudinal_Req_Brk_MAC;
	Message SmartKeylessRequest		MSG_SmartKeylessRequest;
	Message EPAS_Diag_Rx		MSG_EPAS_Diag_Rx;
	Message Steering_Wheel_Angle		MSG_Steering_Wheel_Angle;
	Message VCM_Customize_Status_01		MSG_VCM_Customize_Status_01;
	Message RCMStatusMessage_MAC		MSG_RCMStatusMessage_MAC;
	Message RCM_ISO_SCRAP_Tx		MSG_RCM_ISO_SCRAP_Tx;
	Message MACKVERI1		MSG_MACKVERI1;
	Message YAW_Rate_Brake_Control		MSG_YAW_Rate_Brake_Control;
	Message MACKSEND1		MSG_MACKSEND1;
	Message Cruise_Multi_Switch_1_MAC		MSG_Cruise_Multi_Switch_1_MAC;
	Message ADAS_HMI_Information1		MSG_ADAS_HMI_Information1;
	Message EPAS_CCP_Tx		MSG_EPAS_CCP_Tx;
	Message BCM_Information1_MAC		MSG_BCM_Information1_MAC;
	Message MACKSEND7		MSG_MACKSEND7;
	Message Push_Start_Status		MSG_Push_Start_Status;
	Message CGW_Sync		MSG_CGW_Sync;
	Message EPAS_Info_MAC		MSG_EPAS_Info_MAC;
	Message ADAS_AP_Collision_Data1		MSG_ADAS_AP_Collision_Data1;
	Message ADAS_SteeringCtrlReq_Data		MSG_ADAS_SteeringCtrlReq_Data;
	Message RCMStatusMessage_2_MAC		MSG_RCMStatusMessage_2_MAC;
	Message YAW_Rate_Brake_Control_1_1_MAC		MSG_YAW_Rate_Brake_Control_1_1_MAC;
	Message WheelData_2_MAC		MSG_WheelData_2_MAC;
	Message Hvac_Control_Information2		MSG_Hvac_Control_Information2;
	Message WheelSpeed		MSG_WheelSpeed;


	mstimer 	T_MSG_ADAS_AP_Collision_Data2;
	mstimer 	T_MSG_SAS_G_Info2;
	mstimer 	T_MSG_RCM_Diag_Rx;
	mstimer 	T_MSG_IP_Switch_Information;
	mstimer 	T_MSG_AEB_Longitudinal_Req_Brk_MAC;
	mstimer 	T_MSG_YAW_Rate_Brake_Control_2_2_MAC;
	mstimer 	T_MSG_EPAS_SAS_Info_2_MAC;
	mstimer 	T_MSG_MACKSEND6;
	mstimer 	T_MSG_LocateTime_Info;
	mstimer 	T_MSG_RCM_Bus_Status;
	mstimer 	T_MSG_DesiredTorqBrk_MAC;
	mstimer 	T_MSG_EngControlData;
	mstimer 	T_MSG_CBCM_DriveSelection_Info;
	mstimer 	T_MSG_RCM_Late_Acc_MAC;
	mstimer 	T_MSG_MACKVERI2;
	mstimer 	T_MSG_RCM_Diag_Tx;
	mstimer 	T_MSG_VDT_Trigger_Control2;
	mstimer 	T_MSG_Door_D_Message;
	mstimer 	T_MSG_SAS_G_Info1;
	mstimer 	T_MSG_ECM_Status;
	mstimer 	T_MSG_ADAS_HMI_Information2;
	mstimer 	T_MSG_Hvac_Control_Information2_MAC;
	mstimer 	T_MSG_Longitudinal_Lateral_deltaV;
	mstimer 	T_MSG_YAW_Rate_Brake_Control_2_1_MAC;
	mstimer 	T_MSG_MACKSEND3;
	mstimer 	T_MSG_EPAS_SAS_Info_1_MAC;
	mstimer 	T_MSG_ADAS_SteeringCtrl_Data;
	mstimer 	T_MSG_MACKVERI4;
	mstimer 	T_MSG_ABS_Diag_Rx;
	mstimer 	T_MSG_WheelData2;
	mstimer 	T_MSG_crashoutput_brk_MAC;
	mstimer 	T_MSG_DirectYawMomentControlRequest;
	mstimer 	T_MSG_AEB_Longitudinal_Request_Pt_MAC;
	mstimer 	T_MSG_BrakeSysFeatures_MAC;
	mstimer 	T_MSG_CBCM_Autosar_NM;
	mstimer 	T_MSG_WheelData_1_MAC;
	mstimer 	T_MSG_GCC_Config_Mgmt;
	mstimer 	T_MSG_MACKSEND8;
	mstimer 	T_MSG_Functional_Diag_Request;
	mstimer 	T_MSG_Engine_Conf;
	mstimer 	T_MSG_TransGearData;
	mstimer 	T_MSG_MACKSEND2;
	mstimer 	T_MSG_ADAS_HMI_Information4;
	mstimer 	T_MSG_EngVehicleSpThrottle;
	mstimer 	T_MSG_RBCM_Information2;
	mstimer 	T_MSG_RCMSerialNumber;
	mstimer 	T_MSG_TPMS_Control;
	mstimer 	T_MSG_CBCM_IllumStatus;
	mstimer 	T_MSG_EPAS_CCP_Rx;
	mstimer 	T_MSG_MACKSEND4;
	mstimer 	T_MSG_DCM_Message;
	mstimer 	T_MSG_EPAS_Diag_Tx;
	mstimer 	T_MSG_ABS_Diag_Tx;
	mstimer 	T_MSG_crashoutput_MAC;
	mstimer 	T_MSG_MACKID_MACKUSAGE;
	mstimer 	T_MSG_RCM_Long_Acc_MAC;
	mstimer 	T_MSG_YAW_Rate_Brake_Control_1_2_MAC;
	mstimer 	T_MSG_FSC_AEBReq_Info;
	mstimer 	T_MSG_RCM_Yaw_Rate_MAC;
	mstimer 	T_MSG_Steering_Column_Switch;
	mstimer 	T_MSG_ABS_Autosar_NM;
	mstimer 	T_MSG_BCM_Information1;
	mstimer 	T_MSG_EPAS_Bus_Status;
	mstimer 	T_MSG_BrakeSysFeatures;
	mstimer 	T_MSG_MACKVERI3;
	mstimer 	T_MSG_ADAS_HMI_Information12;
	mstimer 	T_MSG_Cruise_Multi_Switch_2_MAC;
	mstimer 	T_MSG_SISS_Rqst;
	mstimer 	T_MSG_VDT_RCM_EDR;
	mstimer 	T_MSG_MACKSEND5;
	mstimer 	T_MSG_ADAS_HMI_Information5;
	mstimer 	T_MSG_RCM_ISO_SCRAP_Rx;
	mstimer 	T_MSG_ADAS_Longitudinal_Req_Brk_MAC;
	mstimer 	T_MSG_SmartKeylessRequest;
	mstimer 	T_MSG_EPAS_Diag_Rx;
	mstimer 	T_MSG_Steering_Wheel_Angle;
	mstimer 	T_MSG_VCM_Customize_Status_01;
	mstimer 	T_MSG_RCMStatusMessage_MAC;
	mstimer 	T_MSG_RCM_ISO_SCRAP_Tx;
	mstimer 	T_MSG_MACKVERI1;
	mstimer 	T_MSG_YAW_Rate_Brake_Control;
	mstimer 	T_MSG_MACKSEND1;
	mstimer 	T_MSG_Cruise_Multi_Switch_1_MAC;
	mstimer 	T_MSG_ADAS_HMI_Information1;
	mstimer 	T_MSG_EPAS_CCP_Tx;
	mstimer 	T_MSG_BCM_Information1_MAC;
	mstimer 	T_MSG_MACKSEND7;
	mstimer 	T_MSG_Push_Start_Status;
	mstimer 	T_MSG_CGW_Sync;
	mstimer 	T_MSG_EPAS_Info_MAC;
	mstimer 	T_MSG_ADAS_AP_Collision_Data1;
	mstimer 	T_MSG_ADAS_SteeringCtrlReq_Data;
	mstimer 	T_MSG_RCMStatusMessage_2_MAC;
	mstimer 	T_MSG_YAW_Rate_Brake_Control_1_1_MAC;
	mstimer 	T_MSG_WheelData_2_MAC;
	mstimer 	T_MSG_Hvac_Control_Information2;
	mstimer 	T_MSG_WheelSpeed;

}