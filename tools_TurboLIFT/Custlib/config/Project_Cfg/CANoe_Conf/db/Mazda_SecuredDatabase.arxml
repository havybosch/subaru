AUTOSAR XML (schema 4-2-2)
package /VectorAutosarExplorerGeneratedObjects/SYSTEM
  system System
package /VectorAutosarExplorerGeneratedObjects/Mazda_SecuredDB
  can cluster Mazda_SecuredDB: baudrate=50000, protocol-name=CAN, speed=250000
    can physical channel CANChannel
      comm-connectors:
        Connector_CGW_5ff3715c4a715833
        Connector_RCM_1e6410119d843cf4
        Connector_ECU_Listenning_ae0e138063271aa9
        Connector_SendingNode_6ffcf495b1dbdd16
      frame CGW_Sync_arxml: id 0x20, from CGW, to RCM, frame-length=8, can-addressing-mode=STANDARD, can-frame-tx-behavior=CAN-20
        secured i pdu CGW_Sync_SecuredPDU: length=8, payload=NewPduTriggering_e7f598d650091cf8, secure-communication-props={auth-info-tx-length=28, freshness-value-length=40, freshness-value-tx-length=36}
      frame RCMYawRateMAC_arxml: id 0x70, from RCM, to ListenningNode, frame-length=8, can-addressing-mode=STANDARD, can-frame-tx-behavior=CAN-20
        secured i pdu RCMYawRateMAC_SecuredPDU: length=8, payload=NewPduTriggering_22d2c37e6f8f58e8, secure-communication-props={auth-info-tx-length=28, freshness-value-id=0, freshness-value-length=48, freshness-value-tx-length=4}
      frame WheelData2MAC_arxml: id 0x98, from SendingNode, to RCM, frame-length=8, can-addressing-mode=STANDARD, can-frame-tx-behavior=CAN-20
        secured i pdu WheelData2MAC_SecuredPDU: length=8, payload=NewPduTriggering_3e5c11ffb2b791a9, secure-communication-props={auth-info-tx-length=28, freshness-value-id=3, freshness-value-length=48, freshness-value-tx-length=4}
      frame RCMLateAccMAC_arxml: id 0x71, from RCM, to ListenningNode, frame-length=8, can-addressing-mode=STANDARD, can-frame-tx-behavior=CAN-20
        secured i pdu RCMLateAccMAC_SecuredPDU: length=8, payload=NewPduTriggering_e4de984f6a30268d, secure-communication-props={auth-info-tx-length=28, freshness-value-id=1, freshness-value-length=48, freshness-value-tx-length=4}
      frame RCMLongAccMAC_arxml: id 0x72, from RCM, to ListenningNode, frame-length=8, can-addressing-mode=STANDARD, can-frame-tx-behavior=CAN-20
        secured i pdu RCMLongAccMAC_SecuredPDU: length=8, payload=NewPduTriggering_f3feb0e1619f3a14, secure-communication-props={auth-info-tx-length=28, freshness-value-id=2, freshness-value-length=48, freshness-value-tx-length=4}
      frame BCMInformation1MAC_arxml: id 0x92, from SendingNode, to RCM ListenningNode, frame-length=8, can-addressing-mode=STANDARD, can-frame-tx-behavior=CAN-20
        secured i pdu BCMInformation1MAC_SecuredPDU: length=8, payload=NewPduTriggering_c8342971e5663344, secure-communication-props={auth-info-tx-length=28, freshness-value-id=1, freshness-value-length=48, freshness-value-tx-length=4}
      frame HvacControlInformation2MAC_arxml: id 0x42A, from SendingNode, to RCM ListenningNode, frame-length=8, can-addressing-mode=STANDARD, can-frame-tx-behavior=CAN-20
        secured i pdu HvacControlInformation2MAC_NewPDU: length=8, payload=NewPduTriggering_4231e4b537837181, secure-communication-props={auth-info-tx-length=28, freshness-value-id=4, freshness-value-length=48, freshness-value-tx-length=4}
      frame crashoutputMAC_arxml: id 0x33E, from RCM, to ListenningNode, frame-length=8, can-addressing-mode=STANDARD, can-frame-tx-behavior=CAN-20
        secured i pdu CrashOutputMAC_SecuredPDU: length=8, payload=NewPduTriggering_62e0a73a14efbf01, secure-communication-props={auth-info-tx-length=28, freshness-value-length=48, freshness-value-tx-length=4}
      frame RCMStatusMessageMAC_arxml: id 0x340, from CGW, to ListenningNode, frame-length=8, can-addressing-mode=STANDARD, can-frame-tx-behavior=CAN-20
        secured i pdu RCMStatusMessageMAC_SecuredPDU: length=8, payload=NewPduTriggering_29f09f5836f40299, secure-communication-props={auth-info-tx-length=28, freshness-value-length=48, freshness-value-tx-length=4}
      frame EPAS_SAS_Info2MAC_arxml: id 0x87, from SendingNode, to RCM ListenningNode, frame-length=8, can-addressing-mode=STANDARD, can-frame-tx-behavior=CAN-20
        secured i pdu EPAS_SAS_Info2MAC_SecuredPDU: length=8, payload=NewPduTriggering_bdb73dd7b1476e9a, secure-communication-props={auth-info-tx-length=28, freshness-value-length=48, freshness-value-tx-length=4}
      frame CruiseMultiSwitch1MAC_arxml: id 0x94, from SendingNode, to RCM ListenningNode, frame-length=8, can-addressing-mode=STANDARD, can-frame-tx-behavior=CAN-20
        secured i pdu CruiseMultiSwitch1MAC_SecuredPDU: length=8, payload=NewPduTriggering_52c5257439aafd77, secure-communication-props={auth-info-tx-length=28, freshness-value-length=48, freshness-value-tx-length=4}
      frame RCMStatusMessage_2_MAC_arxml: id 0x4A, from RCM, to ListenningNode, frame-length=8, can-addressing-mode=STANDARD, can-frame-tx-behavior=CAN-20
        secured i pdu RCMStatusMessage_2_MAC_SecuredPDU: length=8, payload=NewPduTriggering_fdd98c3be9835778, secure-communication-props={auth-info-tx-length=28, freshness-value-length=48, freshness-value-tx-length=4}
      pdu triggering NewPduTriggering_e7f598d650091cf8: pdu=CGW_Sync_SignalPDU, from CGW, to RCM
      pdu triggering NewPduTriggering_22d2c37e6f8f58e8: pdu=RCMYawRateMAC_SignalPDU, from RCM
      pdu triggering NewPduTriggering_3e5c11ffb2b791a9: pdu=WheelData2MAC_SignalPDU, from SendingNode, to RCM
      pdu triggering NewPduTriggering_e4de984f6a30268d: pdu=RCMLateAccMAC_SignalPDU, from RCM, to ListenningNode
      pdu triggering NewPduTriggering_f3feb0e1619f3a14: pdu=RCMLongAccMAC_SignalPDU, from RCM, to ListenningNode
      pdu triggering NewPduTriggering_c8342971e5663344: pdu=BCMInformationMAC_SignalPDU, from SendingNode, to RCM ListenningNode
      pdu triggering NewPduTriggering_4231e4b537837181: pdu=HvacControlInformation2MAC_SignalPDU, from SendingNode, to RCM ListenningNode
      pdu triggering NewPduTriggering_62e0a73a14efbf01: pdu=CrashOutputMAC_SignalPDU, from RCM, to ListenningNode
      pdu triggering NewPduTriggering_29f09f5836f40299: pdu=RCMStatusMessageMAC_SignalPDU, from CGW, to ListenningNode
      pdu triggering NewPduTriggering_bdb73dd7b1476e9a: pdu=EPAS_SAS_Info2MAC_SignalPDU, from SendingNode, to RCM ListenningNode
      pdu triggering NewPduTriggering_52c5257439aafd77: pdu=CruiseMultiSwitch1MAC_SignalPDU, from SendingNode, to RCM ListenningNode
      pdu triggering NewPduTriggering_fdd98c3be9835778: pdu=RCMStatusMessage_2_MAC_SignalPDU, from RCM, to ListenningNode
package /VectorAutosarExplorerGeneratedObjects/ECU_INSTANCES
  4 x ecu instance, all with diagnostic-address=0:
    CGW: associated-com-i-pdu-group=[PduGroup_6108db4cd3dc4cc2ad08e2807fe317c0_Tx, PduGroup_b7da231febff4e4c9272d68c7ba573b3_Tx]
      can communication controller Controller_CGW_3f6cb31cb8c077c8
      can communication connector Connector_CGW_5ff3715c4a715833: comm-controller=Controller_CGW_3f6cb31cb8c077c8
    RCM: associated-com-i-pdu-group=[PduGroup_34a30fc1c3674d7c80bfb15d83007864_Rx, PduGroup_69d508bf690e42ffa350b6283e705a96_Tx, PduGroup_4f646e9ae7814e5b92907363247cc228_Rx, PduGroup_ada6ca8a6e3b473fb43629b2128e0cf7_Tx, PduGroup_204fbaaa570a40dda098e5f9a7efe8f9_Tx, PduGroup_fdb485a4c3ee4cdcbded60e2cdedea9a_Rx, PduGroup_986e74aeec1f41bfa2666bb6bd83f025_Rx, PduGroup_d61b27fd8f4b4cbeaca0520f0ebe6d36_Rx, PduGroup_ebb139b8bc274f819cc35704e67e38dd_Rx, PduGroup_d40fdc19f6ce4dbebc6a925ec6cb83ba_Tx, PduGroup_0a1803b268dd496fa5a229fc469a5717_Rx, PduGroup_2d7a7b2fa5064e1b8b4a0a4148ff5e88_Rx, PduGroup_bdf0a98fac8d458fbaf5f2468e088545_Tx]
      can communication controller Controller_RCM_5b96d50a92224f03
      can communication connector Connector_RCM_1e6410119d843cf4: comm-controller=Controller_RCM_5b96d50a92224f03
    ListenningNode: associated-com-i-pdu-group=[PduGroup_c0e2eb103ac144bd8631631c09ba5464_Rx, PduGroup_b333b2b99efd42369a91dff7091812e6_Rx, PduGroup_e40c385c1ee4490eb28645db75ae15b4_Rx, PduGroup_ff327cef6c0b41ccbac0f59cdb1984e4_Rx, PduGroup_9b6091071acb4abf99191486034c4afa_Rx, PduGroup_1461eb8f51a74e2aac32c46de0213cf6_Rx, PduGroup_16172ff6d9c84a29aa9dc0e5cb11f503_Rx, PduGroup_01c730556a564f5a99e45cd6dfe5dd3b_Rx, PduGroup_0dd6a2d0b8f24615aeaf94264ddc5df4_Rx, PduGroup_40d787db26934de48e9a7afae967353c_Rx, PduGroup_3dee4a88dd3f46eca647b2aa2b7cc71d_Rx]
      can communication controller Controller_ECU_Listenning_c31e57be02a92737
      can communication connector Connector_ECU_Listenning_ae0e138063271aa9: comm-controller=Controller_ECU_Listenning_c31e57be02a92737
    SendingNode: associated-com-i-pdu-group=[PduGroup_18f67d8059554defba05f9ddc08bfb80_Tx, PduGroup_75f940bcb4d74e3c8e84ba3710885740_Tx, PduGroup_2548ca802e454a1faabec74892afba87_Tx, PduGroup_b21777323c3c4e6a8688e772e159eee4_Tx, PduGroup_fc0d02c9da1b49e0b7d3b8c92495ba8a_Tx, PduGroup_f40841bd3e664b2ba9a8095db2d2ec1a_Tx, PduGroup_f237d2a084284e79a3f3ce73b0b7b472_Tx]
      can communication controller Controller_SendingNode_3e125b70ea55e8e4
      can communication connector Connector_SendingNode_6ffcf495b1dbdd16: comm-controller=Controller_SendingNode_3e125b70ea55e8e4
package /VectorAutosarExplorerGeneratedObjects/PDUS
  pdu CGW_Sync_SignalPDU: length=8
    signal TripCounter: start 7, 16 bit, big-endian, system signal CGW_Sync_SignalPDU_TripCounter_0cd74f6e61491288, data-type-policy=OVERRIDE, base-type=New_BaseType, to RCM
    signal ResetCounter: start 23, 20 bit, big-endian, system signal CGW_Sync_SignalPDU_ResetCounter_a700fe8a163a74d0, data-type-policy=OVERRIDE, base-type=New_BaseType, to RCM
    signal MACTx: start 35, 28 bit, big-endian, system signal CGW_Sync_SignalPDU_MACTx_b901f88610f80920, data-type-policy=OVERRIDE, base-type=New_BaseType, to RCM
  pdu RCMYawRateMAC_SignalPDU: length=8
    signal RCMYawRateCRC: start 7, 8 bit, big-endian, system signal ID070_E2E_CRCProfile2_288ec022a029cff5, data-type-policy=OVERRIDE, base-type=New_BaseType
    signal Signal_State_Yaw_Rate: start 15, 2 bit, big-endian, system signal Signal_State_Yaw_Rate_f3fb16f4695fcc92, data-type-policy=OVERRIDE, base-type=New_BaseType
    signal Rolling_Counter_Yaw_Rate: start 11, 4 bit, big-endian, system signal ID070_E2E_CNTProfile2_75b0b9197398495f, data-type-policy=OVERRIDE, base-type=New_BaseType
    signal Yaw_Rate: start 23, 16 bit, big-endian, system signal Yaw_Rate_603448fd11b3066e, data-type-policy=OVERRIDE, base-type=New_BaseType
    signal RCM_Yaw_Rate_FVTx: start 39, 4 bit, big-endian, system signal RCM_Yaw_Rate_FVTx_7d30c7bec9ca1a3b, data-type-policy=OVERRIDE, base-type=New_BaseType
    signal RCM_Yaw_Rate_MACTx: start 35, 28 bit, big-endian, system signal RCM_Yaw_Rate_MACTx_64d548aeaf9052e4, data-type-policy=OVERRIDE, base-type=New_BaseType
  pdu WheelData2MAC_SignalPDU: length=8
    signal WheelData2MAC_SignalPDU_Veh_V_ActlBrk: start 7, 16 bit, big-endian, system signal WheelData2MAC_SignalPDU_Veh_V_ActlBrk_923d5dd89d4de0cb, data-type-policy=OVERRIDE, base-type=New_BaseType, to RCM
    signal WheelData2MAC_SignalPDU_VehVActlBrk_D_Qf: start 23, 2 bit, big-endian, system signal WheelData2MAC_SignalPDU_VehVActlBrk_D_Qf_71044ef6d390ff37, data-type-policy=OVERRIDE, base-type=New_BaseType, to RCM
    signal WheelData2MAC_SignalPDU_FVRx: start 39, 4 bit, big-endian, system signal WheelData2MAC_SignalPDU_FVRx_32bfc906b0c5f780, data-type-policy=OVERRIDE, base-type=New_BaseType, to RCM
    signal WheelData2MAC_SignalPDU_MACRx: start 35, 28 bit, big-endian, system signal WheelData2MAC_SignalPDU_MACRx_7e0a191e9d604c90, data-type-policy=OVERRIDE, base-type=New_BaseType, to RCM
  pdu RCMLateAccMAC_SignalPDU: length=8
    signal ID071_E2E_CRCProfile2: start 7, 8 bit, big-endian, system signal ID071_E2E_CRCProfile2_a9d176d1723dfd49, data-type-policy=OVERRIDE, base-type=New_BaseType, to ListenningNode
    signal Signal_State_Lateral_Acceleratio: start 15, 2 bit, big-endian, system signal Signal_State_Lateral_Acceleratio_ff4ab5db54727a59, data-type-policy=OVERRIDE, base-type=New_BaseType, to ListenningNode
    signal ID071_E2E_CNTProfile2: start 11, 4 bit, big-endian, system signal ID071_E2E_CNTProfile2_b8728c36753c9b4a, data-type-policy=OVERRIDE, base-type=New_BaseType, to ListenningNode
    signal Lateral_Acceleration: start 23, 16 bit, big-endian, system signal Lateral_Acceleration_77abd05f12aba7ce, data-type-policy=OVERRIDE, base-type=New_BaseType, to ListenningNode
    signal RCM_Late_Acc_FVTx: start 39, 4 bit, big-endian, system signal RCM_Late_Acc_FVTx_a277c6a8e5054ede, data-type-policy=OVERRIDE, base-type=New_BaseType, to ListenningNode
    signal RCM_Late_Acc_MACTx: start 35, 28 bit, big-endian, system signal RCM_Late_Acc_MACTx_06832afd54d626d5, data-type-policy=OVERRIDE, base-type=New_BaseType, to ListenningNode
  pdu RCMLongAccMAC_SignalPDU: length=8
    signal ID072_E2E_CRCProfile2: start 7, 8 bit, big-endian, system signal ID072_E2E_CRCProfile2_b9f3a891151e16d1, data-type-policy=OVERRIDE, base-type=New_BaseType, to ListenningNode
    signal Signal_State_Longtitudinal_Accele: start 15, 2 bit, big-endian, system signal Signal_State_Longtitudinal_Accele_011733505be686ba, data-type-policy=OVERRIDE, base-type=New_BaseType, to ListenningNode
    signal ID072_E2E_CNTProfile2: start 11, 4 bit, big-endian, system signal ID072_E2E_CNTProfile2_c5d544501e3828ec, data-type-policy=OVERRIDE, base-type=New_BaseType, to ListenningNode
    signal Longitudinal_Acceleration: start 23, 16 bit, big-endian, system signal Longitudinal_Acceleration_1b0f98269b86fd11, data-type-policy=OVERRIDE, base-type=New_BaseType, to ListenningNode
    signal RCM_Long_Acc_FVTx: start 39, 4 bit, big-endian, system signal RCM_Long_Acc_FVTx_d3533a3fbdec7084, data-type-policy=OVERRIDE, base-type=New_BaseType, to ListenningNode
    signal RCM_Long_Acc_MACTx: start 35, 28 bit, big-endian, system signal RCM_Long_Acc_MACTx_bdaf32384358ea4d, data-type-policy=OVERRIDE, base-type=New_BaseType, to ListenningNode
  pdu BCMInformationMAC_SignalPDU: length=8
    signal PADI_Stat: start 7, 4 bit, big-endian, system signal PADI_Stat_11611574279ef910, data-type-policy=OVERRIDE, base-type=New_BaseType, to RCM ListenningNode
    signal BCMINFO1_MAC_No_Cnt: start 3, 4 bit, big-endian, system signal BCMINFO1_MAC_No_Cnt_1b9c6f2d88b43eef, data-type-policy=OVERRIDE, base-type=New_BaseType, to RCM ListenningNode
    signal BCMINFO1_MAC_No_Cs: start 15, 8 bit, big-endian, system signal BCMINFO1_MAC_No_Cs_ff57593d4f47b78e, data-type-policy=OVERRIDE, base-type=New_BaseType, to RCM ListenningNode
    signal BCM_Information1_FVTx: start 39, 4 bit, big-endian, system signal BCM_Information1_FVTx_6fb97d234cf4afef, data-type-policy=OVERRIDE, base-type=New_BaseType, to RCM ListenningNode
    signal BCM_Information1_MACTx: start 35, 28 bit, big-endian, system signal BCM_Information1_MACTx_9696a8a8d7ea9f5c, data-type-policy=OVERRIDE, base-type=New_BaseType, to RCM ListenningNode
  pdu HvacControlInformation2MAC_SignalPDU: length=8
    signal Hvac_Control_Information2_FVTx: start 39, 4 bit, big-endian, system signal Hvac_Control_Information2_FVTx_39bbdf1eb7739485, data-type-policy=OVERRIDE, base-type=New_BaseType, to RCM ListenningNode
    signal Hvac_Control_Information2_MACTx: start 35, 28 bit, big-endian, system signal Hvac_Control_Information2_MACTx_13c3a14c6040241b, data-type-policy=OVERRIDE, base-type=New_BaseType, to RCM ListenningNode
    signal FirstRowBuckleDriver: start 30, 2 bit, big-endian, system signal FirstRowBuckleDriver_69763b8dedd4dd6c, data-type-policy=OVERRIDE, base-type=New_BaseType, to RCM ListenningNode
  pdu CrashOutputMAC_SignalPDU: length=8
    signal threshold_over_front: start 7, 2 bit, big-endian, system signal threshold_over_front_51aab8ec01e388a1, data-type-policy=OVERRIDE, base-type=New_BaseType, to ListenningNode
    signal threshold_over_side_Driver: start 5, 2 bit, big-endian, system signal threshold_over_side_Driver_ded15dc863fcd919, data-type-policy=OVERRIDE, base-type=New_BaseType, to ListenningNode
    signal threshold_over_rear: start 1, 2 bit, big-endian, system signal threshold_over_rear_fb7fc4d3f88f92d2, data-type-policy=OVERRIDE, base-type=New_BaseType, to ListenningNode
    signal threshold_over_rollover: start 15, 2 bit, big-endian, system signal threshold_over_rollover_de65f88ca96adaa3, data-type-policy=OVERRIDE, base-type=New_BaseType, to ListenningNode
    signal FuelCutoffReq: start 13, 4 bit, big-endian, system signal FuelCutoffReq_3d6dc391209b6fd5, data-type-policy=OVERRIDE, base-type=New_BaseType, to ListenningNode
    signal RcmStat_B_Actl: start 9, 1 bit, big-endian, system signal RcmStat_B_Actl_d553f0ee4da4ebf7, data-type-policy=OVERRIDE, base-type=New_BaseType, to ListenningNode
    signal threshold_over_rollover_static: start 8, 1 bit, big-endian, system signal threshold_over_rollover_static_a609d8009f3aa24f, data-type-policy=OVERRIDE, base-type=New_BaseType, to ListenningNode
    signal ID33E_No_Cnt: start 19, 4 bit, big-endian, system signal ID33E_No_Cnt_7e3c7b5f78dae0cc, data-type-policy=OVERRIDE, base-type=New_BaseType, to ListenningNode
    signal threshold_over_side_passenger: start 3, 2 bit, big-endian, system signal threshold_over_side_passenger_67ccfd9961d4ce47, data-type-policy=OVERRIDE, base-type=New_BaseType, to ListenningNode
    signal crashoutput_FVTx: start 39, 4 bit, big-endian, system signal crashoutput_FVTx_04c17d7a2467a085, data-type-policy=OVERRIDE, base-type=New_BaseType, to ListenningNode
    signal ID33E_No_Cs: start 31, 8 bit, big-endian, system signal ID33E_No_Cs_3fc1a0c12e7f8ae4, data-type-policy=OVERRIDE, base-type=New_BaseType, to ListenningNode
    signal crashoutput_MACTx: start 35, 28 bit, big-endian, system signal crashoutput_MACTx_3ee764db1b0fb8d3, data-type-policy=OVERRIDE, base-type=New_BaseType, to ListenningNode
  pdu RCMStatusMessageMAC_SignalPDU: length=8
    signal RILReq: start 7, 2 bit, big-endian, system signal RILReq_42761c320373cc38, data-type-policy=OVERRIDE, base-type=New_BaseType, to ListenningNode
    signal PAD_Ind_Req: start 5, 3 bit, big-endian, system signal PAD_Ind_Req_1abe5c1d5ef742ad, data-type-policy=OVERRIDE, base-type=New_BaseType, to ListenningNode
    signal OCS_Status: start 2, 2 bit, big-endian, system signal OCS_Status_c13f882caff1845f, data-type-policy=OVERRIDE, base-type=New_BaseType, to ListenningNode
    signal FirstRowBucklePsngr: start 0, 2 bit, big-endian, system signal FirstRowBucklePsngr_121cd9df1a96b153, data-type-policy=OVERRIDE, base-type=New_BaseType, to ListenningNode
    signal DHS_RILReq: start 14, 2 bit, big-endian, system signal DHS_RILReq_7154fe1c11bb6167, data-type-policy=OVERRIDE, base-type=New_BaseType, to ListenningNode
    signal ID340_No_Cnt: start 19, 4 bit, big-endian, system signal ID340_No_Cnt_1937319f9c0c1042, data-type-policy=OVERRIDE, base-type=New_BaseType, to ListenningNode
    signal RCMStatusMessage_FVTx: start 39, 4 bit, big-endian, system signal RCMStatusMessage_FVTx_5f1358be004aae8f, data-type-policy=OVERRIDE, base-type=New_BaseType, to ListenningNode
    signal RCMStatusMessage_MACTx: start 35, 28 bit, big-endian, system signal RCMStatusMessage_MACTx_9ba17f4ecda15c86, data-type-policy=OVERRIDE, base-type=New_BaseType, to ListenningNode
    signal ID340_No_Cs: start 31, 8 bit, big-endian, system signal ID340_No_Cs_732d8ec74d71ea06, data-type-policy=OVERRIDE, base-type=New_BaseType, to ListenningNode
  pdu EPAS_SAS_Info2MAC_SignalPDU: length=8
    signal SteAngEstAn_No_Cs: start 7, 8 bit, big-endian, system signal SteAngEstAn_No_Cs_e4644db7771a1788, data-type-policy=OVERRIDE, base-type=New_BaseType, to RCM ListenningNode
    signal SteWhlCompAnEst_D_Qf: start 15, 8 bit, big-endian, system signal SteWhlCompAnEst_D_Qf_3c9d12fa42ec2c65, data-type-policy=OVERRIDE, base-type=New_BaseType, to RCM ListenningNode
    signal Sas_FailStatus: start 13, 2 bit, big-endian, system signal Sas_FailStatus_7c3560d75c8edfe4, data-type-policy=OVERRIDE, base-type=New_BaseType, to RCM ListenningNode
    signal SteAngEstAn_No_Cnt: start 11, 4 bit, big-endian, system signal SteAngEstAn_No_Cnt_cbacf3b4d0f8997d, data-type-policy=OVERRIDE, base-type=New_BaseType, to RCM ListenningNode
    signal SasCntComplt_B_Actl: start 23, 1 bit, big-endian, system signal SasCntComplt_B_Actl_8ef3cb1cb2040039, data-type-policy=OVERRIDE, base-type=New_BaseType, to RCM ListenningNode
    signal SteWhlComp_An_Est: start 22, 15 bit, big-endian, system signal SteWhlComp_An_Est_d614c1a57e99b61e, data-type-policy=OVERRIDE, base-type=New_BaseType, to RCM ListenningNode
    signal EPAS_SAS_Info_2_FVTx: start 39, 4 bit, big-endian, system signal EPAS_SAS_Info_2_FVTx_cf131972d3d4d8a7, data-type-policy=OVERRIDE, base-type=New_BaseType, to RCM ListenningNode
    signal EPAS_SAS_Info_2_MACTx: start 35, 28 bit, big-endian, system signal EPAS_SAS_Info_2_MACTx_b4845222132a6293, data-type-policy=OVERRIDE, base-type=New_BaseType, to RCM ListenningNode
  pdu CruiseMultiSwitch1MAC_SignalPDU: length=8
    signal RIL_STAT: start 9, 3 bit, big-endian, system signal RIL_STAT_f1dcbd3c432fb932, data-type-policy=OVERRIDE, base-type=New_BaseType, to RCM ListenningNode
    signal DHS_RIL_STAT: start 22, 3 bit, big-endian, system signal DHS_RIL_STAT_2acde375a95d680d, data-type-policy=OVERRIDE, base-type=New_BaseType, to RCM ListenningNode
    signal HECSwtchB_1_Cnt: start 19, 4 bit, big-endian, system signal HECSwtchB_1_Cnt_82cbd772f244bd16, data-type-policy=OVERRIDE, base-type=New_BaseType, to RCM ListenningNode
    signal Cruise_Multi_Switch_1_FVTx: start 39, 4 bit, big-endian, system signal Cruise_Multi_Switch_1_FVTx_a6494ddcf9ee68fb, data-type-policy=OVERRIDE, base-type=New_BaseType, to RCM ListenningNode
    signal HECSwtchB_1_Cs: start 31, 8 bit, big-endian, system signal HECSwtchB_1_Cs_8ae64e81403e1a40, data-type-policy=OVERRIDE, base-type=New_BaseType, to RCM ListenningNode
    signal Cruise_Multi_Switch1_MACTx: start 35, 28 bit, big-endian, system signal Cruise_Multi_Switch1_MACTx_75ab265dc6352823, data-type-policy=OVERRIDE, base-type=New_BaseType, to RCM ListenningNode
  pdu RCMStatusMessage_2_MAC_SignalPDU: length=8
    signal threshold_over_fst: start 7, 2 bit, big-endian, system signal threshold_over_fst_3b962528f18747f8, data-type-policy=OVERRIDE, base-type=New_BaseType, to ListenningNode
    signal RCMStatusMessage_2_MACTx: start 35, 28 bit, big-endian, system signal RCMStatusMessage_2_MACTx_8835f5c8b10ccd4f, data-type-policy=OVERRIDE, base-type=New_BaseType, to ListenningNode
    signal RCMStatusMessage_2_FVTx: start 39, 4 bit, big-endian, system signal RCMStatusMessage_2_FVTx_8b7c6dedd61a188a, data-type-policy=OVERRIDE, base-type=New_BaseType, to ListenningNode
package /VectorAutosarExplorerGeneratedObjects/PDU_GROUP
  33 x i signal i pdu group:
    PduGroup_6108db4cd3dc4cc2ad08e2807fe317c0_Tx: communication-direction=OUT
    PduGroup_34a30fc1c3674d7c80bfb15d83007864_Rx: communication-direction=IN
    PduGroup_69d508bf690e42ffa350b6283e705a96_Tx: communication-direction=OUT
    PduGroup_18f67d8059554defba05f9ddc08bfb80_Tx: communication-direction=OUT
    PduGroup_4f646e9ae7814e5b92907363247cc228_Rx: communication-direction=IN
    PduGroup_ada6ca8a6e3b473fb43629b2128e0cf7_Tx: communication-direction=OUT
    PduGroup_c0e2eb103ac144bd8631631c09ba5464_Rx: communication-direction=IN
    PduGroup_204fbaaa570a40dda098e5f9a7efe8f9_Tx: communication-direction=OUT
    PduGroup_b333b2b99efd42369a91dff7091812e6_Rx: communication-direction=IN
    PduGroup_75f940bcb4d74e3c8e84ba3710885740_Tx: communication-direction=OUT
    PduGroup_fdb485a4c3ee4cdcbded60e2cdedea9a_Rx: communication-direction=IN
    PduGroup_e40c385c1ee4490eb28645db75ae15b4_Rx: communication-direction=IN
    PduGroup_2548ca802e454a1faabec74892afba87_Tx: communication-direction=OUT
    PduGroup_986e74aeec1f41bfa2666bb6bd83f025_Rx: communication-direction=IN
    PduGroup_ff327cef6c0b41ccbac0f59cdb1984e4_Rx: communication-direction=IN
    PduGroup_b21777323c3c4e6a8688e772e159eee4_Tx: communication-direction=OUT
    PduGroup_d61b27fd8f4b4cbeaca0520f0ebe6d36_Rx: communication-direction=IN
    PduGroup_9b6091071acb4abf99191486034c4afa_Rx: communication-direction=IN
    PduGroup_fc0d02c9da1b49e0b7d3b8c92495ba8a_Tx: communication-direction=OUT
    PduGroup_ebb139b8bc274f819cc35704e67e38dd_Rx: communication-direction=IN
    PduGroup_1461eb8f51a74e2aac32c46de0213cf6_Rx: communication-direction=IN
    PduGroup_d40fdc19f6ce4dbebc6a925ec6cb83ba_Tx: communication-direction=OUT
    PduGroup_16172ff6d9c84a29aa9dc0e5cb11f503_Rx: communication-direction=IN
    PduGroup_b7da231febff4e4c9272d68c7ba573b3_Tx: communication-direction=OUT
    PduGroup_01c730556a564f5a99e45cd6dfe5dd3b_Rx: communication-direction=IN
    PduGroup_f40841bd3e664b2ba9a8095db2d2ec1a_Tx: communication-direction=OUT
    PduGroup_0a1803b268dd496fa5a229fc469a5717_Rx: communication-direction=IN
    PduGroup_0dd6a2d0b8f24615aeaf94264ddc5df4_Rx: communication-direction=IN
    PduGroup_f237d2a084284e79a3f3ce73b0b7b472_Tx: communication-direction=OUT
    PduGroup_2d7a7b2fa5064e1b8b4a0a4148ff5e88_Rx: communication-direction=IN
    PduGroup_40d787db26934de48e9a7afae967353c_Rx: communication-direction=IN
    PduGroup_bdf0a98fac8d458fbaf5f2468e088545_Tx: communication-direction=OUT
    PduGroup_3dee4a88dd3f46eca647b2aa2b7cc71d_Rx: communication-direction=IN
package /VectorAutosarExplorerGeneratedObjects/I_SIGNALS
  i signal ID429_E2E_CRCProfile2: data-type-policy=OVERRIDE, length=8, base-type=New_BaseType, system-signal=ID429_E2E_CRCProfile2_d3c7ee4ecd429e0b
  i signal ID429_E2E_CNTProfile2: data-type-policy=OVERRIDE, length=4, base-type=New_BaseType, system-signal=ID429_E2E_CNTProfile2_4bcbd6428f6550d8
package /VectorAutosarExplorerGeneratedObjects/BASE_TYPES
  base type New_BaseType: base-type-size=16, base-type-encoding=NONE
package /VectorAutosarExplorerGeneratedObjects/SYSTEM_SIGNALS
  system signal ID429_E2E_CRCProfile2_d3c7ee4ecd429e0b
  system signal ID429_E2E_CNTProfile2_4bcbd6428f6550d8
